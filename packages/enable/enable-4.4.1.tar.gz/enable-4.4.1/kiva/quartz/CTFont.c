/* Generated by Cython 0.19.2 on Fri May  9 10:22:43 2014 */

#define PY_SSIZE_T_CLEAN
#ifndef CYTHON_USE_PYLONG_INTERNALS
#ifdef PYLONG_BITS_IN_DIGIT
#define CYTHON_USE_PYLONG_INTERNALS 0
#else
#include "pyconfig.h"
#ifdef PYLONG_BITS_IN_DIGIT
#define CYTHON_USE_PYLONG_INTERNALS 1
#else
#define CYTHON_USE_PYLONG_INTERNALS 0
#endif
#endif
#endif
#include "Python.h"
#ifndef Py_PYTHON_H
    #error Python headers needed to compile C extensions, please install development version of Python.
#elif PY_VERSION_HEX < 0x02040000
    #error Cython requires Python 2.4+.
#else
#include <stddef.h> /* For offsetof */
#ifndef offsetof
#define offsetof(type, member) ( (size_t) & ((type*)0) -> member )
#endif
#if !defined(WIN32) && !defined(MS_WINDOWS)
  #ifndef __stdcall
    #define __stdcall
  #endif
  #ifndef __cdecl
    #define __cdecl
  #endif
  #ifndef __fastcall
    #define __fastcall
  #endif
#endif
#ifndef DL_IMPORT
  #define DL_IMPORT(t) t
#endif
#ifndef DL_EXPORT
  #define DL_EXPORT(t) t
#endif
#ifndef PY_LONG_LONG
  #define PY_LONG_LONG LONG_LONG
#endif
#ifndef Py_HUGE_VAL
  #define Py_HUGE_VAL HUGE_VAL
#endif
#ifdef PYPY_VERSION
#define CYTHON_COMPILING_IN_PYPY 1
#define CYTHON_COMPILING_IN_CPYTHON 0
#else
#define CYTHON_COMPILING_IN_PYPY 0
#define CYTHON_COMPILING_IN_CPYTHON 1
#endif
#if PY_VERSION_HEX < 0x02050000
  typedef int Py_ssize_t;
  #define PY_SSIZE_T_MAX INT_MAX
  #define PY_SSIZE_T_MIN INT_MIN
  #define PY_FORMAT_SIZE_T ""
  #define CYTHON_FORMAT_SSIZE_T ""
  #define PyInt_FromSsize_t(z) PyInt_FromLong(z)
  #define PyInt_AsSsize_t(o)   __Pyx_PyInt_AsInt(o)
  #define PyNumber_Index(o)    ((PyNumber_Check(o) && !PyFloat_Check(o)) ? PyNumber_Int(o) : \
                                (PyErr_Format(PyExc_TypeError, \
                                              "expected index value, got %.200s", Py_TYPE(o)->tp_name), \
                                 (PyObject*)0))
  #define __Pyx_PyIndex_Check(o) (PyNumber_Check(o) && !PyFloat_Check(o) && \
                                  !PyComplex_Check(o))
  #define PyIndex_Check __Pyx_PyIndex_Check
  #define PyErr_WarnEx(category, message, stacklevel) PyErr_Warn(category, message)
  #define __PYX_BUILD_PY_SSIZE_T "i"
#else
  #define __PYX_BUILD_PY_SSIZE_T "n"
  #define CYTHON_FORMAT_SSIZE_T "z"
  #define __Pyx_PyIndex_Check PyIndex_Check
#endif
#if PY_VERSION_HEX < 0x02060000
  #define Py_REFCNT(ob) (((PyObject*)(ob))->ob_refcnt)
  #define Py_TYPE(ob)   (((PyObject*)(ob))->ob_type)
  #define Py_SIZE(ob)   (((PyVarObject*)(ob))->ob_size)
  #define PyVarObject_HEAD_INIT(type, size) \
          PyObject_HEAD_INIT(type) size,
  #define PyType_Modified(t)
  typedef struct {
     void *buf;
     PyObject *obj;
     Py_ssize_t len;
     Py_ssize_t itemsize;
     int readonly;
     int ndim;
     char *format;
     Py_ssize_t *shape;
     Py_ssize_t *strides;
     Py_ssize_t *suboffsets;
     void *internal;
  } Py_buffer;
  #define PyBUF_SIMPLE 0
  #define PyBUF_WRITABLE 0x0001
  #define PyBUF_FORMAT 0x0004
  #define PyBUF_ND 0x0008
  #define PyBUF_STRIDES (0x0010 | PyBUF_ND)
  #define PyBUF_C_CONTIGUOUS (0x0020 | PyBUF_STRIDES)
  #define PyBUF_F_CONTIGUOUS (0x0040 | PyBUF_STRIDES)
  #define PyBUF_ANY_CONTIGUOUS (0x0080 | PyBUF_STRIDES)
  #define PyBUF_INDIRECT (0x0100 | PyBUF_STRIDES)
  #define PyBUF_RECORDS (PyBUF_STRIDES | PyBUF_FORMAT | PyBUF_WRITABLE)
  #define PyBUF_FULL (PyBUF_INDIRECT | PyBUF_FORMAT | PyBUF_WRITABLE)
  typedef int (*getbufferproc)(PyObject *, Py_buffer *, int);
  typedef void (*releasebufferproc)(PyObject *, Py_buffer *);
#endif
#if PY_MAJOR_VERSION < 3
  #define __Pyx_BUILTIN_MODULE_NAME "__builtin__"
  #define __Pyx_PyCode_New(a, k, l, s, f, code, c, n, v, fv, cell, fn, name, fline, lnos) \
          PyCode_New(a, l, s, f, code, c, n, v, fv, cell, fn, name, fline, lnos)
#else
  #define __Pyx_BUILTIN_MODULE_NAME "builtins"
  #define __Pyx_PyCode_New(a, k, l, s, f, code, c, n, v, fv, cell, fn, name, fline, lnos) \
          PyCode_New(a, k, l, s, f, code, c, n, v, fv, cell, fn, name, fline, lnos)
#endif
#if PY_MAJOR_VERSION < 3 && PY_MINOR_VERSION < 6
  #define PyUnicode_FromString(s) PyUnicode_Decode(s, strlen(s), "UTF-8", "strict")
#endif
#if PY_MAJOR_VERSION >= 3
  #define Py_TPFLAGS_CHECKTYPES 0
  #define Py_TPFLAGS_HAVE_INDEX 0
#endif
#if (PY_VERSION_HEX < 0x02060000) || (PY_MAJOR_VERSION >= 3)
  #define Py_TPFLAGS_HAVE_NEWBUFFER 0
#endif
#if PY_VERSION_HEX < 0x02060000
  #define Py_TPFLAGS_HAVE_VERSION_TAG 0
#endif
#if PY_VERSION_HEX > 0x03030000 && defined(PyUnicode_KIND)
  #define CYTHON_PEP393_ENABLED 1
  #define __Pyx_PyUnicode_READY(op)       (likely(PyUnicode_IS_READY(op)) ? \
                                              0 : _PyUnicode_Ready((PyObject *)(op)))
  #define __Pyx_PyUnicode_GET_LENGTH(u)   PyUnicode_GET_LENGTH(u)
  #define __Pyx_PyUnicode_READ_CHAR(u, i) PyUnicode_READ_CHAR(u, i)
  #define __Pyx_PyUnicode_READ(k, d, i)   PyUnicode_READ(k, d, i)
#else
  #define CYTHON_PEP393_ENABLED 0
  #define __Pyx_PyUnicode_READY(op)       (0)
  #define __Pyx_PyUnicode_GET_LENGTH(u)   PyUnicode_GET_SIZE(u)
  #define __Pyx_PyUnicode_READ_CHAR(u, i) ((Py_UCS4)(PyUnicode_AS_UNICODE(u)[i]))
  #define __Pyx_PyUnicode_READ(k, d, i)   ((k=k), (Py_UCS4)(((Py_UNICODE*)d)[i]))
#endif
#if PY_MAJOR_VERSION >= 3
  #define PyBaseString_Type            PyUnicode_Type
  #define PyStringObject               PyUnicodeObject
  #define PyString_Type                PyUnicode_Type
  #define PyString_Check               PyUnicode_Check
  #define PyString_CheckExact          PyUnicode_CheckExact
#endif
#if PY_VERSION_HEX < 0x02060000
  #define PyBytesObject                PyStringObject
  #define PyBytes_Type                 PyString_Type
  #define PyBytes_Check                PyString_Check
  #define PyBytes_CheckExact           PyString_CheckExact
  #define PyBytes_FromString           PyString_FromString
  #define PyBytes_FromStringAndSize    PyString_FromStringAndSize
  #define PyBytes_FromFormat           PyString_FromFormat
  #define PyBytes_DecodeEscape         PyString_DecodeEscape
  #define PyBytes_AsString             PyString_AsString
  #define PyBytes_AsStringAndSize      PyString_AsStringAndSize
  #define PyBytes_Size                 PyString_Size
  #define PyBytes_AS_STRING            PyString_AS_STRING
  #define PyBytes_GET_SIZE             PyString_GET_SIZE
  #define PyBytes_Repr                 PyString_Repr
  #define PyBytes_Concat               PyString_Concat
  #define PyBytes_ConcatAndDel         PyString_ConcatAndDel
#endif
#if PY_MAJOR_VERSION >= 3
  #define __Pyx_PyBaseString_Check(obj) PyUnicode_Check(obj)
  #define __Pyx_PyBaseString_CheckExact(obj) PyUnicode_CheckExact(obj)
#else
  #define __Pyx_PyBaseString_Check(obj) (PyString_CheckExact(obj) || PyUnicode_CheckExact(obj) || \
                                         PyString_Check(obj) || PyUnicode_Check(obj))
  #define __Pyx_PyBaseString_CheckExact(obj) (Py_TYPE(obj) == &PyBaseString_Type)
#endif
#if PY_VERSION_HEX < 0x02060000
  #define PySet_Check(obj)             PyObject_TypeCheck(obj, &PySet_Type)
  #define PyFrozenSet_Check(obj)       PyObject_TypeCheck(obj, &PyFrozenSet_Type)
#endif
#ifndef PySet_CheckExact
  #define PySet_CheckExact(obj)        (Py_TYPE(obj) == &PySet_Type)
#endif
#define __Pyx_TypeCheck(obj, type) PyObject_TypeCheck(obj, (PyTypeObject *)type)
#if PY_MAJOR_VERSION >= 3
  #define PyIntObject                  PyLongObject
  #define PyInt_Type                   PyLong_Type
  #define PyInt_Check(op)              PyLong_Check(op)
  #define PyInt_CheckExact(op)         PyLong_CheckExact(op)
  #define PyInt_FromString             PyLong_FromString
  #define PyInt_FromUnicode            PyLong_FromUnicode
  #define PyInt_FromLong               PyLong_FromLong
  #define PyInt_FromSize_t             PyLong_FromSize_t
  #define PyInt_FromSsize_t            PyLong_FromSsize_t
  #define PyInt_AsLong                 PyLong_AsLong
  #define PyInt_AS_LONG                PyLong_AS_LONG
  #define PyInt_AsSsize_t              PyLong_AsSsize_t
  #define PyInt_AsUnsignedLongMask     PyLong_AsUnsignedLongMask
  #define PyInt_AsUnsignedLongLongMask PyLong_AsUnsignedLongLongMask
#endif
#if PY_MAJOR_VERSION >= 3
  #define PyBoolObject                 PyLongObject
#endif
#if PY_VERSION_HEX < 0x03020000
  typedef long Py_hash_t;
  #define __Pyx_PyInt_FromHash_t PyInt_FromLong
  #define __Pyx_PyInt_AsHash_t   PyInt_AsLong
#else
  #define __Pyx_PyInt_FromHash_t PyInt_FromSsize_t
  #define __Pyx_PyInt_AsHash_t   PyInt_AsSsize_t
#endif
#if (PY_MAJOR_VERSION < 3) || (PY_VERSION_HEX >= 0x03010300)
  #define __Pyx_PySequence_GetSlice(obj, a, b) PySequence_GetSlice(obj, a, b)
  #define __Pyx_PySequence_SetSlice(obj, a, b, value) PySequence_SetSlice(obj, a, b, value)
  #define __Pyx_PySequence_DelSlice(obj, a, b) PySequence_DelSlice(obj, a, b)
#else
  #define __Pyx_PySequence_GetSlice(obj, a, b) (unlikely(!(obj)) ? \
        (PyErr_SetString(PyExc_SystemError, "null argument to internal routine"), (PyObject*)0) : \
        (likely((obj)->ob_type->tp_as_mapping) ? (PySequence_GetSlice(obj, a, b)) : \
            (PyErr_Format(PyExc_TypeError, "'%.200s' object is unsliceable", (obj)->ob_type->tp_name), (PyObject*)0)))
  #define __Pyx_PySequence_SetSlice(obj, a, b, value) (unlikely(!(obj)) ? \
        (PyErr_SetString(PyExc_SystemError, "null argument to internal routine"), -1) : \
        (likely((obj)->ob_type->tp_as_mapping) ? (PySequence_SetSlice(obj, a, b, value)) : \
            (PyErr_Format(PyExc_TypeError, "'%.200s' object doesn't support slice assignment", (obj)->ob_type->tp_name), -1)))
  #define __Pyx_PySequence_DelSlice(obj, a, b) (unlikely(!(obj)) ? \
        (PyErr_SetString(PyExc_SystemError, "null argument to internal routine"), -1) : \
        (likely((obj)->ob_type->tp_as_mapping) ? (PySequence_DelSlice(obj, a, b)) : \
            (PyErr_Format(PyExc_TypeError, "'%.200s' object doesn't support slice deletion", (obj)->ob_type->tp_name), -1)))
#endif
#if PY_MAJOR_VERSION >= 3
  #define PyMethod_New(func, self, klass) ((self) ? PyMethod_New(func, self) : PyInstanceMethod_New(func))
#endif
#if PY_VERSION_HEX < 0x02050000
  #define __Pyx_GetAttrString(o,n)   PyObject_GetAttrString((o),((char *)(n)))
  #define __Pyx_SetAttrString(o,n,a) PyObject_SetAttrString((o),((char *)(n)),(a))
  #define __Pyx_DelAttrString(o,n)   PyObject_DelAttrString((o),((char *)(n)))
#else
  #define __Pyx_GetAttrString(o,n)   PyObject_GetAttrString((o),(n))
  #define __Pyx_SetAttrString(o,n,a) PyObject_SetAttrString((o),(n),(a))
  #define __Pyx_DelAttrString(o,n)   PyObject_DelAttrString((o),(n))
#endif
#if PY_VERSION_HEX < 0x02050000
  #define __Pyx_NAMESTR(n) ((char *)(n))
  #define __Pyx_DOCSTR(n)  ((char *)(n))
#else
  #define __Pyx_NAMESTR(n) (n)
  #define __Pyx_DOCSTR(n)  (n)
#endif
#ifndef CYTHON_INLINE
  #if defined(__GNUC__)
    #define CYTHON_INLINE __inline__
  #elif defined(_MSC_VER)
    #define CYTHON_INLINE __inline
  #elif defined (__STDC_VERSION__) && __STDC_VERSION__ >= 199901L
    #define CYTHON_INLINE inline
  #else
    #define CYTHON_INLINE
  #endif
#endif
#ifndef CYTHON_RESTRICT
  #if defined(__GNUC__)
    #define CYTHON_RESTRICT __restrict__
  #elif defined(_MSC_VER) && _MSC_VER >= 1400
    #define CYTHON_RESTRICT __restrict
  #elif defined (__STDC_VERSION__) && __STDC_VERSION__ >= 199901L
    #define CYTHON_RESTRICT restrict
  #else
    #define CYTHON_RESTRICT
  #endif
#endif
#ifdef NAN
#define __PYX_NAN() ((float) NAN)
#else
static CYTHON_INLINE float __PYX_NAN() {
  /* Initialize NaN. The sign is irrelevant, an exponent with all bits 1 and
   a nonzero mantissa means NaN. If the first bit in the mantissa is 1, it is
   a quiet NaN. */
  float value;
  memset(&value, 0xFF, sizeof(value));
  return value;
}
#endif


#if PY_MAJOR_VERSION >= 3
  #define __Pyx_PyNumber_Divide(x,y)         PyNumber_TrueDivide(x,y)
  #define __Pyx_PyNumber_InPlaceDivide(x,y)  PyNumber_InPlaceTrueDivide(x,y)
#else
  #define __Pyx_PyNumber_Divide(x,y)         PyNumber_Divide(x,y)
  #define __Pyx_PyNumber_InPlaceDivide(x,y)  PyNumber_InPlaceDivide(x,y)
#endif

#ifndef __PYX_EXTERN_C
  #ifdef __cplusplus
    #define __PYX_EXTERN_C extern "C"
  #else
    #define __PYX_EXTERN_C extern
  #endif
#endif

#if defined(WIN32) || defined(MS_WINDOWS)
#define _USE_MATH_DEFINES
#endif
#include <math.h>
#define __PYX_HAVE__kiva__quartz__CTFont
#define __PYX_HAVE_API__kiva__quartz__CTFont
#include "CoreFoundation/CoreFoundation.h"
#include "ApplicationServices/ApplicationServices.h"
#ifdef _OPENMP
#include <omp.h>
#endif /* _OPENMP */

#ifdef PYREX_WITHOUT_ASSERTIONS
#define CYTHON_WITHOUT_ASSERTIONS
#endif

#ifndef CYTHON_UNUSED
# if defined(__GNUC__)
#   if !(defined(__cplusplus)) || (__GNUC__ > 3 || (__GNUC__ == 3 && __GNUC_MINOR__ >= 4))
#     define CYTHON_UNUSED __attribute__ ((__unused__))
#   else
#     define CYTHON_UNUSED
#   endif
# elif defined(__ICC) || (defined(__INTEL_COMPILER) && !defined(_MSC_VER))
#   define CYTHON_UNUSED __attribute__ ((__unused__))
# else
#   define CYTHON_UNUSED
# endif
#endif
typedef struct {PyObject **p; char *s; const Py_ssize_t n; const char* encoding;
                const char is_unicode; const char is_str; const char intern; } __Pyx_StringTabEntry; /*proto*/

#define __PYX_DEFAULT_STRING_ENCODING_IS_ASCII 0
#define __PYX_DEFAULT_STRING_ENCODING_IS_DEFAULT 0
#define __PYX_DEFAULT_STRING_ENCODING ""
#define __Pyx_PyObject_FromString __Pyx_PyBytes_FromString
#define __Pyx_PyObject_FromStringAndSize __Pyx_PyBytes_FromStringAndSize
static CYTHON_INLINE char* __Pyx_PyObject_AsString(PyObject*);
static CYTHON_INLINE char* __Pyx_PyObject_AsStringAndSize(PyObject*, Py_ssize_t* length);
#define __Pyx_PyBytes_FromString        PyBytes_FromString
#define __Pyx_PyBytes_FromStringAndSize PyBytes_FromStringAndSize
static CYTHON_INLINE PyObject* __Pyx_PyUnicode_FromString(char*);
#if PY_MAJOR_VERSION < 3
    #define __Pyx_PyStr_FromString        __Pyx_PyBytes_FromString
    #define __Pyx_PyStr_FromStringAndSize __Pyx_PyBytes_FromStringAndSize
#else
    #define __Pyx_PyStr_FromString        __Pyx_PyUnicode_FromString
    #define __Pyx_PyStr_FromStringAndSize __Pyx_PyUnicode_FromStringAndSize
#endif
#define __Pyx_PyObject_AsUString(s)    ((unsigned char*) __Pyx_PyObject_AsString(s))
#define __Pyx_PyObject_FromUString(s)  __Pyx_PyObject_FromString((char*)s)
#define __Pyx_PyBytes_FromUString(s)   __Pyx_PyBytes_FromString((char*)s)
#define __Pyx_PyStr_FromUString(s)     __Pyx_PyStr_FromString((char*)s)
#define __Pyx_PyUnicode_FromUString(s) __Pyx_PyUnicode_FromString((char*)s)
#if PY_MAJOR_VERSION < 3
static CYTHON_INLINE size_t __Pyx_Py_UNICODE_strlen(const Py_UNICODE *u)
{
    const Py_UNICODE *u_end = u;
    while (*u_end++) ;
    return u_end - u - 1;
}
#else
#define __Pyx_Py_UNICODE_strlen Py_UNICODE_strlen
#endif
#define __Pyx_PyUnicode_FromUnicode(u)       PyUnicode_FromUnicode(u, __Pyx_Py_UNICODE_strlen(u))
#define __Pyx_PyUnicode_FromUnicodeAndLength PyUnicode_FromUnicode
#define __Pyx_PyUnicode_AsUnicode            PyUnicode_AsUnicode
#define __Pyx_Owned_Py_None(b) (Py_INCREF(Py_None), Py_None)
#define __Pyx_PyBool_FromLong(b) ((b) ? (Py_INCREF(Py_True), Py_True) : (Py_INCREF(Py_False), Py_False))
static CYTHON_INLINE int __Pyx_PyObject_IsTrue(PyObject*);
static CYTHON_INLINE PyObject* __Pyx_PyNumber_Int(PyObject* x);
static CYTHON_INLINE Py_ssize_t __Pyx_PyIndex_AsSsize_t(PyObject*);
static CYTHON_INLINE PyObject * __Pyx_PyInt_FromSize_t(size_t);
static CYTHON_INLINE size_t __Pyx_PyInt_AsSize_t(PyObject*);
#if CYTHON_COMPILING_IN_CPYTHON
#define __pyx_PyFloat_AsDouble(x) (PyFloat_CheckExact(x) ? PyFloat_AS_DOUBLE(x) : PyFloat_AsDouble(x))
#else
#define __pyx_PyFloat_AsDouble(x) PyFloat_AsDouble(x)
#endif
#define __pyx_PyFloat_AsFloat(x) ((float) __pyx_PyFloat_AsDouble(x))
#if PY_MAJOR_VERSION < 3 && __PYX_DEFAULT_STRING_ENCODING_IS_ASCII
static int __Pyx_sys_getdefaultencoding_not_ascii;
static int __Pyx_init_sys_getdefaultencoding_params() {
    PyObject* sys = NULL;
    PyObject* default_encoding = NULL;
    PyObject* ascii_chars_u = NULL;
    PyObject* ascii_chars_b = NULL;
    sys = PyImport_ImportModule("sys");
    if (sys == NULL) goto bad;
    default_encoding = PyObject_CallMethod(sys, (char*) (const char*) "getdefaultencoding", NULL);
    if (default_encoding == NULL) goto bad;
    if (strcmp(PyBytes_AsString(default_encoding), "ascii") == 0) {
        __Pyx_sys_getdefaultencoding_not_ascii = 0;
    } else {
        const char* default_encoding_c = PyBytes_AS_STRING(default_encoding);
        char ascii_chars[128];
        int c;
        for (c = 0; c < 128; c++) {
            ascii_chars[c] = c;
        }
        __Pyx_sys_getdefaultencoding_not_ascii = 1;
        ascii_chars_u = PyUnicode_DecodeASCII(ascii_chars, 128, NULL);
        if (ascii_chars_u == NULL) goto bad;
        ascii_chars_b = PyUnicode_AsEncodedString(ascii_chars_u, default_encoding_c, NULL);
        if (ascii_chars_b == NULL || strncmp(ascii_chars, PyBytes_AS_STRING(ascii_chars_b), 128) != 0) {
            PyErr_Format(
                PyExc_ValueError,
                "This module compiled with c_string_encoding=ascii, but default encoding '%s' is not a superset of ascii.",
                default_encoding_c);
            goto bad;
        }
    }
    Py_XDECREF(sys);
    Py_XDECREF(default_encoding);
    Py_XDECREF(ascii_chars_u);
    Py_XDECREF(ascii_chars_b);
    return 0;
bad:
    Py_XDECREF(sys);
    Py_XDECREF(default_encoding);
    Py_XDECREF(ascii_chars_u);
    Py_XDECREF(ascii_chars_b);
    return -1;
}
#endif
#if __PYX_DEFAULT_STRING_ENCODING_IS_DEFAULT && PY_MAJOR_VERSION >= 3
#define __Pyx_PyUnicode_FromStringAndSize(c_str, size) PyUnicode_DecodeUTF8(c_str, size, NULL)
#else
#define __Pyx_PyUnicode_FromStringAndSize(c_str, size) PyUnicode_Decode(c_str, size, __PYX_DEFAULT_STRING_ENCODING, NULL)
#if __PYX_DEFAULT_STRING_ENCODING_IS_DEFAULT
static char* __PYX_DEFAULT_STRING_ENCODING;
static int __Pyx_init_sys_getdefaultencoding_params() {
    PyObject* sys = NULL;
    PyObject* default_encoding = NULL;
    char* default_encoding_c;
    sys = PyImport_ImportModule("sys");
    if (sys == NULL) goto bad;
    default_encoding = PyObject_CallMethod(sys, (char*) (const char*) "getdefaultencoding", NULL);
    if (default_encoding == NULL) goto bad;
    default_encoding_c = PyBytes_AS_STRING(default_encoding);
    __PYX_DEFAULT_STRING_ENCODING = (char*) malloc(strlen(default_encoding_c));
    strcpy(__PYX_DEFAULT_STRING_ENCODING, default_encoding_c);
    Py_DECREF(sys);
    Py_DECREF(default_encoding);
    return 0;
bad:
    Py_XDECREF(sys);
    Py_XDECREF(default_encoding);
    return -1;
}
#endif
#endif


#ifdef __GNUC__
  /* Test for GCC > 2.95 */
  #if __GNUC__ > 2 || (__GNUC__ == 2 && (__GNUC_MINOR__ > 95))
    #define likely(x)   __builtin_expect(!!(x), 1)
    #define unlikely(x) __builtin_expect(!!(x), 0)
  #else /* __GNUC__ > 2 ... */
    #define likely(x)   (x)
    #define unlikely(x) (x)
  #endif /* __GNUC__ > 2 ... */
#else /* __GNUC__ */
  #define likely(x)   (x)
  #define unlikely(x) (x)
#endif /* __GNUC__ */

static PyObject *__pyx_m;
static PyObject *__pyx_d;
static PyObject *__pyx_b;
static PyObject *__pyx_empty_tuple;
static PyObject *__pyx_empty_bytes;
static int __pyx_lineno;
static int __pyx_clineno = 0;
static const char * __pyx_cfilenm= __FILE__;
static const char *__pyx_filename;


static const char *__pyx_f[] = {
  "CTFont.pyx",
};

/*--- Type declarations ---*/
struct __pyx_obj_4kiva_6quartz_6CTFont_CTFont;
struct __pyx_obj_4kiva_6quartz_6CTFont_FontLookup;
struct __pyx_obj_4kiva_6quartz_6CTFont_CTFontStyle;

/* "kiva/quartz/CTFont.pyx":51
 *         return cf_font_descriptors
 * 
 * cdef class CTFont:             # <<<<<<<<<<<<<<
 *     cdef CTFontRef ct_font
 *     def __cinit__(self, *args, **kwargs):
 */
struct __pyx_obj_4kiva_6quartz_6CTFont_CTFont {
  PyObject_HEAD
  struct __pyx_vtabstruct_4kiva_6quartz_6CTFont_CTFont *__pyx_vtab;
  CTFontRef ct_font;
};


/* "kiva/quartz/CTFont.pyx":154
 * 
 * 
 * cdef class FontLookup:             # <<<<<<<<<<<<<<
 *     cdef readonly object cache
 *     cdef public object default_font
 */
struct __pyx_obj_4kiva_6quartz_6CTFont_FontLookup {
  PyObject_HEAD
  PyObject *cache;
  PyObject *default_font;
};


/* "kiva/quartz/CTFont.pyx":67
 * 
 * 
 * cdef class CTFontStyle:             # <<<<<<<<<<<<<<
 *     cdef CTFontDescriptorRef ct_font_descriptor
 *     cdef CFDictionaryRef attribute_dictionary
 */
struct __pyx_obj_4kiva_6quartz_6CTFont_CTFontStyle {
  PyObject_HEAD
  struct __pyx_vtabstruct_4kiva_6quartz_6CTFont_CTFontStyle *__pyx_vtab;
  CTFontDescriptorRef ct_font_descriptor;
  CFDictionaryRef attribute_dictionary;
  PyObject *family_name;
  PyObject *style;
};



/* "kiva/quartz/CTFont.pyx":51
 *         return cf_font_descriptors
 * 
 * cdef class CTFont:             # <<<<<<<<<<<<<<
 *     cdef CTFontRef ct_font
 *     def __cinit__(self, *args, **kwargs):
 */

struct __pyx_vtabstruct_4kiva_6quartz_6CTFont_CTFont {
  size_t (*get_pointer)(struct __pyx_obj_4kiva_6quartz_6CTFont_CTFont *, int __pyx_skip_dispatch);
  PyObject *(*set_pointer)(struct __pyx_obj_4kiva_6quartz_6CTFont_CTFont *, CTFontRef);
};
static struct __pyx_vtabstruct_4kiva_6quartz_6CTFont_CTFont *__pyx_vtabptr_4kiva_6quartz_6CTFont_CTFont;


/* "kiva/quartz/CTFont.pyx":67
 * 
 * 
 * cdef class CTFontStyle:             # <<<<<<<<<<<<<<
 *     cdef CTFontDescriptorRef ct_font_descriptor
 *     cdef CFDictionaryRef attribute_dictionary
 */

struct __pyx_vtabstruct_4kiva_6quartz_6CTFont_CTFontStyle {
  CFDictionaryRef (*_build_attribute_dictionary)(struct __pyx_obj_4kiva_6quartz_6CTFont_CTFontStyle *, PyObject *, PyObject *);
};
static struct __pyx_vtabstruct_4kiva_6quartz_6CTFont_CTFontStyle *__pyx_vtabptr_4kiva_6quartz_6CTFont_CTFontStyle;
#ifndef CYTHON_REFNANNY
  #define CYTHON_REFNANNY 0
#endif
#if CYTHON_REFNANNY
  typedef struct {
    void (*INCREF)(void*, PyObject*, int);
    void (*DECREF)(void*, PyObject*, int);
    void (*GOTREF)(void*, PyObject*, int);
    void (*GIVEREF)(void*, PyObject*, int);
    void* (*SetupContext)(const char*, int, const char*);
    void (*FinishContext)(void**);
  } __Pyx_RefNannyAPIStruct;
  static __Pyx_RefNannyAPIStruct *__Pyx_RefNanny = NULL;
  static __Pyx_RefNannyAPIStruct *__Pyx_RefNannyImportAPI(const char *modname); /*proto*/
  #define __Pyx_RefNannyDeclarations void *__pyx_refnanny = NULL;
#ifdef WITH_THREAD
  #define __Pyx_RefNannySetupContext(name, acquire_gil) \
          if (acquire_gil) { \
              PyGILState_STATE __pyx_gilstate_save = PyGILState_Ensure(); \
              __pyx_refnanny = __Pyx_RefNanny->SetupContext((name), __LINE__, __FILE__); \
              PyGILState_Release(__pyx_gilstate_save); \
          } else { \
              __pyx_refnanny = __Pyx_RefNanny->SetupContext((name), __LINE__, __FILE__); \
          }
#else
  #define __Pyx_RefNannySetupContext(name, acquire_gil) \
          __pyx_refnanny = __Pyx_RefNanny->SetupContext((name), __LINE__, __FILE__)
#endif
  #define __Pyx_RefNannyFinishContext() \
          __Pyx_RefNanny->FinishContext(&__pyx_refnanny)
  #define __Pyx_INCREF(r)  __Pyx_RefNanny->INCREF(__pyx_refnanny, (PyObject *)(r), __LINE__)
  #define __Pyx_DECREF(r)  __Pyx_RefNanny->DECREF(__pyx_refnanny, (PyObject *)(r), __LINE__)
  #define __Pyx_GOTREF(r)  __Pyx_RefNanny->GOTREF(__pyx_refnanny, (PyObject *)(r), __LINE__)
  #define __Pyx_GIVEREF(r) __Pyx_RefNanny->GIVEREF(__pyx_refnanny, (PyObject *)(r), __LINE__)
  #define __Pyx_XINCREF(r)  do { if((r) != NULL) {__Pyx_INCREF(r); }} while(0)
  #define __Pyx_XDECREF(r)  do { if((r) != NULL) {__Pyx_DECREF(r); }} while(0)
  #define __Pyx_XGOTREF(r)  do { if((r) != NULL) {__Pyx_GOTREF(r); }} while(0)
  #define __Pyx_XGIVEREF(r) do { if((r) != NULL) {__Pyx_GIVEREF(r);}} while(0)
#else
  #define __Pyx_RefNannyDeclarations
  #define __Pyx_RefNannySetupContext(name, acquire_gil)
  #define __Pyx_RefNannyFinishContext()
  #define __Pyx_INCREF(r) Py_INCREF(r)
  #define __Pyx_DECREF(r) Py_DECREF(r)
  #define __Pyx_GOTREF(r)
  #define __Pyx_GIVEREF(r)
  #define __Pyx_XINCREF(r) Py_XINCREF(r)
  #define __Pyx_XDECREF(r) Py_XDECREF(r)
  #define __Pyx_XGOTREF(r)
  #define __Pyx_XGIVEREF(r)
#endif /* CYTHON_REFNANNY */
#define __Pyx_XDECREF_SET(r, v) do {                            \
        PyObject *tmp = (PyObject *) r;                         \
        r = v; __Pyx_XDECREF(tmp);                              \
    } while (0)
#define __Pyx_DECREF_SET(r, v) do {                             \
        PyObject *tmp = (PyObject *) r;                         \
        r = v; __Pyx_DECREF(tmp);                               \
    } while (0)
#define __Pyx_CLEAR(r)    do { PyObject* tmp = ((PyObject*)(r)); r = NULL; __Pyx_DECREF(tmp);} while(0)
#define __Pyx_XCLEAR(r)   do { if((r) != NULL) {PyObject* tmp = ((PyObject*)(r)); r = NULL; __Pyx_DECREF(tmp);}} while(0)

#if CYTHON_COMPILING_IN_CPYTHON
static CYTHON_INLINE PyObject* __Pyx_PyObject_GetAttrStr(PyObject* obj, PyObject* attr_name) {
    PyTypeObject* tp = Py_TYPE(obj);
    if (likely(tp->tp_getattro))
        return tp->tp_getattro(obj, attr_name);
#if PY_MAJOR_VERSION < 3
    if (likely(tp->tp_getattr))
        return tp->tp_getattr(obj, PyString_AS_STRING(attr_name));
#endif
    return PyObject_GetAttr(obj, attr_name);
}
#else
#define __Pyx_PyObject_GetAttrStr(o,n) PyObject_GetAttr(o,n)
#endif

static PyObject *__Pyx_GetBuiltinName(PyObject *name); /*proto*/

static CYTHON_INLINE void __Pyx_ErrRestore(PyObject *type, PyObject *value, PyObject *tb); /*proto*/
static CYTHON_INLINE void __Pyx_ErrFetch(PyObject **type, PyObject **value, PyObject **tb); /*proto*/

static void __Pyx_Raise(PyObject *type, PyObject *value, PyObject *tb, PyObject *cause); /*proto*/

static void __Pyx_WriteUnraisable(const char *name, int clineno,
                                  int lineno, const char *filename); /*proto*/

static CYTHON_INLINE int __Pyx_CheckKeywordStrings(PyObject *kwdict, const char* function_name, int kw_allowed); /*proto*/

static void __Pyx_RaiseDoubleKeywordsError(const char* func_name, PyObject* kw_name); /*proto*/

static int __Pyx_ParseOptionalKeywords(PyObject *kwds, PyObject **argnames[], \
    PyObject *kwds2, PyObject *values[], Py_ssize_t num_pos_args, \
    const char* function_name); /*proto*/

static void __Pyx_RaiseArgtupleInvalid(const char* func_name, int exact,
    Py_ssize_t num_min, Py_ssize_t num_max, Py_ssize_t num_found); /*proto*/

#if CYTHON_COMPILING_IN_CPYTHON
static CYTHON_INLINE int __Pyx_PyList_Append(PyObject* list, PyObject* x) {
    PyListObject* L = (PyListObject*) list;
    Py_ssize_t len = Py_SIZE(list);
    if (likely(L->allocated > len) & likely(len > (L->allocated >> 1))) {
        Py_INCREF(x);
        PyList_SET_ITEM(list, len, x);
        Py_SIZE(list) = len+1;
        return 0;
    }
    return PyList_Append(list, x);
}
#else
#define __Pyx_PyList_Append(L,x) PyList_Append(L,x)
#endif

#if PY_VERSION_HEX < 0x02050000
#ifndef PyAnySet_CheckExact
#define PyAnySet_CheckExact(ob) \
    ((ob)->ob_type == &PySet_Type || \
     (ob)->ob_type == &PyFrozenSet_Type)
#define PySet_New(iterable) \
    PyObject_CallFunctionObjArgs((PyObject *)&PySet_Type, (iterable), NULL)
#define Pyx_PyFrozenSet_New(iterable) \
    PyObject_CallFunctionObjArgs((PyObject *)&PyFrozenSet_Type, (iterable), NULL)
#define PySet_Size(anyset) \
    PyObject_Size((anyset))
#define PySet_Contains(anyset, key) \
    PySequence_Contains((anyset), (key))
#define PySet_Pop(set) \
    PyObject_CallMethod(set, (char *)"pop", NULL)
static CYTHON_INLINE int PySet_Clear(PyObject *set) {
    PyObject *ret = PyObject_CallMethod(set, (char *)"clear", NULL);
    if (!ret) return -1;
    Py_DECREF(ret); return 0;
}
static CYTHON_INLINE int PySet_Discard(PyObject *set, PyObject *key) {
    PyObject *ret = PyObject_CallMethod(set, (char *)"discard", (char *)"O", key);
    if (!ret) return -1;
    Py_DECREF(ret); return 0;
}
static CYTHON_INLINE int PySet_Add(PyObject *set, PyObject *key) {
    PyObject *ret = PyObject_CallMethod(set, (char *)"add", (char *)"O", key);
    if (!ret) return -1;
    Py_DECREF(ret); return 0;
}
#endif /* PyAnySet_CheckExact (<= Py2.4) */
#endif /* < Py2.5  */

static int __Pyx_SetVtable(PyObject *dict, void *vtable); /*proto*/

static CYTHON_INLINE PyObject *__Pyx_GetModuleGlobalName(PyObject *name); /*proto*/

#if CYTHON_COMPILING_IN_CPYTHON
#define __Pyx_PyObject_DelAttrStr(o,n) __Pyx_PyObject_SetAttrStr(o,n,NULL)
static CYTHON_INLINE int __Pyx_PyObject_SetAttrStr(PyObject* obj, PyObject* attr_name, PyObject* value) {
    PyTypeObject* tp = Py_TYPE(obj);
    if (likely(tp->tp_setattro))
        return tp->tp_setattro(obj, attr_name, value);
#if PY_MAJOR_VERSION < 3
    if (likely(tp->tp_setattr))
        return tp->tp_setattr(obj, PyString_AS_STRING(attr_name), value);
#endif
    return PyObject_SetAttr(obj, attr_name, value);
}
#else
#define __Pyx_PyObject_DelAttrStr(o,n)   PyObject_DelAttr(o,n)
#define __Pyx_PyObject_SetAttrStr(o,n,v) PyObject_SetAttr(o,n,v)
#endif

static int __Pyx_Print(PyObject*, PyObject *, int); /*proto*/
#if CYTHON_COMPILING_IN_PYPY || PY_MAJOR_VERSION >= 3
static PyObject* __pyx_print = 0;
static PyObject* __pyx_print_kwargs = 0;
#endif

static CYTHON_INLINE unsigned char __Pyx_PyInt_AsUnsignedChar(PyObject *);

static CYTHON_INLINE unsigned short __Pyx_PyInt_AsUnsignedShort(PyObject *);

static CYTHON_INLINE unsigned int __Pyx_PyInt_AsUnsignedInt(PyObject *);

static CYTHON_INLINE char __Pyx_PyInt_AsChar(PyObject *);

static CYTHON_INLINE short __Pyx_PyInt_AsShort(PyObject *);

static CYTHON_INLINE int __Pyx_PyInt_AsInt(PyObject *);

static CYTHON_INLINE signed char __Pyx_PyInt_AsSignedChar(PyObject *);

static CYTHON_INLINE signed short __Pyx_PyInt_AsSignedShort(PyObject *);

static CYTHON_INLINE signed int __Pyx_PyInt_AsSignedInt(PyObject *);

static CYTHON_INLINE int __Pyx_PyInt_AsLongDouble(PyObject *);

static CYTHON_INLINE unsigned long __Pyx_PyInt_AsUnsignedLong(PyObject *);

static CYTHON_INLINE unsigned PY_LONG_LONG __Pyx_PyInt_AsUnsignedLongLong(PyObject *);

static CYTHON_INLINE long __Pyx_PyInt_AsLong(PyObject *);

static CYTHON_INLINE PY_LONG_LONG __Pyx_PyInt_AsLongLong(PyObject *);

static CYTHON_INLINE signed long __Pyx_PyInt_AsSignedLong(PyObject *);

static CYTHON_INLINE signed PY_LONG_LONG __Pyx_PyInt_AsSignedLongLong(PyObject *);

static int __Pyx_check_binary_version(void);

typedef struct {
    int code_line;
    PyCodeObject* code_object;
} __Pyx_CodeObjectCacheEntry;
struct __Pyx_CodeObjectCache {
    int count;
    int max_count;
    __Pyx_CodeObjectCacheEntry* entries;
};
static struct __Pyx_CodeObjectCache __pyx_code_cache = {0,0,NULL};
static int __pyx_bisect_code_objects(__Pyx_CodeObjectCacheEntry* entries, int count, int code_line);
static PyCodeObject *__pyx_find_code_object(int code_line);
static void __pyx_insert_code_object(int code_line, PyCodeObject* code_object);

static void __Pyx_AddTraceback(const char *funcname, int c_line,
                               int py_line, const char *filename); /*proto*/

static int __Pyx_InitStrings(__Pyx_StringTabEntry *t); /*proto*/


/* Module declarations from 'kiva.quartz.CTFont' */
static PyTypeObject *__pyx_ptype_4kiva_6quartz_6CTFont_CTFont = 0;
static PyTypeObject *__pyx_ptype_4kiva_6quartz_6CTFont_FontLookup = 0;
static PyTypeObject *__pyx_ptype_4kiva_6quartz_6CTFont_CTFontStyle = 0;
static PyObject *__pyx_f_4kiva_6quartz_6CTFont__cf_string_to_pystring(CFStringRef); /*proto*/
static CFArrayRef __pyx_f_4kiva_6quartz_6CTFont__get_system_fonts(void); /*proto*/
#define __Pyx_MODULE_NAME "kiva.quartz.CTFont"
int __pyx_module_is_main_kiva__quartz__CTFont = 0;

/* Implementation of 'kiva.quartz.CTFont' */
static PyObject *__pyx_builtin_RuntimeError;
static PyObject *__pyx_builtin_NotImplementedError;
static int __pyx_pf_4kiva_6quartz_6CTFont_6CTFont___cinit__(struct __pyx_obj_4kiva_6quartz_6CTFont_CTFont *__pyx_v_self, CYTHON_UNUSED PyObject *__pyx_v_args, CYTHON_UNUSED PyObject *__pyx_v_kwargs); /* proto */
static void __pyx_pf_4kiva_6quartz_6CTFont_6CTFont_2__dealloc__(struct __pyx_obj_4kiva_6quartz_6CTFont_CTFont *__pyx_v_self); /* proto */
static PyObject *__pyx_pf_4kiva_6quartz_6CTFont_6CTFont_4get_pointer(struct __pyx_obj_4kiva_6quartz_6CTFont_CTFont *__pyx_v_self); /* proto */
static int __pyx_pf_4kiva_6quartz_6CTFont_11CTFontStyle___cinit__(struct __pyx_obj_4kiva_6quartz_6CTFont_CTFontStyle *__pyx_v_self, CYTHON_UNUSED PyObject *__pyx_v_args, CYTHON_UNUSED PyObject *__pyx_v_kwargs); /* proto */
static void __pyx_pf_4kiva_6quartz_6CTFont_11CTFontStyle_2__dealloc__(struct __pyx_obj_4kiva_6quartz_6CTFont_CTFontStyle *__pyx_v_self); /* proto */
static int __pyx_pf_4kiva_6quartz_6CTFont_11CTFontStyle_4__init__(struct __pyx_obj_4kiva_6quartz_6CTFont_CTFontStyle *__pyx_v_self, PyObject *__pyx_v_name, PyObject *__pyx_v_style); /* proto */
static PyObject *__pyx_pf_4kiva_6quartz_6CTFont_11CTFontStyle_6get_descent_ascent(struct __pyx_obj_4kiva_6quartz_6CTFont_CTFontStyle *__pyx_v_self, CYTHON_UNUSED PyObject *__pyx_v_text); /* proto */
static PyObject *__pyx_pf_4kiva_6quartz_6CTFont_11CTFontStyle_8get_font(struct __pyx_obj_4kiva_6quartz_6CTFont_CTFontStyle *__pyx_v_self, float __pyx_v_font_size); /* proto */
static PyObject *__pyx_pf_4kiva_6quartz_6CTFont_11CTFontStyle_14postcript_name___get__(struct __pyx_obj_4kiva_6quartz_6CTFont_CTFontStyle *__pyx_v_self); /* proto */
static PyObject *__pyx_pf_4kiva_6quartz_6CTFont_11CTFontStyle_11family_name___get__(struct __pyx_obj_4kiva_6quartz_6CTFont_CTFontStyle *__pyx_v_self); /* proto */
static PyObject *__pyx_pf_4kiva_6quartz_6CTFont_11CTFontStyle_5style___get__(struct __pyx_obj_4kiva_6quartz_6CTFont_CTFontStyle *__pyx_v_self); /* proto */
static PyObject *__pyx_pf_4kiva_6quartz_6CTFont_10FontLookup_lookup(struct __pyx_obj_4kiva_6quartz_6CTFont_FontLookup *__pyx_v_self, PyObject *__pyx_v_name, PyObject *__pyx_v_style); /* proto */
static PyObject *__pyx_pf_4kiva_6quartz_6CTFont_10FontLookup_2names(CYTHON_UNUSED struct __pyx_obj_4kiva_6quartz_6CTFont_FontLookup *__pyx_v_self); /* proto */
static PyObject *__pyx_pf_4kiva_6quartz_6CTFont_10FontLookup_4styles(CYTHON_UNUSED struct __pyx_obj_4kiva_6quartz_6CTFont_FontLookup *__pyx_v_self, CYTHON_UNUSED PyObject *__pyx_v_font_name); /* proto */
static PyObject *__pyx_pf_4kiva_6quartz_6CTFont_10FontLookup_6list_fonts(struct __pyx_obj_4kiva_6quartz_6CTFont_FontLookup *__pyx_v_self); /* proto */
static PyObject *__pyx_pf_4kiva_6quartz_6CTFont_10FontLookup_5cache___get__(struct __pyx_obj_4kiva_6quartz_6CTFont_FontLookup *__pyx_v_self); /* proto */
static PyObject *__pyx_pf_4kiva_6quartz_6CTFont_10FontLookup_12default_font___get__(struct __pyx_obj_4kiva_6quartz_6CTFont_FontLookup *__pyx_v_self); /* proto */
static int __pyx_pf_4kiva_6quartz_6CTFont_10FontLookup_12default_font_2__set__(struct __pyx_obj_4kiva_6quartz_6CTFont_FontLookup *__pyx_v_self, PyObject *__pyx_v_value); /* proto */
static int __pyx_pf_4kiva_6quartz_6CTFont_10FontLookup_12default_font_4__del__(struct __pyx_obj_4kiva_6quartz_6CTFont_FontLookup *__pyx_v_self); /* proto */
static PyObject *__pyx_tp_new_4kiva_6quartz_6CTFont_CTFont(PyTypeObject *t, PyObject *a, PyObject *k); /*proto*/
static PyObject *__pyx_tp_new_4kiva_6quartz_6CTFont_FontLookup(PyTypeObject *t, PyObject *a, PyObject *k); /*proto*/
static PyObject *__pyx_tp_new_4kiva_6quartz_6CTFont_CTFontStyle(PyTypeObject *t, PyObject *a, PyObject *k); /*proto*/
static char __pyx_k_1[] = "unknown error building options dictionary for font list";
static char __pyx_k_2[] = "utf-8";
static char __pyx_k_5[] = "unknown error building descriptor dictionary for font %r";
static char __pyx_k__end[] = "end";
static char __pyx_k__file[] = "file";
static char __pyx_k__name[] = "name";
static char __pyx_k__names[] = "names";
static char __pyx_k__print[] = "print";
static char __pyx_k__strip[] = "strip";
static char __pyx_k__style[] = "style";
static char __pyx_k__title[] = "title";
static char __pyx_k__encode[] = "encode";
static char __pyx_k__styles[] = "styles";
static char __pyx_k__regular[] = "regular";
static char __pyx_k____main__[] = "__main__";
static char __pyx_k____test__[] = "__test__";
static char __pyx_k__Helvetica[] = "Helvetica";
static char __pyx_k__get_pointer[] = "get_pointer";
static char __pyx_k__RuntimeError[] = "RuntimeError";
static char __pyx_k__default_font[] = "default_font";
static char __pyx_k____pyx_vtable__[] = "__pyx_vtable__";
static char __pyx_k__default_font_info[] = "default_font_info";
static char __pyx_k__NotImplementedError[] = "NotImplementedError";
static PyObject *__pyx_kp_s_1;
static PyObject *__pyx_kp_s_2;
static PyObject *__pyx_kp_s_5;
static PyObject *__pyx_n_s__Helvetica;
static PyObject *__pyx_n_s__NotImplementedError;
static PyObject *__pyx_n_s__RuntimeError;
static PyObject *__pyx_n_s____main__;
static PyObject *__pyx_n_s____pyx_vtable__;
static PyObject *__pyx_n_s____test__;
static PyObject *__pyx_n_s__default_font;
static PyObject *__pyx_n_s__default_font_info;
static PyObject *__pyx_n_s__encode;
static PyObject *__pyx_n_s__end;
static PyObject *__pyx_n_s__file;
static PyObject *__pyx_n_s__get_pointer;
static PyObject *__pyx_n_s__name;
static PyObject *__pyx_n_s__names;
static PyObject *__pyx_n_s__print;
static PyObject *__pyx_n_s__regular;
static PyObject *__pyx_n_s__strip;
static PyObject *__pyx_n_s__style;
static PyObject *__pyx_n_s__styles;
static PyObject *__pyx_n_s__title;
static PyObject *__pyx_k_tuple_3;
static PyObject *__pyx_k_tuple_4;

/* "kiva/quartz/CTFont.pyx":11
 * 
 * 
 * cdef object _cf_string_to_pystring(CFStringRef cf_string):             # <<<<<<<<<<<<<<
 *     cdef char* c_string
 *     cdef char buf[256]
 */

static PyObject *__pyx_f_4kiva_6quartz_6CTFont__cf_string_to_pystring(CFStringRef __pyx_v_cf_string) {
  char *__pyx_v_c_string;
  char __pyx_v_buf[256];
  CYTHON_UNUSED Boolean __pyx_v_success;
  PyObject *__pyx_v_retval = NULL;
  PyObject *__pyx_r = NULL;
  __Pyx_RefNannyDeclarations
  int __pyx_t_1;
  PyObject *__pyx_t_2 = NULL;
  PyObject *__pyx_t_3 = NULL;
  int __pyx_lineno = 0;
  const char *__pyx_filename = NULL;
  int __pyx_clineno = 0;
  __Pyx_RefNannySetupContext("_cf_string_to_pystring", 0);

  /* "kiva/quartz/CTFont.pyx":14
 *     cdef char* c_string
 *     cdef char buf[256]
 *     c_string = CFStringGetCStringPtr(cf_string, kCFStringEncodingMacRoman)             # <<<<<<<<<<<<<<
 *     if c_string == NULL:
 *         success = CFStringGetCString(cf_string, buf, 256,
 */
  __pyx_v_c_string = CFStringGetCStringPtr(__pyx_v_cf_string, kCFStringEncodingMacRoman);

  /* "kiva/quartz/CTFont.pyx":15
 *     cdef char buf[256]
 *     c_string = CFStringGetCStringPtr(cf_string, kCFStringEncodingMacRoman)
 *     if c_string == NULL:             # <<<<<<<<<<<<<<
 *         success = CFStringGetCString(cf_string, buf, 256,
 *                     kCFStringEncodingMacRoman)
 */
  __pyx_t_1 = ((__pyx_v_c_string == NULL) != 0);
  if (__pyx_t_1) {

    /* "kiva/quartz/CTFont.pyx":17
 *     if c_string == NULL:
 *         success = CFStringGetCString(cf_string, buf, 256,
 *                     kCFStringEncodingMacRoman)             # <<<<<<<<<<<<<<
 *         retval = str(buf)
 *     else:
 */
    __pyx_v_success = CFStringGetCString(__pyx_v_cf_string, __pyx_v_buf, 256, kCFStringEncodingMacRoman);

    /* "kiva/quartz/CTFont.pyx":18
 *         success = CFStringGetCString(cf_string, buf, 256,
 *                     kCFStringEncodingMacRoman)
 *         retval = str(buf)             # <<<<<<<<<<<<<<
 *     else:
 *         retval = str(c_string)
 */
    __pyx_t_2 = __Pyx_PyBytes_FromString(__pyx_v_buf); if (unlikely(!__pyx_t_2)) {__pyx_filename = __pyx_f[0]; __pyx_lineno = 18; __pyx_clineno = __LINE__; goto __pyx_L1_error;}
    __Pyx_GOTREF(((PyObject *)__pyx_t_2));
    __pyx_t_3 = PyTuple_New(1); if (unlikely(!__pyx_t_3)) {__pyx_filename = __pyx_f[0]; __pyx_lineno = 18; __pyx_clineno = __LINE__; goto __pyx_L1_error;}
    __Pyx_GOTREF(__pyx_t_3);
    PyTuple_SET_ITEM(__pyx_t_3, 0, ((PyObject *)__pyx_t_2));
    __Pyx_GIVEREF(((PyObject *)__pyx_t_2));
    __pyx_t_2 = 0;
    __pyx_t_2 = PyObject_Call(((PyObject *)((PyObject*)(&PyString_Type))), ((PyObject *)__pyx_t_3), NULL); if (unlikely(!__pyx_t_2)) {__pyx_filename = __pyx_f[0]; __pyx_lineno = 18; __pyx_clineno = __LINE__; goto __pyx_L1_error;}
    __Pyx_GOTREF(__pyx_t_2);
    __Pyx_DECREF(((PyObject *)__pyx_t_3)); __pyx_t_3 = 0;
    __pyx_v_retval = __pyx_t_2;
    __pyx_t_2 = 0;
    goto __pyx_L3;
  }
  /*else*/ {

    /* "kiva/quartz/CTFont.pyx":20
 *         retval = str(buf)
 *     else:
 *         retval = str(c_string)             # <<<<<<<<<<<<<<
 *     return retval
 * 
 */
    __pyx_t_2 = __Pyx_PyBytes_FromString(__pyx_v_c_string); if (unlikely(!__pyx_t_2)) {__pyx_filename = __pyx_f[0]; __pyx_lineno = 20; __pyx_clineno = __LINE__; goto __pyx_L1_error;}
    __Pyx_GOTREF(((PyObject *)__pyx_t_2));
    __pyx_t_3 = PyTuple_New(1); if (unlikely(!__pyx_t_3)) {__pyx_filename = __pyx_f[0]; __pyx_lineno = 20; __pyx_clineno = __LINE__; goto __pyx_L1_error;}
    __Pyx_GOTREF(__pyx_t_3);
    PyTuple_SET_ITEM(__pyx_t_3, 0, ((PyObject *)__pyx_t_2));
    __Pyx_GIVEREF(((PyObject *)__pyx_t_2));
    __pyx_t_2 = 0;
    __pyx_t_2 = PyObject_Call(((PyObject *)((PyObject*)(&PyString_Type))), ((PyObject *)__pyx_t_3), NULL); if (unlikely(!__pyx_t_2)) {__pyx_filename = __pyx_f[0]; __pyx_lineno = 20; __pyx_clineno = __LINE__; goto __pyx_L1_error;}
    __Pyx_GOTREF(__pyx_t_2);
    __Pyx_DECREF(((PyObject *)__pyx_t_3)); __pyx_t_3 = 0;
    __pyx_v_retval = __pyx_t_2;
    __pyx_t_2 = 0;
  }
  __pyx_L3:;

  /* "kiva/quartz/CTFont.pyx":21
 *     else:
 *         retval = str(c_string)
 *     return retval             # <<<<<<<<<<<<<<
 * 
 * cdef CFArrayRef _get_system_fonts():
 */
  __Pyx_XDECREF(__pyx_r);
  __Pyx_INCREF(__pyx_v_retval);
  __pyx_r = __pyx_v_retval;
  goto __pyx_L0;

  __pyx_r = Py_None; __Pyx_INCREF(Py_None);
  goto __pyx_L0;
  __pyx_L1_error:;
  __Pyx_XDECREF(__pyx_t_2);
  __Pyx_XDECREF(__pyx_t_3);
  __Pyx_AddTraceback("kiva.quartz.CTFont._cf_string_to_pystring", __pyx_clineno, __pyx_lineno, __pyx_filename);
  __pyx_r = 0;
  __pyx_L0:;
  __Pyx_XDECREF(__pyx_v_retval);
  __Pyx_XGIVEREF(__pyx_r);
  __Pyx_RefNannyFinishContext();
  return __pyx_r;
}

/* "kiva/quartz/CTFont.pyx":23
 *     return retval
 * 
 * cdef CFArrayRef _get_system_fonts():             # <<<<<<<<<<<<<<
 *         cdef CFIndex value = 1
 *         cdef CFNumberRef cf_number
 */

static CFArrayRef __pyx_f_4kiva_6quartz_6CTFont__get_system_fonts(void) {
  CFIndex __pyx_v_value;
  CFNumberRef __pyx_v_cf_number;
  CFMutableDictionaryRef __pyx_v_cf_options_dict;
  CTFontCollectionRef __pyx_v_cf_font_collection;
  CFArrayRef __pyx_v_cf_font_descriptors;
  PyObject *__pyx_v_msg = NULL;
  CFArrayRef __pyx_r;
  __Pyx_RefNannyDeclarations
  int __pyx_t_1;
  PyObject *__pyx_t_2 = NULL;
  PyObject *__pyx_t_3 = NULL;
  int __pyx_lineno = 0;
  const char *__pyx_filename = NULL;
  int __pyx_clineno = 0;
  __Pyx_RefNannySetupContext("_get_system_fonts", 0);

  /* "kiva/quartz/CTFont.pyx":24
 * 
 * cdef CFArrayRef _get_system_fonts():
 *         cdef CFIndex value = 1             # <<<<<<<<<<<<<<
 *         cdef CFNumberRef cf_number
 *         cdef CFMutableDictionaryRef cf_options_dict
 */
  __pyx_v_value = 1;

  /* "kiva/quartz/CTFont.pyx":32
 *         cf_options_dict = CFDictionaryCreateMutable(NULL, 0,
 *                             &kCFTypeDictionaryKeyCallBacks,
 *                             &kCFTypeDictionaryValueCallBacks)             # <<<<<<<<<<<<<<
 * 
 *         if cf_options_dict != NULL:
 */
  __pyx_v_cf_options_dict = CFDictionaryCreateMutable(NULL, 0, (&kCFTypeDictionaryKeyCallBacks), (&kCFTypeDictionaryValueCallBacks));

  /* "kiva/quartz/CTFont.pyx":34
 *                             &kCFTypeDictionaryValueCallBacks)
 * 
 *         if cf_options_dict != NULL:             # <<<<<<<<<<<<<<
 *             cf_number = CFNumberCreate(NULL, kCFNumberCFIndexType, &value)
 *             CFDictionaryAddValue(cf_options_dict, <void*>kCTFontCollectionRemoveDuplicatesOption,
 */
  __pyx_t_1 = ((__pyx_v_cf_options_dict != NULL) != 0);
  if (__pyx_t_1) {

    /* "kiva/quartz/CTFont.pyx":35
 * 
 *         if cf_options_dict != NULL:
 *             cf_number = CFNumberCreate(NULL, kCFNumberCFIndexType, &value)             # <<<<<<<<<<<<<<
 *             CFDictionaryAddValue(cf_options_dict, <void*>kCTFontCollectionRemoveDuplicatesOption,
 *                 <void*>cf_number)
 */
    __pyx_v_cf_number = CFNumberCreate(NULL, kCFNumberCFIndexType, (&__pyx_v_value));

    /* "kiva/quartz/CTFont.pyx":37
 *             cf_number = CFNumberCreate(NULL, kCFNumberCFIndexType, &value)
 *             CFDictionaryAddValue(cf_options_dict, <void*>kCTFontCollectionRemoveDuplicatesOption,
 *                 <void*>cf_number)             # <<<<<<<<<<<<<<
 *             CFRelease(cf_number)
 *         else:
 */
    CFDictionaryAddValue(__pyx_v_cf_options_dict, ((void *)kCTFontCollectionRemoveDuplicatesOption), ((void *)__pyx_v_cf_number));

    /* "kiva/quartz/CTFont.pyx":38
 *             CFDictionaryAddValue(cf_options_dict, <void*>kCTFontCollectionRemoveDuplicatesOption,
 *                 <void*>cf_number)
 *             CFRelease(cf_number)             # <<<<<<<<<<<<<<
 *         else:
 *             msg = "unknown error building options dictionary for font list"
 */
    CFRelease(__pyx_v_cf_number);
    goto __pyx_L3;
  }
  /*else*/ {

    /* "kiva/quartz/CTFont.pyx":40
 *             CFRelease(cf_number)
 *         else:
 *             msg = "unknown error building options dictionary for font list"             # <<<<<<<<<<<<<<
 *             raise RuntimeError(msg)
 * 
 */
    __Pyx_INCREF(((PyObject *)__pyx_kp_s_1));
    __pyx_v_msg = ((PyObject *)__pyx_kp_s_1);

    /* "kiva/quartz/CTFont.pyx":41
 *         else:
 *             msg = "unknown error building options dictionary for font list"
 *             raise RuntimeError(msg)             # <<<<<<<<<<<<<<
 * 
 *         cf_font_collection = CTFontCollectionCreateFromAvailableFonts(cf_options_dict)
 */
    __pyx_t_2 = PyTuple_New(1); if (unlikely(!__pyx_t_2)) {__pyx_filename = __pyx_f[0]; __pyx_lineno = 41; __pyx_clineno = __LINE__; goto __pyx_L1_error;}
    __Pyx_GOTREF(__pyx_t_2);
    __Pyx_INCREF(__pyx_v_msg);
    PyTuple_SET_ITEM(__pyx_t_2, 0, __pyx_v_msg);
    __Pyx_GIVEREF(__pyx_v_msg);
    __pyx_t_3 = PyObject_Call(__pyx_builtin_RuntimeError, ((PyObject *)__pyx_t_2), NULL); if (unlikely(!__pyx_t_3)) {__pyx_filename = __pyx_f[0]; __pyx_lineno = 41; __pyx_clineno = __LINE__; goto __pyx_L1_error;}
    __Pyx_GOTREF(__pyx_t_3);
    __Pyx_DECREF(((PyObject *)__pyx_t_2)); __pyx_t_2 = 0;
    __Pyx_Raise(__pyx_t_3, 0, 0, 0);
    __Pyx_DECREF(__pyx_t_3); __pyx_t_3 = 0;
    {__pyx_filename = __pyx_f[0]; __pyx_lineno = 41; __pyx_clineno = __LINE__; goto __pyx_L1_error;}
  }
  __pyx_L3:;

  /* "kiva/quartz/CTFont.pyx":43
 *             raise RuntimeError(msg)
 * 
 *         cf_font_collection = CTFontCollectionCreateFromAvailableFonts(cf_options_dict)             # <<<<<<<<<<<<<<
 *         CFRelease(cf_options_dict)
 * 
 */
  __pyx_v_cf_font_collection = CTFontCollectionCreateFromAvailableFonts(__pyx_v_cf_options_dict);

  /* "kiva/quartz/CTFont.pyx":44
 * 
 *         cf_font_collection = CTFontCollectionCreateFromAvailableFonts(cf_options_dict)
 *         CFRelease(cf_options_dict)             # <<<<<<<<<<<<<<
 * 
 *         cf_font_descriptors = CTFontCollectionCreateMatchingFontDescriptors(cf_font_collection)
 */
  CFRelease(__pyx_v_cf_options_dict);

  /* "kiva/quartz/CTFont.pyx":46
 *         CFRelease(cf_options_dict)
 * 
 *         cf_font_descriptors = CTFontCollectionCreateMatchingFontDescriptors(cf_font_collection)             # <<<<<<<<<<<<<<
 *         CFRelease(cf_font_collection)
 * 
 */
  __pyx_v_cf_font_descriptors = CTFontCollectionCreateMatchingFontDescriptors(__pyx_v_cf_font_collection);

  /* "kiva/quartz/CTFont.pyx":47
 * 
 *         cf_font_descriptors = CTFontCollectionCreateMatchingFontDescriptors(cf_font_collection)
 *         CFRelease(cf_font_collection)             # <<<<<<<<<<<<<<
 * 
 *         return cf_font_descriptors
 */
  CFRelease(__pyx_v_cf_font_collection);

  /* "kiva/quartz/CTFont.pyx":49
 *         CFRelease(cf_font_collection)
 * 
 *         return cf_font_descriptors             # <<<<<<<<<<<<<<
 * 
 * cdef class CTFont:
 */
  __pyx_r = __pyx_v_cf_font_descriptors;
  goto __pyx_L0;

  __pyx_r = 0;
  goto __pyx_L0;
  __pyx_L1_error:;
  __Pyx_XDECREF(__pyx_t_2);
  __Pyx_XDECREF(__pyx_t_3);
  __Pyx_WriteUnraisable("kiva.quartz.CTFont._get_system_fonts", __pyx_clineno, __pyx_lineno, __pyx_filename);
  __pyx_r = 0;
  __pyx_L0:;
  __Pyx_XDECREF(__pyx_v_msg);
  __Pyx_RefNannyFinishContext();
  return __pyx_r;
}

/* Python wrapper */
static int __pyx_pw_4kiva_6quartz_6CTFont_6CTFont_1__cinit__(PyObject *__pyx_v_self, PyObject *__pyx_args, PyObject *__pyx_kwds); /*proto*/
static int __pyx_pw_4kiva_6quartz_6CTFont_6CTFont_1__cinit__(PyObject *__pyx_v_self, PyObject *__pyx_args, PyObject *__pyx_kwds) {
  CYTHON_UNUSED PyObject *__pyx_v_args = 0;
  CYTHON_UNUSED PyObject *__pyx_v_kwargs = 0;
  int __pyx_r;
  __Pyx_RefNannyDeclarations
  __Pyx_RefNannySetupContext("__cinit__ (wrapper)", 0);
  if (unlikely(__pyx_kwds) && unlikely(!__Pyx_CheckKeywordStrings(__pyx_kwds, "__cinit__", 1))) return -1;
  __pyx_v_kwargs = (__pyx_kwds) ? PyDict_Copy(__pyx_kwds) : PyDict_New();
  if (unlikely(!__pyx_v_kwargs)) return -1;
  __Pyx_GOTREF(__pyx_v_kwargs);
  __Pyx_INCREF(__pyx_args);
  __pyx_v_args = __pyx_args;
  __pyx_r = __pyx_pf_4kiva_6quartz_6CTFont_6CTFont___cinit__(((struct __pyx_obj_4kiva_6quartz_6CTFont_CTFont *)__pyx_v_self), __pyx_v_args, __pyx_v_kwargs);
  __Pyx_XDECREF(__pyx_v_args);
  __Pyx_XDECREF(__pyx_v_kwargs);
  __Pyx_RefNannyFinishContext();
  return __pyx_r;
}

/* "kiva/quartz/CTFont.pyx":53
 * cdef class CTFont:
 *     cdef CTFontRef ct_font
 *     def __cinit__(self, *args, **kwargs):             # <<<<<<<<<<<<<<
 *         self.ct_font = NULL
 * 
 */

static int __pyx_pf_4kiva_6quartz_6CTFont_6CTFont___cinit__(struct __pyx_obj_4kiva_6quartz_6CTFont_CTFont *__pyx_v_self, CYTHON_UNUSED PyObject *__pyx_v_args, CYTHON_UNUSED PyObject *__pyx_v_kwargs) {
  int __pyx_r;
  __Pyx_RefNannyDeclarations
  __Pyx_RefNannySetupContext("__cinit__", 0);

  /* "kiva/quartz/CTFont.pyx":54
 *     cdef CTFontRef ct_font
 *     def __cinit__(self, *args, **kwargs):
 *         self.ct_font = NULL             # <<<<<<<<<<<<<<
 * 
 *     def __dealloc__(self):
 */
  __pyx_v_self->ct_font = NULL;

  __pyx_r = 0;
  __Pyx_RefNannyFinishContext();
  return __pyx_r;
}

/* Python wrapper */
static void __pyx_pw_4kiva_6quartz_6CTFont_6CTFont_3__dealloc__(PyObject *__pyx_v_self); /*proto*/
static void __pyx_pw_4kiva_6quartz_6CTFont_6CTFont_3__dealloc__(PyObject *__pyx_v_self) {
  __Pyx_RefNannyDeclarations
  __Pyx_RefNannySetupContext("__dealloc__ (wrapper)", 0);
  __pyx_pf_4kiva_6quartz_6CTFont_6CTFont_2__dealloc__(((struct __pyx_obj_4kiva_6quartz_6CTFont_CTFont *)__pyx_v_self));
  __Pyx_RefNannyFinishContext();
}

/* "kiva/quartz/CTFont.pyx":56
 *         self.ct_font = NULL
 * 
 *     def __dealloc__(self):             # <<<<<<<<<<<<<<
 *         if self.ct_font != NULL:
 *             CFRelease(self.ct_font)
 */

static void __pyx_pf_4kiva_6quartz_6CTFont_6CTFont_2__dealloc__(struct __pyx_obj_4kiva_6quartz_6CTFont_CTFont *__pyx_v_self) {
  __Pyx_RefNannyDeclarations
  int __pyx_t_1;
  __Pyx_RefNannySetupContext("__dealloc__", 0);

  /* "kiva/quartz/CTFont.pyx":57
 * 
 *     def __dealloc__(self):
 *         if self.ct_font != NULL:             # <<<<<<<<<<<<<<
 *             CFRelease(self.ct_font)
 * 
 */
  __pyx_t_1 = ((__pyx_v_self->ct_font != NULL) != 0);
  if (__pyx_t_1) {

    /* "kiva/quartz/CTFont.pyx":58
 *     def __dealloc__(self):
 *         if self.ct_font != NULL:
 *             CFRelease(self.ct_font)             # <<<<<<<<<<<<<<
 * 
 *     cpdef size_t get_pointer(self):
 */
    CFRelease(__pyx_v_self->ct_font);
    goto __pyx_L3;
  }
  __pyx_L3:;

  __Pyx_RefNannyFinishContext();
}

/* "kiva/quartz/CTFont.pyx":60
 *             CFRelease(self.ct_font)
 * 
 *     cpdef size_t get_pointer(self):             # <<<<<<<<<<<<<<
 *         return <size_t>self.ct_font
 * 
 */

static PyObject *__pyx_pw_4kiva_6quartz_6CTFont_6CTFont_5get_pointer(PyObject *__pyx_v_self, CYTHON_UNUSED PyObject *unused); /*proto*/
static size_t __pyx_f_4kiva_6quartz_6CTFont_6CTFont_get_pointer(struct __pyx_obj_4kiva_6quartz_6CTFont_CTFont *__pyx_v_self, int __pyx_skip_dispatch) {
  size_t __pyx_r;
  __Pyx_RefNannyDeclarations
  PyObject *__pyx_t_1 = NULL;
  PyObject *__pyx_t_2 = NULL;
  size_t __pyx_t_3;
  int __pyx_lineno = 0;
  const char *__pyx_filename = NULL;
  int __pyx_clineno = 0;
  __Pyx_RefNannySetupContext("get_pointer", 0);
  /* Check if called by wrapper */
  if (unlikely(__pyx_skip_dispatch)) ;
  /* Check if overridden in Python */
  else if (unlikely(Py_TYPE(((PyObject *)__pyx_v_self))->tp_dictoffset != 0)) {
    __pyx_t_1 = __Pyx_PyObject_GetAttrStr(((PyObject *)__pyx_v_self), __pyx_n_s__get_pointer); if (unlikely(!__pyx_t_1)) {__pyx_filename = __pyx_f[0]; __pyx_lineno = 60; __pyx_clineno = __LINE__; goto __pyx_L1_error;}
    __Pyx_GOTREF(__pyx_t_1);
    if (!PyCFunction_Check(__pyx_t_1) || (PyCFunction_GET_FUNCTION(__pyx_t_1) != (PyCFunction)__pyx_pw_4kiva_6quartz_6CTFont_6CTFont_5get_pointer)) {
      __pyx_t_2 = PyObject_Call(__pyx_t_1, ((PyObject *)__pyx_empty_tuple), NULL); if (unlikely(!__pyx_t_2)) {__pyx_filename = __pyx_f[0]; __pyx_lineno = 60; __pyx_clineno = __LINE__; goto __pyx_L1_error;}
      __Pyx_GOTREF(__pyx_t_2);
      __pyx_t_3 = __Pyx_PyInt_AsSize_t(__pyx_t_2); if (unlikely((__pyx_t_3 == (size_t)-1) && PyErr_Occurred())) {__pyx_filename = __pyx_f[0]; __pyx_lineno = 60; __pyx_clineno = __LINE__; goto __pyx_L1_error;}
      __Pyx_DECREF(__pyx_t_2); __pyx_t_2 = 0;
      __pyx_r = __pyx_t_3;
      __Pyx_DECREF(__pyx_t_1); __pyx_t_1 = 0;
      goto __pyx_L0;
    }
    __Pyx_DECREF(__pyx_t_1); __pyx_t_1 = 0;
  }

  /* "kiva/quartz/CTFont.pyx":61
 * 
 *     cpdef size_t get_pointer(self):
 *         return <size_t>self.ct_font             # <<<<<<<<<<<<<<
 * 
 *     cdef set_pointer(self, CTFontRef pointer):
 */
  __pyx_r = ((size_t)__pyx_v_self->ct_font);
  goto __pyx_L0;

  __pyx_r = 0;
  goto __pyx_L0;
  __pyx_L1_error:;
  __Pyx_XDECREF(__pyx_t_1);
  __Pyx_XDECREF(__pyx_t_2);
  __Pyx_WriteUnraisable("kiva.quartz.CTFont.CTFont.get_pointer", __pyx_clineno, __pyx_lineno, __pyx_filename);
  __pyx_r = 0;
  __pyx_L0:;
  __Pyx_RefNannyFinishContext();
  return __pyx_r;
}

/* Python wrapper */
static PyObject *__pyx_pw_4kiva_6quartz_6CTFont_6CTFont_5get_pointer(PyObject *__pyx_v_self, CYTHON_UNUSED PyObject *unused); /*proto*/
static PyObject *__pyx_pw_4kiva_6quartz_6CTFont_6CTFont_5get_pointer(PyObject *__pyx_v_self, CYTHON_UNUSED PyObject *unused) {
  PyObject *__pyx_r = 0;
  __Pyx_RefNannyDeclarations
  __Pyx_RefNannySetupContext("get_pointer (wrapper)", 0);
  __pyx_r = __pyx_pf_4kiva_6quartz_6CTFont_6CTFont_4get_pointer(((struct __pyx_obj_4kiva_6quartz_6CTFont_CTFont *)__pyx_v_self));
  __Pyx_RefNannyFinishContext();
  return __pyx_r;
}

/* "kiva/quartz/CTFont.pyx":60
 *             CFRelease(self.ct_font)
 * 
 *     cpdef size_t get_pointer(self):             # <<<<<<<<<<<<<<
 *         return <size_t>self.ct_font
 * 
 */

static PyObject *__pyx_pf_4kiva_6quartz_6CTFont_6CTFont_4get_pointer(struct __pyx_obj_4kiva_6quartz_6CTFont_CTFont *__pyx_v_self) {
  PyObject *__pyx_r = NULL;
  __Pyx_RefNannyDeclarations
  PyObject *__pyx_t_1 = NULL;
  int __pyx_lineno = 0;
  const char *__pyx_filename = NULL;
  int __pyx_clineno = 0;
  __Pyx_RefNannySetupContext("get_pointer", 0);
  __Pyx_XDECREF(__pyx_r);
  __pyx_t_1 = __Pyx_PyInt_FromSize_t(((struct __pyx_vtabstruct_4kiva_6quartz_6CTFont_CTFont *)__pyx_v_self->__pyx_vtab)->get_pointer(__pyx_v_self, 1)); if (unlikely(!__pyx_t_1)) {__pyx_filename = __pyx_f[0]; __pyx_lineno = 60; __pyx_clineno = __LINE__; goto __pyx_L1_error;}
  __Pyx_GOTREF(__pyx_t_1);
  __pyx_r = __pyx_t_1;
  __pyx_t_1 = 0;
  goto __pyx_L0;

  __pyx_r = Py_None; __Pyx_INCREF(Py_None);
  goto __pyx_L0;
  __pyx_L1_error:;
  __Pyx_XDECREF(__pyx_t_1);
  __Pyx_AddTraceback("kiva.quartz.CTFont.CTFont.get_pointer", __pyx_clineno, __pyx_lineno, __pyx_filename);
  __pyx_r = NULL;
  __pyx_L0:;
  __Pyx_XGIVEREF(__pyx_r);
  __Pyx_RefNannyFinishContext();
  return __pyx_r;
}

/* "kiva/quartz/CTFont.pyx":63
 *         return <size_t>self.ct_font
 * 
 *     cdef set_pointer(self, CTFontRef pointer):             # <<<<<<<<<<<<<<
 *         self.ct_font = pointer
 * 
 */

static PyObject *__pyx_f_4kiva_6quartz_6CTFont_6CTFont_set_pointer(struct __pyx_obj_4kiva_6quartz_6CTFont_CTFont *__pyx_v_self, CTFontRef __pyx_v_pointer) {
  PyObject *__pyx_r = NULL;
  __Pyx_RefNannyDeclarations
  __Pyx_RefNannySetupContext("set_pointer", 0);

  /* "kiva/quartz/CTFont.pyx":64
 * 
 *     cdef set_pointer(self, CTFontRef pointer):
 *         self.ct_font = pointer             # <<<<<<<<<<<<<<
 * 
 * 
 */
  __pyx_v_self->ct_font = __pyx_v_pointer;

  __pyx_r = Py_None; __Pyx_INCREF(Py_None);
  __Pyx_XGIVEREF(__pyx_r);
  __Pyx_RefNannyFinishContext();
  return __pyx_r;
}

/* Python wrapper */
static int __pyx_pw_4kiva_6quartz_6CTFont_11CTFontStyle_1__cinit__(PyObject *__pyx_v_self, PyObject *__pyx_args, PyObject *__pyx_kwds); /*proto*/
static int __pyx_pw_4kiva_6quartz_6CTFont_11CTFontStyle_1__cinit__(PyObject *__pyx_v_self, PyObject *__pyx_args, PyObject *__pyx_kwds) {
  CYTHON_UNUSED PyObject *__pyx_v_args = 0;
  CYTHON_UNUSED PyObject *__pyx_v_kwargs = 0;
  int __pyx_r;
  __Pyx_RefNannyDeclarations
  __Pyx_RefNannySetupContext("__cinit__ (wrapper)", 0);
  if (unlikely(__pyx_kwds) && unlikely(!__Pyx_CheckKeywordStrings(__pyx_kwds, "__cinit__", 1))) return -1;
  __pyx_v_kwargs = (__pyx_kwds) ? PyDict_Copy(__pyx_kwds) : PyDict_New();
  if (unlikely(!__pyx_v_kwargs)) return -1;
  __Pyx_GOTREF(__pyx_v_kwargs);
  __Pyx_INCREF(__pyx_args);
  __pyx_v_args = __pyx_args;
  __pyx_r = __pyx_pf_4kiva_6quartz_6CTFont_11CTFontStyle___cinit__(((struct __pyx_obj_4kiva_6quartz_6CTFont_CTFontStyle *)__pyx_v_self), __pyx_v_args, __pyx_v_kwargs);
  __Pyx_XDECREF(__pyx_v_args);
  __Pyx_XDECREF(__pyx_v_kwargs);
  __Pyx_RefNannyFinishContext();
  return __pyx_r;
}

/* "kiva/quartz/CTFont.pyx":73
 *     cdef readonly object style
 * 
 *     def __cinit__(self, *args, **kwargs):             # <<<<<<<<<<<<<<
 *         self.ct_font_descriptor = NULL
 *         self.attribute_dictionary = NULL
 */

static int __pyx_pf_4kiva_6quartz_6CTFont_11CTFontStyle___cinit__(struct __pyx_obj_4kiva_6quartz_6CTFont_CTFontStyle *__pyx_v_self, CYTHON_UNUSED PyObject *__pyx_v_args, CYTHON_UNUSED PyObject *__pyx_v_kwargs) {
  int __pyx_r;
  __Pyx_RefNannyDeclarations
  __Pyx_RefNannySetupContext("__cinit__", 0);

  /* "kiva/quartz/CTFont.pyx":74
 * 
 *     def __cinit__(self, *args, **kwargs):
 *         self.ct_font_descriptor = NULL             # <<<<<<<<<<<<<<
 *         self.attribute_dictionary = NULL
 * 
 */
  __pyx_v_self->ct_font_descriptor = NULL;

  /* "kiva/quartz/CTFont.pyx":75
 *     def __cinit__(self, *args, **kwargs):
 *         self.ct_font_descriptor = NULL
 *         self.attribute_dictionary = NULL             # <<<<<<<<<<<<<<
 * 
 *     def __dealloc__(self):
 */
  __pyx_v_self->attribute_dictionary = NULL;

  __pyx_r = 0;
  __Pyx_RefNannyFinishContext();
  return __pyx_r;
}

/* Python wrapper */
static void __pyx_pw_4kiva_6quartz_6CTFont_11CTFontStyle_3__dealloc__(PyObject *__pyx_v_self); /*proto*/
static void __pyx_pw_4kiva_6quartz_6CTFont_11CTFontStyle_3__dealloc__(PyObject *__pyx_v_self) {
  __Pyx_RefNannyDeclarations
  __Pyx_RefNannySetupContext("__dealloc__ (wrapper)", 0);
  __pyx_pf_4kiva_6quartz_6CTFont_11CTFontStyle_2__dealloc__(((struct __pyx_obj_4kiva_6quartz_6CTFont_CTFontStyle *)__pyx_v_self));
  __Pyx_RefNannyFinishContext();
}

/* "kiva/quartz/CTFont.pyx":77
 *         self.attribute_dictionary = NULL
 * 
 *     def __dealloc__(self):             # <<<<<<<<<<<<<<
 *         if self.attribute_dictionary != NULL:
 *             CFRelease(self.attribute_dictionary)
 */

static void __pyx_pf_4kiva_6quartz_6CTFont_11CTFontStyle_2__dealloc__(struct __pyx_obj_4kiva_6quartz_6CTFont_CTFontStyle *__pyx_v_self) {
  __Pyx_RefNannyDeclarations
  int __pyx_t_1;
  __Pyx_RefNannySetupContext("__dealloc__", 0);

  /* "kiva/quartz/CTFont.pyx":78
 * 
 *     def __dealloc__(self):
 *         if self.attribute_dictionary != NULL:             # <<<<<<<<<<<<<<
 *             CFRelease(self.attribute_dictionary)
 *         if self.ct_font_descriptor != NULL:
 */
  __pyx_t_1 = ((__pyx_v_self->attribute_dictionary != NULL) != 0);
  if (__pyx_t_1) {

    /* "kiva/quartz/CTFont.pyx":79
 *     def __dealloc__(self):
 *         if self.attribute_dictionary != NULL:
 *             CFRelease(self.attribute_dictionary)             # <<<<<<<<<<<<<<
 *         if self.ct_font_descriptor != NULL:
 *             CFRelease(self.ct_font_descriptor)
 */
    CFRelease(__pyx_v_self->attribute_dictionary);
    goto __pyx_L3;
  }
  __pyx_L3:;

  /* "kiva/quartz/CTFont.pyx":80
 *         if self.attribute_dictionary != NULL:
 *             CFRelease(self.attribute_dictionary)
 *         if self.ct_font_descriptor != NULL:             # <<<<<<<<<<<<<<
 *             CFRelease(self.ct_font_descriptor)
 * 
 */
  __pyx_t_1 = ((__pyx_v_self->ct_font_descriptor != NULL) != 0);
  if (__pyx_t_1) {

    /* "kiva/quartz/CTFont.pyx":81
 *             CFRelease(self.attribute_dictionary)
 *         if self.ct_font_descriptor != NULL:
 *             CFRelease(self.ct_font_descriptor)             # <<<<<<<<<<<<<<
 * 
 *     def __init__(self, name, style='regular'):
 */
    CFRelease(__pyx_v_self->ct_font_descriptor);
    goto __pyx_L4;
  }
  __pyx_L4:;

  __Pyx_RefNannyFinishContext();
}

/* Python wrapper */
static int __pyx_pw_4kiva_6quartz_6CTFont_11CTFontStyle_5__init__(PyObject *__pyx_v_self, PyObject *__pyx_args, PyObject *__pyx_kwds); /*proto*/
static int __pyx_pw_4kiva_6quartz_6CTFont_11CTFontStyle_5__init__(PyObject *__pyx_v_self, PyObject *__pyx_args, PyObject *__pyx_kwds) {
  PyObject *__pyx_v_name = 0;
  PyObject *__pyx_v_style = 0;
  int __pyx_lineno = 0;
  const char *__pyx_filename = NULL;
  int __pyx_clineno = 0;
  int __pyx_r;
  __Pyx_RefNannyDeclarations
  __Pyx_RefNannySetupContext("__init__ (wrapper)", 0);
  {
    static PyObject **__pyx_pyargnames[] = {&__pyx_n_s__name,&__pyx_n_s__style,0};
    PyObject* values[2] = {0,0};
    values[1] = ((PyObject *)__pyx_n_s__regular);
    if (unlikely(__pyx_kwds)) {
      Py_ssize_t kw_args;
      const Py_ssize_t pos_args = PyTuple_GET_SIZE(__pyx_args);
      switch (pos_args) {
        case  2: values[1] = PyTuple_GET_ITEM(__pyx_args, 1);
        case  1: values[0] = PyTuple_GET_ITEM(__pyx_args, 0);
        case  0: break;
        default: goto __pyx_L5_argtuple_error;
      }
      kw_args = PyDict_Size(__pyx_kwds);
      switch (pos_args) {
        case  0:
        if (likely((values[0] = PyDict_GetItem(__pyx_kwds, __pyx_n_s__name)) != 0)) kw_args--;
        else goto __pyx_L5_argtuple_error;
        case  1:
        if (kw_args > 0) {
          PyObject* value = PyDict_GetItem(__pyx_kwds, __pyx_n_s__style);
          if (value) { values[1] = value; kw_args--; }
        }
      }
      if (unlikely(kw_args > 0)) {
        if (unlikely(__Pyx_ParseOptionalKeywords(__pyx_kwds, __pyx_pyargnames, 0, values, pos_args, "__init__") < 0)) {__pyx_filename = __pyx_f[0]; __pyx_lineno = 83; __pyx_clineno = __LINE__; goto __pyx_L3_error;}
      }
    } else {
      switch (PyTuple_GET_SIZE(__pyx_args)) {
        case  2: values[1] = PyTuple_GET_ITEM(__pyx_args, 1);
        case  1: values[0] = PyTuple_GET_ITEM(__pyx_args, 0);
        break;
        default: goto __pyx_L5_argtuple_error;
      }
    }
    __pyx_v_name = values[0];
    __pyx_v_style = values[1];
  }
  goto __pyx_L4_argument_unpacking_done;
  __pyx_L5_argtuple_error:;
  __Pyx_RaiseArgtupleInvalid("__init__", 0, 1, 2, PyTuple_GET_SIZE(__pyx_args)); {__pyx_filename = __pyx_f[0]; __pyx_lineno = 83; __pyx_clineno = __LINE__; goto __pyx_L3_error;}
  __pyx_L3_error:;
  __Pyx_AddTraceback("kiva.quartz.CTFont.CTFontStyle.__init__", __pyx_clineno, __pyx_lineno, __pyx_filename);
  __Pyx_RefNannyFinishContext();
  return -1;
  __pyx_L4_argument_unpacking_done:;
  __pyx_r = __pyx_pf_4kiva_6quartz_6CTFont_11CTFontStyle_4__init__(((struct __pyx_obj_4kiva_6quartz_6CTFont_CTFontStyle *)__pyx_v_self), __pyx_v_name, __pyx_v_style);
  __Pyx_RefNannyFinishContext();
  return __pyx_r;
}

/* "kiva/quartz/CTFont.pyx":83
 *             CFRelease(self.ct_font_descriptor)
 * 
 *     def __init__(self, name, style='regular'):             # <<<<<<<<<<<<<<
 *         self.family_name = name
 *         self.style = style
 */

static int __pyx_pf_4kiva_6quartz_6CTFont_11CTFontStyle_4__init__(struct __pyx_obj_4kiva_6quartz_6CTFont_CTFontStyle *__pyx_v_self, PyObject *__pyx_v_name, PyObject *__pyx_v_style) {
  int __pyx_r;
  __Pyx_RefNannyDeclarations
  __Pyx_RefNannySetupContext("__init__", 0);

  /* "kiva/quartz/CTFont.pyx":84
 * 
 *     def __init__(self, name, style='regular'):
 *         self.family_name = name             # <<<<<<<<<<<<<<
 *         self.style = style
 *         self.attribute_dictionary = self._build_attribute_dictionary(name, style)
 */
  __Pyx_INCREF(__pyx_v_name);
  __Pyx_GIVEREF(__pyx_v_name);
  __Pyx_GOTREF(__pyx_v_self->family_name);
  __Pyx_DECREF(__pyx_v_self->family_name);
  __pyx_v_self->family_name = __pyx_v_name;

  /* "kiva/quartz/CTFont.pyx":85
 *     def __init__(self, name, style='regular'):
 *         self.family_name = name
 *         self.style = style             # <<<<<<<<<<<<<<
 *         self.attribute_dictionary = self._build_attribute_dictionary(name, style)
 *         self.ct_font_descriptor = CTFontDescriptorCreateWithAttributes(self.attribute_dictionary)
 */
  __Pyx_INCREF(__pyx_v_style);
  __Pyx_GIVEREF(__pyx_v_style);
  __Pyx_GOTREF(__pyx_v_self->style);
  __Pyx_DECREF(__pyx_v_self->style);
  __pyx_v_self->style = __pyx_v_style;

  /* "kiva/quartz/CTFont.pyx":86
 *         self.family_name = name
 *         self.style = style
 *         self.attribute_dictionary = self._build_attribute_dictionary(name, style)             # <<<<<<<<<<<<<<
 *         self.ct_font_descriptor = CTFontDescriptorCreateWithAttributes(self.attribute_dictionary)
 * 
 */
  __pyx_v_self->attribute_dictionary = ((struct __pyx_vtabstruct_4kiva_6quartz_6CTFont_CTFontStyle *)__pyx_v_self->__pyx_vtab)->_build_attribute_dictionary(__pyx_v_self, __pyx_v_name, __pyx_v_style);

  /* "kiva/quartz/CTFont.pyx":87
 *         self.style = style
 *         self.attribute_dictionary = self._build_attribute_dictionary(name, style)
 *         self.ct_font_descriptor = CTFontDescriptorCreateWithAttributes(self.attribute_dictionary)             # <<<<<<<<<<<<<<
 * 
 *     def get_descent_ascent(self, object text):
 */
  __pyx_v_self->ct_font_descriptor = CTFontDescriptorCreateWithAttributes(__pyx_v_self->attribute_dictionary);

  __pyx_r = 0;
  __Pyx_RefNannyFinishContext();
  return __pyx_r;
}

/* Python wrapper */
static PyObject *__pyx_pw_4kiva_6quartz_6CTFont_11CTFontStyle_7get_descent_ascent(PyObject *__pyx_v_self, PyObject *__pyx_v_text); /*proto*/
static char __pyx_doc_4kiva_6quartz_6CTFont_11CTFontStyle_6get_descent_ascent[] = " Get the descent and ascent font metrics for a given string of text.\n        ";
static PyObject *__pyx_pw_4kiva_6quartz_6CTFont_11CTFontStyle_7get_descent_ascent(PyObject *__pyx_v_self, PyObject *__pyx_v_text) {
  PyObject *__pyx_r = 0;
  __Pyx_RefNannyDeclarations
  __Pyx_RefNannySetupContext("get_descent_ascent (wrapper)", 0);
  __pyx_r = __pyx_pf_4kiva_6quartz_6CTFont_11CTFontStyle_6get_descent_ascent(((struct __pyx_obj_4kiva_6quartz_6CTFont_CTFontStyle *)__pyx_v_self), ((PyObject *)__pyx_v_text));
  __Pyx_RefNannyFinishContext();
  return __pyx_r;
}

/* "kiva/quartz/CTFont.pyx":89
 *         self.ct_font_descriptor = CTFontDescriptorCreateWithAttributes(self.attribute_dictionary)
 * 
 *     def get_descent_ascent(self, object text):             # <<<<<<<<<<<<<<
 *         """ Get the descent and ascent font metrics for a given string of text.
 *         """
 */

static PyObject *__pyx_pf_4kiva_6quartz_6CTFont_11CTFontStyle_6get_descent_ascent(struct __pyx_obj_4kiva_6quartz_6CTFont_CTFontStyle *__pyx_v_self, CYTHON_UNUSED PyObject *__pyx_v_text) {
  CTFontRef __pyx_v_ct_font;
  float __pyx_v_ascent;
  float __pyx_v_descent;
  PyObject *__pyx_r = NULL;
  __Pyx_RefNannyDeclarations
  PyObject *__pyx_t_1 = NULL;
  PyObject *__pyx_t_2 = NULL;
  PyObject *__pyx_t_3 = NULL;
  int __pyx_lineno = 0;
  const char *__pyx_filename = NULL;
  int __pyx_clineno = 0;
  __Pyx_RefNannySetupContext("get_descent_ascent", 0);

  /* "kiva/quartz/CTFont.pyx":96
 *         cdef float ascent, descent
 * 
 *         ct_font = CTFontCreateWithFontDescriptor(self.ct_font_descriptor, 0.0, NULL)             # <<<<<<<<<<<<<<
 *         ascent = CTFontGetAscent(ct_font)
 *         descent = CTFontGetDescent(ct_font)
 */
  __pyx_v_ct_font = CTFontCreateWithFontDescriptor(__pyx_v_self->ct_font_descriptor, 0.0, NULL);

  /* "kiva/quartz/CTFont.pyx":97
 * 
 *         ct_font = CTFontCreateWithFontDescriptor(self.ct_font_descriptor, 0.0, NULL)
 *         ascent = CTFontGetAscent(ct_font)             # <<<<<<<<<<<<<<
 *         descent = CTFontGetDescent(ct_font)
 *         CFRelease(ct_font)
 */
  __pyx_v_ascent = CTFontGetAscent(__pyx_v_ct_font);

  /* "kiva/quartz/CTFont.pyx":98
 *         ct_font = CTFontCreateWithFontDescriptor(self.ct_font_descriptor, 0.0, NULL)
 *         ascent = CTFontGetAscent(ct_font)
 *         descent = CTFontGetDescent(ct_font)             # <<<<<<<<<<<<<<
 *         CFRelease(ct_font)
 * 
 */
  __pyx_v_descent = CTFontGetDescent(__pyx_v_ct_font);

  /* "kiva/quartz/CTFont.pyx":99
 *         ascent = CTFontGetAscent(ct_font)
 *         descent = CTFontGetDescent(ct_font)
 *         CFRelease(ct_font)             # <<<<<<<<<<<<<<
 * 
 *         return descent, ascent
 */
  CFRelease(__pyx_v_ct_font);

  /* "kiva/quartz/CTFont.pyx":101
 *         CFRelease(ct_font)
 * 
 *         return descent, ascent             # <<<<<<<<<<<<<<
 * 
 *     def get_font(self, float font_size):
 */
  __Pyx_XDECREF(__pyx_r);
  __pyx_t_1 = PyFloat_FromDouble(__pyx_v_descent); if (unlikely(!__pyx_t_1)) {__pyx_filename = __pyx_f[0]; __pyx_lineno = 101; __pyx_clineno = __LINE__; goto __pyx_L1_error;}
  __Pyx_GOTREF(__pyx_t_1);
  __pyx_t_2 = PyFloat_FromDouble(__pyx_v_ascent); if (unlikely(!__pyx_t_2)) {__pyx_filename = __pyx_f[0]; __pyx_lineno = 101; __pyx_clineno = __LINE__; goto __pyx_L1_error;}
  __Pyx_GOTREF(__pyx_t_2);
  __pyx_t_3 = PyTuple_New(2); if (unlikely(!__pyx_t_3)) {__pyx_filename = __pyx_f[0]; __pyx_lineno = 101; __pyx_clineno = __LINE__; goto __pyx_L1_error;}
  __Pyx_GOTREF(__pyx_t_3);
  PyTuple_SET_ITEM(__pyx_t_3, 0, __pyx_t_1);
  __Pyx_GIVEREF(__pyx_t_1);
  PyTuple_SET_ITEM(__pyx_t_3, 1, __pyx_t_2);
  __Pyx_GIVEREF(__pyx_t_2);
  __pyx_t_1 = 0;
  __pyx_t_2 = 0;
  __pyx_r = ((PyObject *)__pyx_t_3);
  __pyx_t_3 = 0;
  goto __pyx_L0;

  __pyx_r = Py_None; __Pyx_INCREF(Py_None);
  goto __pyx_L0;
  __pyx_L1_error:;
  __Pyx_XDECREF(__pyx_t_1);
  __Pyx_XDECREF(__pyx_t_2);
  __Pyx_XDECREF(__pyx_t_3);
  __Pyx_AddTraceback("kiva.quartz.CTFont.CTFontStyle.get_descent_ascent", __pyx_clineno, __pyx_lineno, __pyx_filename);
  __pyx_r = NULL;
  __pyx_L0:;
  __Pyx_XGIVEREF(__pyx_r);
  __Pyx_RefNannyFinishContext();
  return __pyx_r;
}

/* Python wrapper */
static PyObject *__pyx_pw_4kiva_6quartz_6CTFont_11CTFontStyle_9get_font(PyObject *__pyx_v_self, PyObject *__pyx_arg_font_size); /*proto*/
static char __pyx_doc_4kiva_6quartz_6CTFont_11CTFontStyle_8get_font[] = " Get a CTFont matching the descriptor at the given size.\n        ";
static PyObject *__pyx_pw_4kiva_6quartz_6CTFont_11CTFontStyle_9get_font(PyObject *__pyx_v_self, PyObject *__pyx_arg_font_size) {
  float __pyx_v_font_size;
  int __pyx_lineno = 0;
  const char *__pyx_filename = NULL;
  int __pyx_clineno = 0;
  PyObject *__pyx_r = 0;
  __Pyx_RefNannyDeclarations
  __Pyx_RefNannySetupContext("get_font (wrapper)", 0);
  assert(__pyx_arg_font_size); {
    __pyx_v_font_size = __pyx_PyFloat_AsFloat(__pyx_arg_font_size); if (unlikely((__pyx_v_font_size == (float)-1) && PyErr_Occurred())) {__pyx_filename = __pyx_f[0]; __pyx_lineno = 103; __pyx_clineno = __LINE__; goto __pyx_L3_error;}
  }
  goto __pyx_L4_argument_unpacking_done;
  __pyx_L3_error:;
  __Pyx_AddTraceback("kiva.quartz.CTFont.CTFontStyle.get_font", __pyx_clineno, __pyx_lineno, __pyx_filename);
  __Pyx_RefNannyFinishContext();
  return NULL;
  __pyx_L4_argument_unpacking_done:;
  __pyx_r = __pyx_pf_4kiva_6quartz_6CTFont_11CTFontStyle_8get_font(((struct __pyx_obj_4kiva_6quartz_6CTFont_CTFontStyle *)__pyx_v_self), ((float)__pyx_v_font_size));
  __Pyx_RefNannyFinishContext();
  return __pyx_r;
}

/* "kiva/quartz/CTFont.pyx":103
 *         return descent, ascent
 * 
 *     def get_font(self, float font_size):             # <<<<<<<<<<<<<<
 *         """ Get a CTFont matching the descriptor at the given size.
 *         """
 */

static PyObject *__pyx_pf_4kiva_6quartz_6CTFont_11CTFontStyle_8get_font(struct __pyx_obj_4kiva_6quartz_6CTFont_CTFontStyle *__pyx_v_self, float __pyx_v_font_size) {
  CTFontRef __pyx_v_ct_font;
  struct __pyx_obj_4kiva_6quartz_6CTFont_CTFont *__pyx_v_font = NULL;
  PyObject *__pyx_r = NULL;
  __Pyx_RefNannyDeclarations
  PyObject *__pyx_t_1 = NULL;
  int __pyx_lineno = 0;
  const char *__pyx_filename = NULL;
  int __pyx_clineno = 0;
  __Pyx_RefNannySetupContext("get_font", 0);

  /* "kiva/quartz/CTFont.pyx":109
 * 
 *         ct_font = CTFontCreateWithFontDescriptor(self.ct_font_descriptor,
 *                     font_size, NULL)             # <<<<<<<<<<<<<<
 *         font = CTFont()
 *         font.set_pointer(ct_font)
 */
  __pyx_v_ct_font = CTFontCreateWithFontDescriptor(__pyx_v_self->ct_font_descriptor, __pyx_v_font_size, NULL);

  /* "kiva/quartz/CTFont.pyx":110
 *         ct_font = CTFontCreateWithFontDescriptor(self.ct_font_descriptor,
 *                     font_size, NULL)
 *         font = CTFont()             # <<<<<<<<<<<<<<
 *         font.set_pointer(ct_font)
 *         return font
 */
  __pyx_t_1 = PyObject_Call(((PyObject *)((PyObject*)__pyx_ptype_4kiva_6quartz_6CTFont_CTFont)), ((PyObject *)__pyx_empty_tuple), NULL); if (unlikely(!__pyx_t_1)) {__pyx_filename = __pyx_f[0]; __pyx_lineno = 110; __pyx_clineno = __LINE__; goto __pyx_L1_error;}
  __Pyx_GOTREF(__pyx_t_1);
  __pyx_v_font = ((struct __pyx_obj_4kiva_6quartz_6CTFont_CTFont *)__pyx_t_1);
  __pyx_t_1 = 0;

  /* "kiva/quartz/CTFont.pyx":111
 *                     font_size, NULL)
 *         font = CTFont()
 *         font.set_pointer(ct_font)             # <<<<<<<<<<<<<<
 *         return font
 * 
 */
  __pyx_t_1 = ((struct __pyx_vtabstruct_4kiva_6quartz_6CTFont_CTFont *)__pyx_v_font->__pyx_vtab)->set_pointer(__pyx_v_font, __pyx_v_ct_font); if (unlikely(!__pyx_t_1)) {__pyx_filename = __pyx_f[0]; __pyx_lineno = 111; __pyx_clineno = __LINE__; goto __pyx_L1_error;}
  __Pyx_GOTREF(__pyx_t_1);
  __Pyx_DECREF(__pyx_t_1); __pyx_t_1 = 0;

  /* "kiva/quartz/CTFont.pyx":112
 *         font = CTFont()
 *         font.set_pointer(ct_font)
 *         return font             # <<<<<<<<<<<<<<
 * 
 *     property postcript_name:
 */
  __Pyx_XDECREF(__pyx_r);
  __Pyx_INCREF(((PyObject *)__pyx_v_font));
  __pyx_r = ((PyObject *)__pyx_v_font);
  goto __pyx_L0;

  __pyx_r = Py_None; __Pyx_INCREF(Py_None);
  goto __pyx_L0;
  __pyx_L1_error:;
  __Pyx_XDECREF(__pyx_t_1);
  __Pyx_AddTraceback("kiva.quartz.CTFont.CTFontStyle.get_font", __pyx_clineno, __pyx_lineno, __pyx_filename);
  __pyx_r = NULL;
  __pyx_L0:;
  __Pyx_XDECREF((PyObject *)__pyx_v_font);
  __Pyx_XGIVEREF(__pyx_r);
  __Pyx_RefNannyFinishContext();
  return __pyx_r;
}

/* Python wrapper */
static PyObject *__pyx_pw_4kiva_6quartz_6CTFont_11CTFontStyle_14postcript_name_1__get__(PyObject *__pyx_v_self); /*proto*/
static PyObject *__pyx_pw_4kiva_6quartz_6CTFont_11CTFontStyle_14postcript_name_1__get__(PyObject *__pyx_v_self) {
  PyObject *__pyx_r = 0;
  __Pyx_RefNannyDeclarations
  __Pyx_RefNannySetupContext("__get__ (wrapper)", 0);
  __pyx_r = __pyx_pf_4kiva_6quartz_6CTFont_11CTFontStyle_14postcript_name___get__(((struct __pyx_obj_4kiva_6quartz_6CTFont_CTFontStyle *)__pyx_v_self));
  __Pyx_RefNannyFinishContext();
  return __pyx_r;
}

/* "kiva/quartz/CTFont.pyx":115
 * 
 *     property postcript_name:
 *         def __get__(self):             # <<<<<<<<<<<<<<
 *             cdef CFStringRef cf_ps_name
 *             cf_ps_name = <CFStringRef>CTFontDescriptorCopyAttribute(self.ct_font_descriptor,
 */

static PyObject *__pyx_pf_4kiva_6quartz_6CTFont_11CTFontStyle_14postcript_name___get__(struct __pyx_obj_4kiva_6quartz_6CTFont_CTFontStyle *__pyx_v_self) {
  CFStringRef __pyx_v_cf_ps_name;
  PyObject *__pyx_v_retval = NULL;
  PyObject *__pyx_r = NULL;
  __Pyx_RefNannyDeclarations
  PyObject *__pyx_t_1 = NULL;
  int __pyx_lineno = 0;
  const char *__pyx_filename = NULL;
  int __pyx_clineno = 0;
  __Pyx_RefNannySetupContext("__get__", 0);

  /* "kiva/quartz/CTFont.pyx":118
 *             cdef CFStringRef cf_ps_name
 *             cf_ps_name = <CFStringRef>CTFontDescriptorCopyAttribute(self.ct_font_descriptor,
 *                                         kCTFontNameAttribute)             # <<<<<<<<<<<<<<
 *             retval = _cf_string_to_pystring(cf_ps_name)
 *             CFRelease(cf_ps_name)
 */
  __pyx_v_cf_ps_name = ((CFStringRef)CTFontDescriptorCopyAttribute(__pyx_v_self->ct_font_descriptor, kCTFontNameAttribute));

  /* "kiva/quartz/CTFont.pyx":119
 *             cf_ps_name = <CFStringRef>CTFontDescriptorCopyAttribute(self.ct_font_descriptor,
 *                                         kCTFontNameAttribute)
 *             retval = _cf_string_to_pystring(cf_ps_name)             # <<<<<<<<<<<<<<
 *             CFRelease(cf_ps_name)
 * 
 */
  __pyx_t_1 = __pyx_f_4kiva_6quartz_6CTFont__cf_string_to_pystring(__pyx_v_cf_ps_name); if (unlikely(!__pyx_t_1)) {__pyx_filename = __pyx_f[0]; __pyx_lineno = 119; __pyx_clineno = __LINE__; goto __pyx_L1_error;}
  __Pyx_GOTREF(__pyx_t_1);
  __pyx_v_retval = __pyx_t_1;
  __pyx_t_1 = 0;

  /* "kiva/quartz/CTFont.pyx":120
 *                                         kCTFontNameAttribute)
 *             retval = _cf_string_to_pystring(cf_ps_name)
 *             CFRelease(cf_ps_name)             # <<<<<<<<<<<<<<
 * 
 *             return retval
 */
  CFRelease(__pyx_v_cf_ps_name);

  /* "kiva/quartz/CTFont.pyx":122
 *             CFRelease(cf_ps_name)
 * 
 *             return retval             # <<<<<<<<<<<<<<
 * 
 *     cdef CFDictionaryRef _build_attribute_dictionary(self, name, style):
 */
  __Pyx_XDECREF(__pyx_r);
  __Pyx_INCREF(__pyx_v_retval);
  __pyx_r = __pyx_v_retval;
  goto __pyx_L0;

  __pyx_r = Py_None; __Pyx_INCREF(Py_None);
  goto __pyx_L0;
  __pyx_L1_error:;
  __Pyx_XDECREF(__pyx_t_1);
  __Pyx_AddTraceback("kiva.quartz.CTFont.CTFontStyle.postcript_name.__get__", __pyx_clineno, __pyx_lineno, __pyx_filename);
  __pyx_r = NULL;
  __pyx_L0:;
  __Pyx_XDECREF(__pyx_v_retval);
  __Pyx_XGIVEREF(__pyx_r);
  __Pyx_RefNannyFinishContext();
  return __pyx_r;
}

/* "kiva/quartz/CTFont.pyx":124
 *             return retval
 * 
 *     cdef CFDictionaryRef _build_attribute_dictionary(self, name, style):             # <<<<<<<<<<<<<<
 *         cdef CFStringRef cf_name, cf_style
 *         cdef CFMutableDictionaryRef cf_dict
 */

static CFDictionaryRef __pyx_f_4kiva_6quartz_6CTFont_11CTFontStyle__build_attribute_dictionary(CYTHON_UNUSED struct __pyx_obj_4kiva_6quartz_6CTFont_CTFontStyle *__pyx_v_self, PyObject *__pyx_v_name, PyObject *__pyx_v_style) {
  CFStringRef __pyx_v_cf_name;
  CFStringRef __pyx_v_cf_style;
  CFMutableDictionaryRef __pyx_v_cf_dict;
  PyObject *__pyx_v_mac_name = NULL;
  PyObject *__pyx_v_mac_style = NULL;
  PyObject *__pyx_v_msg = NULL;
  CFDictionaryRef __pyx_r;
  __Pyx_RefNannyDeclarations
  PyObject *__pyx_t_1 = NULL;
  PyObject *__pyx_t_2 = NULL;
  char *__pyx_t_3;
  int __pyx_t_4;
  int __pyx_lineno = 0;
  const char *__pyx_filename = NULL;
  int __pyx_clineno = 0;
  __Pyx_RefNannySetupContext("_build_attribute_dictionary", 0);
  __Pyx_INCREF(__pyx_v_style);

  /* "kiva/quartz/CTFont.pyx":128
 *         cdef CFMutableDictionaryRef cf_dict
 * 
 *         mac_name = name.strip().encode('utf-8')             # <<<<<<<<<<<<<<
 *         cf_name = CFStringCreateWithCString(NULL, mac_name,
 *             kCFStringEncodingUTF8)
 */
  __pyx_t_1 = __Pyx_PyObject_GetAttrStr(__pyx_v_name, __pyx_n_s__strip); if (unlikely(!__pyx_t_1)) {__pyx_filename = __pyx_f[0]; __pyx_lineno = 128; __pyx_clineno = __LINE__; goto __pyx_L1_error;}
  __Pyx_GOTREF(__pyx_t_1);
  __pyx_t_2 = PyObject_Call(__pyx_t_1, ((PyObject *)__pyx_empty_tuple), NULL); if (unlikely(!__pyx_t_2)) {__pyx_filename = __pyx_f[0]; __pyx_lineno = 128; __pyx_clineno = __LINE__; goto __pyx_L1_error;}
  __Pyx_GOTREF(__pyx_t_2);
  __Pyx_DECREF(__pyx_t_1); __pyx_t_1 = 0;
  __pyx_t_1 = __Pyx_PyObject_GetAttrStr(__pyx_t_2, __pyx_n_s__encode); if (unlikely(!__pyx_t_1)) {__pyx_filename = __pyx_f[0]; __pyx_lineno = 128; __pyx_clineno = __LINE__; goto __pyx_L1_error;}
  __Pyx_GOTREF(__pyx_t_1);
  __Pyx_DECREF(__pyx_t_2); __pyx_t_2 = 0;
  __pyx_t_2 = PyObject_Call(__pyx_t_1, ((PyObject *)__pyx_k_tuple_3), NULL); if (unlikely(!__pyx_t_2)) {__pyx_filename = __pyx_f[0]; __pyx_lineno = 128; __pyx_clineno = __LINE__; goto __pyx_L1_error;}
  __Pyx_GOTREF(__pyx_t_2);
  __Pyx_DECREF(__pyx_t_1); __pyx_t_1 = 0;
  __pyx_v_mac_name = __pyx_t_2;
  __pyx_t_2 = 0;

  /* "kiva/quartz/CTFont.pyx":129
 * 
 *         mac_name = name.strip().encode('utf-8')
 *         cf_name = CFStringCreateWithCString(NULL, mac_name,             # <<<<<<<<<<<<<<
 *             kCFStringEncodingUTF8)
 * 
 */
  __pyx_t_3 = __Pyx_PyObject_AsString(__pyx_v_mac_name); if (unlikely((!__pyx_t_3) && PyErr_Occurred())) {__pyx_filename = __pyx_f[0]; __pyx_lineno = 129; __pyx_clineno = __LINE__; goto __pyx_L1_error;}

  /* "kiva/quartz/CTFont.pyx":130
 *         mac_name = name.strip().encode('utf-8')
 *         cf_name = CFStringCreateWithCString(NULL, mac_name,
 *             kCFStringEncodingUTF8)             # <<<<<<<<<<<<<<
 * 
 *         style = style.title()
 */
  __pyx_v_cf_name = CFStringCreateWithCString(NULL, __pyx_t_3, kCFStringEncodingUTF8);

  /* "kiva/quartz/CTFont.pyx":132
 *             kCFStringEncodingUTF8)
 * 
 *         style = style.title()             # <<<<<<<<<<<<<<
 *         mac_style = style.strip().encode('utf-8')
 *         cf_style = CFStringCreateWithCString(NULL, mac_style,
 */
  __pyx_t_2 = __Pyx_PyObject_GetAttrStr(__pyx_v_style, __pyx_n_s__title); if (unlikely(!__pyx_t_2)) {__pyx_filename = __pyx_f[0]; __pyx_lineno = 132; __pyx_clineno = __LINE__; goto __pyx_L1_error;}
  __Pyx_GOTREF(__pyx_t_2);
  __pyx_t_1 = PyObject_Call(__pyx_t_2, ((PyObject *)__pyx_empty_tuple), NULL); if (unlikely(!__pyx_t_1)) {__pyx_filename = __pyx_f[0]; __pyx_lineno = 132; __pyx_clineno = __LINE__; goto __pyx_L1_error;}
  __Pyx_GOTREF(__pyx_t_1);
  __Pyx_DECREF(__pyx_t_2); __pyx_t_2 = 0;
  __Pyx_DECREF_SET(__pyx_v_style, __pyx_t_1);
  __pyx_t_1 = 0;

  /* "kiva/quartz/CTFont.pyx":133
 * 
 *         style = style.title()
 *         mac_style = style.strip().encode('utf-8')             # <<<<<<<<<<<<<<
 *         cf_style = CFStringCreateWithCString(NULL, mac_style,
 *             kCFStringEncodingUTF8)
 */
  __pyx_t_1 = __Pyx_PyObject_GetAttrStr(__pyx_v_style, __pyx_n_s__strip); if (unlikely(!__pyx_t_1)) {__pyx_filename = __pyx_f[0]; __pyx_lineno = 133; __pyx_clineno = __LINE__; goto __pyx_L1_error;}
  __Pyx_GOTREF(__pyx_t_1);
  __pyx_t_2 = PyObject_Call(__pyx_t_1, ((PyObject *)__pyx_empty_tuple), NULL); if (unlikely(!__pyx_t_2)) {__pyx_filename = __pyx_f[0]; __pyx_lineno = 133; __pyx_clineno = __LINE__; goto __pyx_L1_error;}
  __Pyx_GOTREF(__pyx_t_2);
  __Pyx_DECREF(__pyx_t_1); __pyx_t_1 = 0;
  __pyx_t_1 = __Pyx_PyObject_GetAttrStr(__pyx_t_2, __pyx_n_s__encode); if (unlikely(!__pyx_t_1)) {__pyx_filename = __pyx_f[0]; __pyx_lineno = 133; __pyx_clineno = __LINE__; goto __pyx_L1_error;}
  __Pyx_GOTREF(__pyx_t_1);
  __Pyx_DECREF(__pyx_t_2); __pyx_t_2 = 0;
  __pyx_t_2 = PyObject_Call(__pyx_t_1, ((PyObject *)__pyx_k_tuple_4), NULL); if (unlikely(!__pyx_t_2)) {__pyx_filename = __pyx_f[0]; __pyx_lineno = 133; __pyx_clineno = __LINE__; goto __pyx_L1_error;}
  __Pyx_GOTREF(__pyx_t_2);
  __Pyx_DECREF(__pyx_t_1); __pyx_t_1 = 0;
  __pyx_v_mac_style = __pyx_t_2;
  __pyx_t_2 = 0;

  /* "kiva/quartz/CTFont.pyx":134
 *         style = style.title()
 *         mac_style = style.strip().encode('utf-8')
 *         cf_style = CFStringCreateWithCString(NULL, mac_style,             # <<<<<<<<<<<<<<
 *             kCFStringEncodingUTF8)
 * 
 */
  __pyx_t_3 = __Pyx_PyObject_AsString(__pyx_v_mac_style); if (unlikely((!__pyx_t_3) && PyErr_Occurred())) {__pyx_filename = __pyx_f[0]; __pyx_lineno = 134; __pyx_clineno = __LINE__; goto __pyx_L1_error;}

  /* "kiva/quartz/CTFont.pyx":135
 *         mac_style = style.strip().encode('utf-8')
 *         cf_style = CFStringCreateWithCString(NULL, mac_style,
 *             kCFStringEncodingUTF8)             # <<<<<<<<<<<<<<
 * 
 *         cf_dict = CFDictionaryCreateMutable(NULL, 0,
 */
  __pyx_v_cf_style = CFStringCreateWithCString(NULL, __pyx_t_3, kCFStringEncodingUTF8);

  /* "kiva/quartz/CTFont.pyx":139
 *         cf_dict = CFDictionaryCreateMutable(NULL, 0,
 *                     &kCFTypeDictionaryKeyCallBacks,
 *                     &kCFTypeDictionaryValueCallBacks)             # <<<<<<<<<<<<<<
 * 
 *         if cf_dict != NULL:
 */
  __pyx_v_cf_dict = CFDictionaryCreateMutable(NULL, 0, (&kCFTypeDictionaryKeyCallBacks), (&kCFTypeDictionaryValueCallBacks));

  /* "kiva/quartz/CTFont.pyx":141
 *                     &kCFTypeDictionaryValueCallBacks)
 * 
 *         if cf_dict != NULL:             # <<<<<<<<<<<<<<
 *             CFDictionaryAddValue(cf_dict, <void*>kCTFontFamilyNameAttribute, cf_name)
 *             CFDictionaryAddValue(cf_dict, <void*>kCTFontStyleNameAttribute, cf_style)
 */
  __pyx_t_4 = ((__pyx_v_cf_dict != NULL) != 0);
  if (__pyx_t_4) {

    /* "kiva/quartz/CTFont.pyx":142
 * 
 *         if cf_dict != NULL:
 *             CFDictionaryAddValue(cf_dict, <void*>kCTFontFamilyNameAttribute, cf_name)             # <<<<<<<<<<<<<<
 *             CFDictionaryAddValue(cf_dict, <void*>kCTFontStyleNameAttribute, cf_style)
 *         else:
 */
    CFDictionaryAddValue(__pyx_v_cf_dict, ((void *)kCTFontFamilyNameAttribute), __pyx_v_cf_name);

    /* "kiva/quartz/CTFont.pyx":143
 *         if cf_dict != NULL:
 *             CFDictionaryAddValue(cf_dict, <void*>kCTFontFamilyNameAttribute, cf_name)
 *             CFDictionaryAddValue(cf_dict, <void*>kCTFontStyleNameAttribute, cf_style)             # <<<<<<<<<<<<<<
 *         else:
 *             msg = "unknown error building descriptor dictionary for font %r"%mac_name
 */
    CFDictionaryAddValue(__pyx_v_cf_dict, ((void *)kCTFontStyleNameAttribute), __pyx_v_cf_style);
    goto __pyx_L3;
  }
  /*else*/ {

    /* "kiva/quartz/CTFont.pyx":145
 *             CFDictionaryAddValue(cf_dict, <void*>kCTFontStyleNameAttribute, cf_style)
 *         else:
 *             msg = "unknown error building descriptor dictionary for font %r"%mac_name             # <<<<<<<<<<<<<<
 *             raise RuntimeError(msg)
 * 
 */
    __pyx_t_2 = PyNumber_Remainder(((PyObject *)__pyx_kp_s_5), __pyx_v_mac_name); if (unlikely(!__pyx_t_2)) {__pyx_filename = __pyx_f[0]; __pyx_lineno = 145; __pyx_clineno = __LINE__; goto __pyx_L1_error;}
    __Pyx_GOTREF(((PyObject *)__pyx_t_2));
    __pyx_v_msg = ((PyObject *)__pyx_t_2);
    __pyx_t_2 = 0;

    /* "kiva/quartz/CTFont.pyx":146
 *         else:
 *             msg = "unknown error building descriptor dictionary for font %r"%mac_name
 *             raise RuntimeError(msg)             # <<<<<<<<<<<<<<
 * 
 *         CFRelease(cf_name)
 */
    __pyx_t_2 = PyTuple_New(1); if (unlikely(!__pyx_t_2)) {__pyx_filename = __pyx_f[0]; __pyx_lineno = 146; __pyx_clineno = __LINE__; goto __pyx_L1_error;}
    __Pyx_GOTREF(__pyx_t_2);
    __Pyx_INCREF(__pyx_v_msg);
    PyTuple_SET_ITEM(__pyx_t_2, 0, __pyx_v_msg);
    __Pyx_GIVEREF(__pyx_v_msg);
    __pyx_t_1 = PyObject_Call(__pyx_builtin_RuntimeError, ((PyObject *)__pyx_t_2), NULL); if (unlikely(!__pyx_t_1)) {__pyx_filename = __pyx_f[0]; __pyx_lineno = 146; __pyx_clineno = __LINE__; goto __pyx_L1_error;}
    __Pyx_GOTREF(__pyx_t_1);
    __Pyx_DECREF(((PyObject *)__pyx_t_2)); __pyx_t_2 = 0;
    __Pyx_Raise(__pyx_t_1, 0, 0, 0);
    __Pyx_DECREF(__pyx_t_1); __pyx_t_1 = 0;
    {__pyx_filename = __pyx_f[0]; __pyx_lineno = 146; __pyx_clineno = __LINE__; goto __pyx_L1_error;}
  }
  __pyx_L3:;

  /* "kiva/quartz/CTFont.pyx":148
 *             raise RuntimeError(msg)
 * 
 *         CFRelease(cf_name)             # <<<<<<<<<<<<<<
 *         CFRelease(cf_style)
 * 
 */
  CFRelease(__pyx_v_cf_name);

  /* "kiva/quartz/CTFont.pyx":149
 * 
 *         CFRelease(cf_name)
 *         CFRelease(cf_style)             # <<<<<<<<<<<<<<
 * 
 *         return cf_dict
 */
  CFRelease(__pyx_v_cf_style);

  /* "kiva/quartz/CTFont.pyx":151
 *         CFRelease(cf_style)
 * 
 *         return cf_dict             # <<<<<<<<<<<<<<
 * 
 * 
 */
  __pyx_r = __pyx_v_cf_dict;
  goto __pyx_L0;

  __pyx_r = 0;
  goto __pyx_L0;
  __pyx_L1_error:;
  __Pyx_XDECREF(__pyx_t_1);
  __Pyx_XDECREF(__pyx_t_2);
  __Pyx_WriteUnraisable("kiva.quartz.CTFont.CTFontStyle._build_attribute_dictionary", __pyx_clineno, __pyx_lineno, __pyx_filename);
  __pyx_r = 0;
  __pyx_L0:;
  __Pyx_XDECREF(__pyx_v_mac_name);
  __Pyx_XDECREF(__pyx_v_mac_style);
  __Pyx_XDECREF(__pyx_v_msg);
  __Pyx_XDECREF(__pyx_v_style);
  __Pyx_RefNannyFinishContext();
  return __pyx_r;
}

/* Python wrapper */
static PyObject *__pyx_pw_4kiva_6quartz_6CTFont_11CTFontStyle_11family_name_1__get__(PyObject *__pyx_v_self); /*proto*/
static PyObject *__pyx_pw_4kiva_6quartz_6CTFont_11CTFontStyle_11family_name_1__get__(PyObject *__pyx_v_self) {
  PyObject *__pyx_r = 0;
  __Pyx_RefNannyDeclarations
  __Pyx_RefNannySetupContext("__get__ (wrapper)", 0);
  __pyx_r = __pyx_pf_4kiva_6quartz_6CTFont_11CTFontStyle_11family_name___get__(((struct __pyx_obj_4kiva_6quartz_6CTFont_CTFontStyle *)__pyx_v_self));
  __Pyx_RefNannyFinishContext();
  return __pyx_r;
}

/* "kiva/quartz/CTFont.pyx":70
 *     cdef CTFontDescriptorRef ct_font_descriptor
 *     cdef CFDictionaryRef attribute_dictionary
 *     cdef readonly object family_name             # <<<<<<<<<<<<<<
 *     cdef readonly object style
 * 
 */

static PyObject *__pyx_pf_4kiva_6quartz_6CTFont_11CTFontStyle_11family_name___get__(struct __pyx_obj_4kiva_6quartz_6CTFont_CTFontStyle *__pyx_v_self) {
  PyObject *__pyx_r = NULL;
  __Pyx_RefNannyDeclarations
  __Pyx_RefNannySetupContext("__get__", 0);
  __Pyx_XDECREF(__pyx_r);
  __Pyx_INCREF(__pyx_v_self->family_name);
  __pyx_r = __pyx_v_self->family_name;
  goto __pyx_L0;

  __pyx_r = Py_None; __Pyx_INCREF(Py_None);
  __pyx_L0:;
  __Pyx_XGIVEREF(__pyx_r);
  __Pyx_RefNannyFinishContext();
  return __pyx_r;
}

/* Python wrapper */
static PyObject *__pyx_pw_4kiva_6quartz_6CTFont_11CTFontStyle_5style_1__get__(PyObject *__pyx_v_self); /*proto*/
static PyObject *__pyx_pw_4kiva_6quartz_6CTFont_11CTFontStyle_5style_1__get__(PyObject *__pyx_v_self) {
  PyObject *__pyx_r = 0;
  __Pyx_RefNannyDeclarations
  __Pyx_RefNannySetupContext("__get__ (wrapper)", 0);
  __pyx_r = __pyx_pf_4kiva_6quartz_6CTFont_11CTFontStyle_5style___get__(((struct __pyx_obj_4kiva_6quartz_6CTFont_CTFontStyle *)__pyx_v_self));
  __Pyx_RefNannyFinishContext();
  return __pyx_r;
}

/* "kiva/quartz/CTFont.pyx":71
 *     cdef CFDictionaryRef attribute_dictionary
 *     cdef readonly object family_name
 *     cdef readonly object style             # <<<<<<<<<<<<<<
 * 
 *     def __cinit__(self, *args, **kwargs):
 */

static PyObject *__pyx_pf_4kiva_6quartz_6CTFont_11CTFontStyle_5style___get__(struct __pyx_obj_4kiva_6quartz_6CTFont_CTFontStyle *__pyx_v_self) {
  PyObject *__pyx_r = NULL;
  __Pyx_RefNannyDeclarations
  __Pyx_RefNannySetupContext("__get__", 0);
  __Pyx_XDECREF(__pyx_r);
  __Pyx_INCREF(__pyx_v_self->style);
  __pyx_r = __pyx_v_self->style;
  goto __pyx_L0;

  __pyx_r = Py_None; __Pyx_INCREF(Py_None);
  __pyx_L0:;
  __Pyx_XGIVEREF(__pyx_r);
  __Pyx_RefNannyFinishContext();
  return __pyx_r;
}

/* Python wrapper */
static PyObject *__pyx_pw_4kiva_6quartz_6CTFont_10FontLookup_1lookup(PyObject *__pyx_v_self, PyObject *__pyx_args, PyObject *__pyx_kwds); /*proto*/
static PyObject *__pyx_pw_4kiva_6quartz_6CTFont_10FontLookup_1lookup(PyObject *__pyx_v_self, PyObject *__pyx_args, PyObject *__pyx_kwds) {
  PyObject *__pyx_v_name = 0;
  PyObject *__pyx_v_style = 0;
  int __pyx_lineno = 0;
  const char *__pyx_filename = NULL;
  int __pyx_clineno = 0;
  PyObject *__pyx_r = 0;
  __Pyx_RefNannyDeclarations
  __Pyx_RefNannySetupContext("lookup (wrapper)", 0);
  {
    static PyObject **__pyx_pyargnames[] = {&__pyx_n_s__name,&__pyx_n_s__style,0};
    PyObject* values[2] = {0,0};

    /* "kiva/quartz/CTFont.pyx":158
 *     cdef public object default_font
 * 
 *     def lookup(self, name=None, style='regular'):             # <<<<<<<<<<<<<<
 *         return CTFontStyle(name or self.default_font, style)
 * 
 */
    values[0] = ((PyObject *)Py_None);
    values[1] = ((PyObject *)__pyx_n_s__regular);
    if (unlikely(__pyx_kwds)) {
      Py_ssize_t kw_args;
      const Py_ssize_t pos_args = PyTuple_GET_SIZE(__pyx_args);
      switch (pos_args) {
        case  2: values[1] = PyTuple_GET_ITEM(__pyx_args, 1);
        case  1: values[0] = PyTuple_GET_ITEM(__pyx_args, 0);
        case  0: break;
        default: goto __pyx_L5_argtuple_error;
      }
      kw_args = PyDict_Size(__pyx_kwds);
      switch (pos_args) {
        case  0:
        if (kw_args > 0) {
          PyObject* value = PyDict_GetItem(__pyx_kwds, __pyx_n_s__name);
          if (value) { values[0] = value; kw_args--; }
        }
        case  1:
        if (kw_args > 0) {
          PyObject* value = PyDict_GetItem(__pyx_kwds, __pyx_n_s__style);
          if (value) { values[1] = value; kw_args--; }
        }
      }
      if (unlikely(kw_args > 0)) {
        if (unlikely(__Pyx_ParseOptionalKeywords(__pyx_kwds, __pyx_pyargnames, 0, values, pos_args, "lookup") < 0)) {__pyx_filename = __pyx_f[0]; __pyx_lineno = 158; __pyx_clineno = __LINE__; goto __pyx_L3_error;}
      }
    } else {
      switch (PyTuple_GET_SIZE(__pyx_args)) {
        case  2: values[1] = PyTuple_GET_ITEM(__pyx_args, 1);
        case  1: values[0] = PyTuple_GET_ITEM(__pyx_args, 0);
        case  0: break;
        default: goto __pyx_L5_argtuple_error;
      }
    }
    __pyx_v_name = values[0];
    __pyx_v_style = values[1];
  }
  goto __pyx_L4_argument_unpacking_done;
  __pyx_L5_argtuple_error:;
  __Pyx_RaiseArgtupleInvalid("lookup", 0, 0, 2, PyTuple_GET_SIZE(__pyx_args)); {__pyx_filename = __pyx_f[0]; __pyx_lineno = 158; __pyx_clineno = __LINE__; goto __pyx_L3_error;}
  __pyx_L3_error:;
  __Pyx_AddTraceback("kiva.quartz.CTFont.FontLookup.lookup", __pyx_clineno, __pyx_lineno, __pyx_filename);
  __Pyx_RefNannyFinishContext();
  return NULL;
  __pyx_L4_argument_unpacking_done:;
  __pyx_r = __pyx_pf_4kiva_6quartz_6CTFont_10FontLookup_lookup(((struct __pyx_obj_4kiva_6quartz_6CTFont_FontLookup *)__pyx_v_self), __pyx_v_name, __pyx_v_style);
  __Pyx_RefNannyFinishContext();
  return __pyx_r;
}

static PyObject *__pyx_pf_4kiva_6quartz_6CTFont_10FontLookup_lookup(struct __pyx_obj_4kiva_6quartz_6CTFont_FontLookup *__pyx_v_self, PyObject *__pyx_v_name, PyObject *__pyx_v_style) {
  PyObject *__pyx_r = NULL;
  __Pyx_RefNannyDeclarations
  int __pyx_t_1;
  PyObject *__pyx_t_2 = NULL;
  PyObject *__pyx_t_3 = NULL;
  int __pyx_lineno = 0;
  const char *__pyx_filename = NULL;
  int __pyx_clineno = 0;
  __Pyx_RefNannySetupContext("lookup", 0);

  /* "kiva/quartz/CTFont.pyx":159
 * 
 *     def lookup(self, name=None, style='regular'):
 *         return CTFontStyle(name or self.default_font, style)             # <<<<<<<<<<<<<<
 * 
 *     def names(self):
 */
  __Pyx_XDECREF(__pyx_r);
  __pyx_t_1 = __Pyx_PyObject_IsTrue(__pyx_v_name); if (unlikely(__pyx_t_1 < 0)) {__pyx_filename = __pyx_f[0]; __pyx_lineno = 159; __pyx_clineno = __LINE__; goto __pyx_L1_error;}
  if (!__pyx_t_1) {
    __Pyx_INCREF(__pyx_v_self->default_font);
    __pyx_t_2 = __pyx_v_self->default_font;
  } else {
    __Pyx_INCREF(__pyx_v_name);
    __pyx_t_2 = __pyx_v_name;
  }
  __pyx_t_3 = PyTuple_New(2); if (unlikely(!__pyx_t_3)) {__pyx_filename = __pyx_f[0]; __pyx_lineno = 159; __pyx_clineno = __LINE__; goto __pyx_L1_error;}
  __Pyx_GOTREF(__pyx_t_3);
  PyTuple_SET_ITEM(__pyx_t_3, 0, __pyx_t_2);
  __Pyx_GIVEREF(__pyx_t_2);
  __Pyx_INCREF(__pyx_v_style);
  PyTuple_SET_ITEM(__pyx_t_3, 1, __pyx_v_style);
  __Pyx_GIVEREF(__pyx_v_style);
  __pyx_t_2 = 0;
  __pyx_t_2 = PyObject_Call(((PyObject *)((PyObject*)__pyx_ptype_4kiva_6quartz_6CTFont_CTFontStyle)), ((PyObject *)__pyx_t_3), NULL); if (unlikely(!__pyx_t_2)) {__pyx_filename = __pyx_f[0]; __pyx_lineno = 159; __pyx_clineno = __LINE__; goto __pyx_L1_error;}
  __Pyx_GOTREF(__pyx_t_2);
  __Pyx_DECREF(((PyObject *)__pyx_t_3)); __pyx_t_3 = 0;
  __pyx_r = __pyx_t_2;
  __pyx_t_2 = 0;
  goto __pyx_L0;

  __pyx_r = Py_None; __Pyx_INCREF(Py_None);
  goto __pyx_L0;
  __pyx_L1_error:;
  __Pyx_XDECREF(__pyx_t_2);
  __Pyx_XDECREF(__pyx_t_3);
  __Pyx_AddTraceback("kiva.quartz.CTFont.FontLookup.lookup", __pyx_clineno, __pyx_lineno, __pyx_filename);
  __pyx_r = NULL;
  __pyx_L0:;
  __Pyx_XGIVEREF(__pyx_r);
  __Pyx_RefNannyFinishContext();
  return __pyx_r;
}

/* Python wrapper */
static PyObject *__pyx_pw_4kiva_6quartz_6CTFont_10FontLookup_3names(PyObject *__pyx_v_self, CYTHON_UNUSED PyObject *unused); /*proto*/
static PyObject *__pyx_pw_4kiva_6quartz_6CTFont_10FontLookup_3names(PyObject *__pyx_v_self, CYTHON_UNUSED PyObject *unused) {
  PyObject *__pyx_r = 0;
  __Pyx_RefNannyDeclarations
  __Pyx_RefNannySetupContext("names (wrapper)", 0);
  __pyx_r = __pyx_pf_4kiva_6quartz_6CTFont_10FontLookup_2names(((struct __pyx_obj_4kiva_6quartz_6CTFont_FontLookup *)__pyx_v_self));
  __Pyx_RefNannyFinishContext();
  return __pyx_r;
}

/* "kiva/quartz/CTFont.pyx":161
 *         return CTFontStyle(name or self.default_font, style)
 * 
 *     def names(self):             # <<<<<<<<<<<<<<
 *         cdef CFIndex idx, count
 *         cdef CFStringRef cf_fam_name
 */

static PyObject *__pyx_pf_4kiva_6quartz_6CTFont_10FontLookup_2names(CYTHON_UNUSED struct __pyx_obj_4kiva_6quartz_6CTFont_FontLookup *__pyx_v_self) {
  CFIndex __pyx_v_idx;
  CFIndex __pyx_v_count;
  CFStringRef __pyx_v_cf_fam_name;
  CFArrayRef __pyx_v_cf_font_descriptors;
  CTFontDescriptorRef __pyx_v_cf_font_descriptor;
  PyObject *__pyx_v_families = NULL;
  PyObject *__pyx_r = NULL;
  __Pyx_RefNannyDeclarations
  PyObject *__pyx_t_1 = NULL;
  CFIndex __pyx_t_2;
  int __pyx_t_3;
  PyObject *__pyx_t_4 = NULL;
  int __pyx_lineno = 0;
  const char *__pyx_filename = NULL;
  int __pyx_clineno = 0;
  __Pyx_RefNannySetupContext("names", 0);

  /* "kiva/quartz/CTFont.pyx":167
 *         cdef CTFontDescriptorRef cf_font_descriptor
 * 
 *         cf_font_descriptors = _get_system_fonts()             # <<<<<<<<<<<<<<
 *         families = []
 *         count = CFArrayGetCount(cf_font_descriptors)
 */
  __pyx_v_cf_font_descriptors = __pyx_f_4kiva_6quartz_6CTFont__get_system_fonts();

  /* "kiva/quartz/CTFont.pyx":168
 * 
 *         cf_font_descriptors = _get_system_fonts()
 *         families = []             # <<<<<<<<<<<<<<
 *         count = CFArrayGetCount(cf_font_descriptors)
 *         for idx from 0 <= idx < count:
 */
  __pyx_t_1 = PyList_New(0); if (unlikely(!__pyx_t_1)) {__pyx_filename = __pyx_f[0]; __pyx_lineno = 168; __pyx_clineno = __LINE__; goto __pyx_L1_error;}
  __Pyx_GOTREF(__pyx_t_1);
  __pyx_v_families = ((PyObject*)__pyx_t_1);
  __pyx_t_1 = 0;

  /* "kiva/quartz/CTFont.pyx":169
 *         cf_font_descriptors = _get_system_fonts()
 *         families = []
 *         count = CFArrayGetCount(cf_font_descriptors)             # <<<<<<<<<<<<<<
 *         for idx from 0 <= idx < count:
 *             cf_font_descriptor = <CTFontDescriptorRef>CFArrayGetValueAtIndex(cf_font_descriptors, idx)
 */
  __pyx_v_count = CFArrayGetCount(__pyx_v_cf_font_descriptors);

  /* "kiva/quartz/CTFont.pyx":170
 *         families = []
 *         count = CFArrayGetCount(cf_font_descriptors)
 *         for idx from 0 <= idx < count:             # <<<<<<<<<<<<<<
 *             cf_font_descriptor = <CTFontDescriptorRef>CFArrayGetValueAtIndex(cf_font_descriptors, idx)
 *             cf_fam_name = <CFStringRef>CTFontDescriptorCopyAttribute(cf_font_descriptor,
 */
  __pyx_t_2 = __pyx_v_count;
  for (__pyx_v_idx = 0; __pyx_v_idx < __pyx_t_2; __pyx_v_idx++) {

    /* "kiva/quartz/CTFont.pyx":171
 *         count = CFArrayGetCount(cf_font_descriptors)
 *         for idx from 0 <= idx < count:
 *             cf_font_descriptor = <CTFontDescriptorRef>CFArrayGetValueAtIndex(cf_font_descriptors, idx)             # <<<<<<<<<<<<<<
 *             cf_fam_name = <CFStringRef>CTFontDescriptorCopyAttribute(cf_font_descriptor,
 *                                         kCTFontFamilyNameAttribute)
 */
    __pyx_v_cf_font_descriptor = ((CTFontDescriptorRef)CFArrayGetValueAtIndex(__pyx_v_cf_font_descriptors, __pyx_v_idx));

    /* "kiva/quartz/CTFont.pyx":173
 *             cf_font_descriptor = <CTFontDescriptorRef>CFArrayGetValueAtIndex(cf_font_descriptors, idx)
 *             cf_fam_name = <CFStringRef>CTFontDescriptorCopyAttribute(cf_font_descriptor,
 *                                         kCTFontFamilyNameAttribute)             # <<<<<<<<<<<<<<
 *             families.append(_cf_string_to_pystring(cf_fam_name))
 *             CFRelease(cf_fam_name)
 */
    __pyx_v_cf_fam_name = ((CFStringRef)CTFontDescriptorCopyAttribute(__pyx_v_cf_font_descriptor, kCTFontFamilyNameAttribute));

    /* "kiva/quartz/CTFont.pyx":174
 *             cf_fam_name = <CFStringRef>CTFontDescriptorCopyAttribute(cf_font_descriptor,
 *                                         kCTFontFamilyNameAttribute)
 *             families.append(_cf_string_to_pystring(cf_fam_name))             # <<<<<<<<<<<<<<
 *             CFRelease(cf_fam_name)
 *         CFRelease(cf_font_descriptors)
 */
    __pyx_t_1 = __pyx_f_4kiva_6quartz_6CTFont__cf_string_to_pystring(__pyx_v_cf_fam_name); if (unlikely(!__pyx_t_1)) {__pyx_filename = __pyx_f[0]; __pyx_lineno = 174; __pyx_clineno = __LINE__; goto __pyx_L1_error;}
    __Pyx_GOTREF(__pyx_t_1);
    __pyx_t_3 = __Pyx_PyList_Append(__pyx_v_families, __pyx_t_1); if (unlikely(__pyx_t_3 == -1)) {__pyx_filename = __pyx_f[0]; __pyx_lineno = 174; __pyx_clineno = __LINE__; goto __pyx_L1_error;}
    __Pyx_DECREF(__pyx_t_1); __pyx_t_1 = 0;

    /* "kiva/quartz/CTFont.pyx":175
 *                                         kCTFontFamilyNameAttribute)
 *             families.append(_cf_string_to_pystring(cf_fam_name))
 *             CFRelease(cf_fam_name)             # <<<<<<<<<<<<<<
 *         CFRelease(cf_font_descriptors)
 * 
 */
    CFRelease(__pyx_v_cf_fam_name);
  }

  /* "kiva/quartz/CTFont.pyx":176
 *             families.append(_cf_string_to_pystring(cf_fam_name))
 *             CFRelease(cf_fam_name)
 *         CFRelease(cf_font_descriptors)             # <<<<<<<<<<<<<<
 * 
 *         families.sort()
 */
  CFRelease(__pyx_v_cf_font_descriptors);

  /* "kiva/quartz/CTFont.pyx":178
 *         CFRelease(cf_font_descriptors)
 * 
 *         families.sort()             # <<<<<<<<<<<<<<
 *         return list(set(families))
 * 
 */
  __pyx_t_3 = PyList_Sort(((PyObject *)__pyx_v_families)); if (unlikely(__pyx_t_3 == -1)) {__pyx_filename = __pyx_f[0]; __pyx_lineno = 178; __pyx_clineno = __LINE__; goto __pyx_L1_error;}

  /* "kiva/quartz/CTFont.pyx":179
 * 
 *         families.sort()
 *         return list(set(families))             # <<<<<<<<<<<<<<
 * 
 *     def styles(self, font_name):
 */
  __Pyx_XDECREF(__pyx_r);
  __pyx_t_1 = PyTuple_New(1); if (unlikely(!__pyx_t_1)) {__pyx_filename = __pyx_f[0]; __pyx_lineno = 179; __pyx_clineno = __LINE__; goto __pyx_L1_error;}
  __Pyx_GOTREF(__pyx_t_1);
  __Pyx_INCREF(((PyObject *)__pyx_v_families));
  PyTuple_SET_ITEM(__pyx_t_1, 0, ((PyObject *)__pyx_v_families));
  __Pyx_GIVEREF(((PyObject *)__pyx_v_families));
  __pyx_t_4 = PyObject_Call(((PyObject *)((PyObject*)(&PySet_Type))), ((PyObject *)__pyx_t_1), NULL); if (unlikely(!__pyx_t_4)) {__pyx_filename = __pyx_f[0]; __pyx_lineno = 179; __pyx_clineno = __LINE__; goto __pyx_L1_error;}
  __Pyx_GOTREF(__pyx_t_4);
  __Pyx_DECREF(((PyObject *)__pyx_t_1)); __pyx_t_1 = 0;
  __pyx_t_1 = PyTuple_New(1); if (unlikely(!__pyx_t_1)) {__pyx_filename = __pyx_f[0]; __pyx_lineno = 179; __pyx_clineno = __LINE__; goto __pyx_L1_error;}
  __Pyx_GOTREF(__pyx_t_1);
  PyTuple_SET_ITEM(__pyx_t_1, 0, __pyx_t_4);
  __Pyx_GIVEREF(__pyx_t_4);
  __pyx_t_4 = 0;
  __pyx_t_4 = PyObject_Call(((PyObject *)((PyObject*)(&PyList_Type))), ((PyObject *)__pyx_t_1), NULL); if (unlikely(!__pyx_t_4)) {__pyx_filename = __pyx_f[0]; __pyx_lineno = 179; __pyx_clineno = __LINE__; goto __pyx_L1_error;}
  __Pyx_GOTREF(__pyx_t_4);
  __Pyx_DECREF(((PyObject *)__pyx_t_1)); __pyx_t_1 = 0;
  __pyx_r = __pyx_t_4;
  __pyx_t_4 = 0;
  goto __pyx_L0;

  __pyx_r = Py_None; __Pyx_INCREF(Py_None);
  goto __pyx_L0;
  __pyx_L1_error:;
  __Pyx_XDECREF(__pyx_t_1);
  __Pyx_XDECREF(__pyx_t_4);
  __Pyx_AddTraceback("kiva.quartz.CTFont.FontLookup.names", __pyx_clineno, __pyx_lineno, __pyx_filename);
  __pyx_r = NULL;
  __pyx_L0:;
  __Pyx_XDECREF(__pyx_v_families);
  __Pyx_XGIVEREF(__pyx_r);
  __Pyx_RefNannyFinishContext();
  return __pyx_r;
}

/* Python wrapper */
static PyObject *__pyx_pw_4kiva_6quartz_6CTFont_10FontLookup_5styles(PyObject *__pyx_v_self, PyObject *__pyx_v_font_name); /*proto*/
static PyObject *__pyx_pw_4kiva_6quartz_6CTFont_10FontLookup_5styles(PyObject *__pyx_v_self, PyObject *__pyx_v_font_name) {
  PyObject *__pyx_r = 0;
  __Pyx_RefNannyDeclarations
  __Pyx_RefNannySetupContext("styles (wrapper)", 0);
  __pyx_r = __pyx_pf_4kiva_6quartz_6CTFont_10FontLookup_4styles(((struct __pyx_obj_4kiva_6quartz_6CTFont_FontLookup *)__pyx_v_self), ((PyObject *)__pyx_v_font_name));
  __Pyx_RefNannyFinishContext();
  return __pyx_r;
}

/* "kiva/quartz/CTFont.pyx":181
 *         return list(set(families))
 * 
 *     def styles(self, font_name):             # <<<<<<<<<<<<<<
 *         raise NotImplementedError
 * 
 */

static PyObject *__pyx_pf_4kiva_6quartz_6CTFont_10FontLookup_4styles(CYTHON_UNUSED struct __pyx_obj_4kiva_6quartz_6CTFont_FontLookup *__pyx_v_self, CYTHON_UNUSED PyObject *__pyx_v_font_name) {
  PyObject *__pyx_r = NULL;
  __Pyx_RefNannyDeclarations
  int __pyx_lineno = 0;
  const char *__pyx_filename = NULL;
  int __pyx_clineno = 0;
  __Pyx_RefNannySetupContext("styles", 0);

  /* "kiva/quartz/CTFont.pyx":182
 * 
 *     def styles(self, font_name):
 *         raise NotImplementedError             # <<<<<<<<<<<<<<
 * 
 *     def list_fonts(self):
 */
  __Pyx_Raise(__pyx_builtin_NotImplementedError, 0, 0, 0);
  {__pyx_filename = __pyx_f[0]; __pyx_lineno = 182; __pyx_clineno = __LINE__; goto __pyx_L1_error;}

  __pyx_r = Py_None; __Pyx_INCREF(Py_None);
  goto __pyx_L0;
  __pyx_L1_error:;
  __Pyx_AddTraceback("kiva.quartz.CTFont.FontLookup.styles", __pyx_clineno, __pyx_lineno, __pyx_filename);
  __pyx_r = NULL;
  __pyx_L0:;
  __Pyx_XGIVEREF(__pyx_r);
  __Pyx_RefNannyFinishContext();
  return __pyx_r;
}

/* Python wrapper */
static PyObject *__pyx_pw_4kiva_6quartz_6CTFont_10FontLookup_7list_fonts(PyObject *__pyx_v_self, CYTHON_UNUSED PyObject *unused); /*proto*/
static PyObject *__pyx_pw_4kiva_6quartz_6CTFont_10FontLookup_7list_fonts(PyObject *__pyx_v_self, CYTHON_UNUSED PyObject *unused) {
  PyObject *__pyx_r = 0;
  __Pyx_RefNannyDeclarations
  __Pyx_RefNannySetupContext("list_fonts (wrapper)", 0);
  __pyx_r = __pyx_pf_4kiva_6quartz_6CTFont_10FontLookup_6list_fonts(((struct __pyx_obj_4kiva_6quartz_6CTFont_FontLookup *)__pyx_v_self));
  __Pyx_RefNannyFinishContext();
  return __pyx_r;
}

/* "kiva/quartz/CTFont.pyx":184
 *         raise NotImplementedError
 * 
 *     def list_fonts(self):             # <<<<<<<<<<<<<<
 *         for name in self.names():
 *             print name, self.styles(name)
 */

static PyObject *__pyx_pf_4kiva_6quartz_6CTFont_10FontLookup_6list_fonts(struct __pyx_obj_4kiva_6quartz_6CTFont_FontLookup *__pyx_v_self) {
  PyObject *__pyx_v_name = NULL;
  PyObject *__pyx_r = NULL;
  __Pyx_RefNannyDeclarations
  PyObject *__pyx_t_1 = NULL;
  PyObject *__pyx_t_2 = NULL;
  Py_ssize_t __pyx_t_3;
  PyObject *(*__pyx_t_4)(PyObject *);
  PyObject *__pyx_t_5 = NULL;
  PyObject *__pyx_t_6 = NULL;
  int __pyx_lineno = 0;
  const char *__pyx_filename = NULL;
  int __pyx_clineno = 0;
  __Pyx_RefNannySetupContext("list_fonts", 0);

  /* "kiva/quartz/CTFont.pyx":185
 * 
 *     def list_fonts(self):
 *         for name in self.names():             # <<<<<<<<<<<<<<
 *             print name, self.styles(name)
 * 
 */
  __pyx_t_1 = __Pyx_PyObject_GetAttrStr(((PyObject *)__pyx_v_self), __pyx_n_s__names); if (unlikely(!__pyx_t_1)) {__pyx_filename = __pyx_f[0]; __pyx_lineno = 185; __pyx_clineno = __LINE__; goto __pyx_L1_error;}
  __Pyx_GOTREF(__pyx_t_1);
  __pyx_t_2 = PyObject_Call(__pyx_t_1, ((PyObject *)__pyx_empty_tuple), NULL); if (unlikely(!__pyx_t_2)) {__pyx_filename = __pyx_f[0]; __pyx_lineno = 185; __pyx_clineno = __LINE__; goto __pyx_L1_error;}
  __Pyx_GOTREF(__pyx_t_2);
  __Pyx_DECREF(__pyx_t_1); __pyx_t_1 = 0;
  if (PyList_CheckExact(__pyx_t_2) || PyTuple_CheckExact(__pyx_t_2)) {
    __pyx_t_1 = __pyx_t_2; __Pyx_INCREF(__pyx_t_1); __pyx_t_3 = 0;
    __pyx_t_4 = NULL;
  } else {
    __pyx_t_3 = -1; __pyx_t_1 = PyObject_GetIter(__pyx_t_2); if (unlikely(!__pyx_t_1)) {__pyx_filename = __pyx_f[0]; __pyx_lineno = 185; __pyx_clineno = __LINE__; goto __pyx_L1_error;}
    __Pyx_GOTREF(__pyx_t_1);
    __pyx_t_4 = Py_TYPE(__pyx_t_1)->tp_iternext;
  }
  __Pyx_DECREF(__pyx_t_2); __pyx_t_2 = 0;
  for (;;) {
    if (!__pyx_t_4 && PyList_CheckExact(__pyx_t_1)) {
      if (__pyx_t_3 >= PyList_GET_SIZE(__pyx_t_1)) break;
      #if CYTHON_COMPILING_IN_CPYTHON
      __pyx_t_2 = PyList_GET_ITEM(__pyx_t_1, __pyx_t_3); __Pyx_INCREF(__pyx_t_2); __pyx_t_3++; if (unlikely(0 < 0)) {__pyx_filename = __pyx_f[0]; __pyx_lineno = 185; __pyx_clineno = __LINE__; goto __pyx_L1_error;}
      #else
      __pyx_t_2 = PySequence_ITEM(__pyx_t_1, __pyx_t_3); __pyx_t_3++; if (unlikely(!__pyx_t_2)) {__pyx_filename = __pyx_f[0]; __pyx_lineno = 185; __pyx_clineno = __LINE__; goto __pyx_L1_error;}
      #endif
    } else if (!__pyx_t_4 && PyTuple_CheckExact(__pyx_t_1)) {
      if (__pyx_t_3 >= PyTuple_GET_SIZE(__pyx_t_1)) break;
      #if CYTHON_COMPILING_IN_CPYTHON
      __pyx_t_2 = PyTuple_GET_ITEM(__pyx_t_1, __pyx_t_3); __Pyx_INCREF(__pyx_t_2); __pyx_t_3++; if (unlikely(0 < 0)) {__pyx_filename = __pyx_f[0]; __pyx_lineno = 185; __pyx_clineno = __LINE__; goto __pyx_L1_error;}
      #else
      __pyx_t_2 = PySequence_ITEM(__pyx_t_1, __pyx_t_3); __pyx_t_3++; if (unlikely(!__pyx_t_2)) {__pyx_filename = __pyx_f[0]; __pyx_lineno = 185; __pyx_clineno = __LINE__; goto __pyx_L1_error;}
      #endif
    } else {
      __pyx_t_2 = __pyx_t_4(__pyx_t_1);
      if (unlikely(!__pyx_t_2)) {
        if (PyErr_Occurred()) {
          if (likely(PyErr_ExceptionMatches(PyExc_StopIteration))) PyErr_Clear();
          else {__pyx_filename = __pyx_f[0]; __pyx_lineno = 185; __pyx_clineno = __LINE__; goto __pyx_L1_error;}
        }
        break;
      }
      __Pyx_GOTREF(__pyx_t_2);
    }
    __Pyx_XDECREF_SET(__pyx_v_name, __pyx_t_2);
    __pyx_t_2 = 0;

    /* "kiva/quartz/CTFont.pyx":186
 *     def list_fonts(self):
 *         for name in self.names():
 *             print name, self.styles(name)             # <<<<<<<<<<<<<<
 * 
 * default_font_info = FontLookup()
 */
    __pyx_t_2 = __Pyx_PyObject_GetAttrStr(((PyObject *)__pyx_v_self), __pyx_n_s__styles); if (unlikely(!__pyx_t_2)) {__pyx_filename = __pyx_f[0]; __pyx_lineno = 186; __pyx_clineno = __LINE__; goto __pyx_L1_error;}
    __Pyx_GOTREF(__pyx_t_2);
    __pyx_t_5 = PyTuple_New(1); if (unlikely(!__pyx_t_5)) {__pyx_filename = __pyx_f[0]; __pyx_lineno = 186; __pyx_clineno = __LINE__; goto __pyx_L1_error;}
    __Pyx_GOTREF(__pyx_t_5);
    __Pyx_INCREF(__pyx_v_name);
    PyTuple_SET_ITEM(__pyx_t_5, 0, __pyx_v_name);
    __Pyx_GIVEREF(__pyx_v_name);
    __pyx_t_6 = PyObject_Call(__pyx_t_2, ((PyObject *)__pyx_t_5), NULL); if (unlikely(!__pyx_t_6)) {__pyx_filename = __pyx_f[0]; __pyx_lineno = 186; __pyx_clineno = __LINE__; goto __pyx_L1_error;}
    __Pyx_GOTREF(__pyx_t_6);
    __Pyx_DECREF(__pyx_t_2); __pyx_t_2 = 0;
    __Pyx_DECREF(((PyObject *)__pyx_t_5)); __pyx_t_5 = 0;
    __pyx_t_5 = PyTuple_New(2); if (unlikely(!__pyx_t_5)) {__pyx_filename = __pyx_f[0]; __pyx_lineno = 186; __pyx_clineno = __LINE__; goto __pyx_L1_error;}
    __Pyx_GOTREF(__pyx_t_5);
    __Pyx_INCREF(__pyx_v_name);
    PyTuple_SET_ITEM(__pyx_t_5, 0, __pyx_v_name);
    __Pyx_GIVEREF(__pyx_v_name);
    PyTuple_SET_ITEM(__pyx_t_5, 1, __pyx_t_6);
    __Pyx_GIVEREF(__pyx_t_6);
    __pyx_t_6 = 0;
    if (__Pyx_Print(0, ((PyObject *)__pyx_t_5), 1) < 0) {__pyx_filename = __pyx_f[0]; __pyx_lineno = 186; __pyx_clineno = __LINE__; goto __pyx_L1_error;}
    __Pyx_DECREF(((PyObject *)__pyx_t_5)); __pyx_t_5 = 0;
  }
  __Pyx_DECREF(__pyx_t_1); __pyx_t_1 = 0;

  __pyx_r = Py_None; __Pyx_INCREF(Py_None);
  goto __pyx_L0;
  __pyx_L1_error:;
  __Pyx_XDECREF(__pyx_t_1);
  __Pyx_XDECREF(__pyx_t_2);
  __Pyx_XDECREF(__pyx_t_5);
  __Pyx_XDECREF(__pyx_t_6);
  __Pyx_AddTraceback("kiva.quartz.CTFont.FontLookup.list_fonts", __pyx_clineno, __pyx_lineno, __pyx_filename);
  __pyx_r = NULL;
  __pyx_L0:;
  __Pyx_XDECREF(__pyx_v_name);
  __Pyx_XGIVEREF(__pyx_r);
  __Pyx_RefNannyFinishContext();
  return __pyx_r;
}

/* Python wrapper */
static PyObject *__pyx_pw_4kiva_6quartz_6CTFont_10FontLookup_5cache_1__get__(PyObject *__pyx_v_self); /*proto*/
static PyObject *__pyx_pw_4kiva_6quartz_6CTFont_10FontLookup_5cache_1__get__(PyObject *__pyx_v_self) {
  PyObject *__pyx_r = 0;
  __Pyx_RefNannyDeclarations
  __Pyx_RefNannySetupContext("__get__ (wrapper)", 0);
  __pyx_r = __pyx_pf_4kiva_6quartz_6CTFont_10FontLookup_5cache___get__(((struct __pyx_obj_4kiva_6quartz_6CTFont_FontLookup *)__pyx_v_self));
  __Pyx_RefNannyFinishContext();
  return __pyx_r;
}

/* "kiva/quartz/CTFont.pyx":155
 * 
 * cdef class FontLookup:
 *     cdef readonly object cache             # <<<<<<<<<<<<<<
 *     cdef public object default_font
 * 
 */

static PyObject *__pyx_pf_4kiva_6quartz_6CTFont_10FontLookup_5cache___get__(struct __pyx_obj_4kiva_6quartz_6CTFont_FontLookup *__pyx_v_self) {
  PyObject *__pyx_r = NULL;
  __Pyx_RefNannyDeclarations
  __Pyx_RefNannySetupContext("__get__", 0);
  __Pyx_XDECREF(__pyx_r);
  __Pyx_INCREF(__pyx_v_self->cache);
  __pyx_r = __pyx_v_self->cache;
  goto __pyx_L0;

  __pyx_r = Py_None; __Pyx_INCREF(Py_None);
  __pyx_L0:;
  __Pyx_XGIVEREF(__pyx_r);
  __Pyx_RefNannyFinishContext();
  return __pyx_r;
}

/* Python wrapper */
static PyObject *__pyx_pw_4kiva_6quartz_6CTFont_10FontLookup_12default_font_1__get__(PyObject *__pyx_v_self); /*proto*/
static PyObject *__pyx_pw_4kiva_6quartz_6CTFont_10FontLookup_12default_font_1__get__(PyObject *__pyx_v_self) {
  PyObject *__pyx_r = 0;
  __Pyx_RefNannyDeclarations
  __Pyx_RefNannySetupContext("__get__ (wrapper)", 0);
  __pyx_r = __pyx_pf_4kiva_6quartz_6CTFont_10FontLookup_12default_font___get__(((struct __pyx_obj_4kiva_6quartz_6CTFont_FontLookup *)__pyx_v_self));
  __Pyx_RefNannyFinishContext();
  return __pyx_r;
}

/* "kiva/quartz/CTFont.pyx":156
 * cdef class FontLookup:
 *     cdef readonly object cache
 *     cdef public object default_font             # <<<<<<<<<<<<<<
 * 
 *     def lookup(self, name=None, style='regular'):
 */

static PyObject *__pyx_pf_4kiva_6quartz_6CTFont_10FontLookup_12default_font___get__(struct __pyx_obj_4kiva_6quartz_6CTFont_FontLookup *__pyx_v_self) {
  PyObject *__pyx_r = NULL;
  __Pyx_RefNannyDeclarations
  __Pyx_RefNannySetupContext("__get__", 0);
  __Pyx_XDECREF(__pyx_r);
  __Pyx_INCREF(__pyx_v_self->default_font);
  __pyx_r = __pyx_v_self->default_font;
  goto __pyx_L0;

  __pyx_r = Py_None; __Pyx_INCREF(Py_None);
  __pyx_L0:;
  __Pyx_XGIVEREF(__pyx_r);
  __Pyx_RefNannyFinishContext();
  return __pyx_r;
}

/* Python wrapper */
static int __pyx_pw_4kiva_6quartz_6CTFont_10FontLookup_12default_font_3__set__(PyObject *__pyx_v_self, PyObject *__pyx_v_value); /*proto*/
static int __pyx_pw_4kiva_6quartz_6CTFont_10FontLookup_12default_font_3__set__(PyObject *__pyx_v_self, PyObject *__pyx_v_value) {
  int __pyx_r;
  __Pyx_RefNannyDeclarations
  __Pyx_RefNannySetupContext("__set__ (wrapper)", 0);
  __pyx_r = __pyx_pf_4kiva_6quartz_6CTFont_10FontLookup_12default_font_2__set__(((struct __pyx_obj_4kiva_6quartz_6CTFont_FontLookup *)__pyx_v_self), ((PyObject *)__pyx_v_value));
  __Pyx_RefNannyFinishContext();
  return __pyx_r;
}

static int __pyx_pf_4kiva_6quartz_6CTFont_10FontLookup_12default_font_2__set__(struct __pyx_obj_4kiva_6quartz_6CTFont_FontLookup *__pyx_v_self, PyObject *__pyx_v_value) {
  int __pyx_r;
  __Pyx_RefNannyDeclarations
  __Pyx_RefNannySetupContext("__set__", 0);
  __Pyx_INCREF(__pyx_v_value);
  __Pyx_GIVEREF(__pyx_v_value);
  __Pyx_GOTREF(__pyx_v_self->default_font);
  __Pyx_DECREF(__pyx_v_self->default_font);
  __pyx_v_self->default_font = __pyx_v_value;

  __pyx_r = 0;
  __Pyx_RefNannyFinishContext();
  return __pyx_r;
}

/* Python wrapper */
static int __pyx_pw_4kiva_6quartz_6CTFont_10FontLookup_12default_font_5__del__(PyObject *__pyx_v_self); /*proto*/
static int __pyx_pw_4kiva_6quartz_6CTFont_10FontLookup_12default_font_5__del__(PyObject *__pyx_v_self) {
  int __pyx_r;
  __Pyx_RefNannyDeclarations
  __Pyx_RefNannySetupContext("__del__ (wrapper)", 0);
  __pyx_r = __pyx_pf_4kiva_6quartz_6CTFont_10FontLookup_12default_font_4__del__(((struct __pyx_obj_4kiva_6quartz_6CTFont_FontLookup *)__pyx_v_self));
  __Pyx_RefNannyFinishContext();
  return __pyx_r;
}

static int __pyx_pf_4kiva_6quartz_6CTFont_10FontLookup_12default_font_4__del__(struct __pyx_obj_4kiva_6quartz_6CTFont_FontLookup *__pyx_v_self) {
  int __pyx_r;
  __Pyx_RefNannyDeclarations
  __Pyx_RefNannySetupContext("__del__", 0);
  __Pyx_INCREF(Py_None);
  __Pyx_GIVEREF(Py_None);
  __Pyx_GOTREF(__pyx_v_self->default_font);
  __Pyx_DECREF(__pyx_v_self->default_font);
  __pyx_v_self->default_font = Py_None;

  __pyx_r = 0;
  __Pyx_RefNannyFinishContext();
  return __pyx_r;
}
static struct __pyx_vtabstruct_4kiva_6quartz_6CTFont_CTFont __pyx_vtable_4kiva_6quartz_6CTFont_CTFont;

static PyObject *__pyx_tp_new_4kiva_6quartz_6CTFont_CTFont(PyTypeObject *t, PyObject *a, PyObject *k) {
  struct __pyx_obj_4kiva_6quartz_6CTFont_CTFont *p;
  PyObject *o;
  o = (*t->tp_alloc)(t, 0);
  if (unlikely(!o)) return 0;
  p = ((struct __pyx_obj_4kiva_6quartz_6CTFont_CTFont *)o);
  p->__pyx_vtab = __pyx_vtabptr_4kiva_6quartz_6CTFont_CTFont;
  if (unlikely(__pyx_pw_4kiva_6quartz_6CTFont_6CTFont_1__cinit__(o, a, k) < 0)) {
    Py_DECREF(o); o = 0;
  }
  return o;
}

static void __pyx_tp_dealloc_4kiva_6quartz_6CTFont_CTFont(PyObject *o) {
  {
    PyObject *etype, *eval, *etb;
    PyErr_Fetch(&etype, &eval, &etb);
    ++Py_REFCNT(o);
    __pyx_pw_4kiva_6quartz_6CTFont_6CTFont_3__dealloc__(o);
    if (PyErr_Occurred()) PyErr_WriteUnraisable(o);
    --Py_REFCNT(o);
    PyErr_Restore(etype, eval, etb);
  }
  (*Py_TYPE(o)->tp_free)(o);
}

static PyMethodDef __pyx_methods_4kiva_6quartz_6CTFont_CTFont[] = {
  {__Pyx_NAMESTR("get_pointer"), (PyCFunction)__pyx_pw_4kiva_6quartz_6CTFont_6CTFont_5get_pointer, METH_NOARGS, __Pyx_DOCSTR(0)},
  {0, 0, 0, 0}
};

static PyTypeObject __pyx_type_4kiva_6quartz_6CTFont_CTFont = {
  PyVarObject_HEAD_INIT(0, 0)
  __Pyx_NAMESTR("kiva.quartz.CTFont.CTFont"), /*tp_name*/
  sizeof(struct __pyx_obj_4kiva_6quartz_6CTFont_CTFont), /*tp_basicsize*/
  0, /*tp_itemsize*/
  __pyx_tp_dealloc_4kiva_6quartz_6CTFont_CTFont, /*tp_dealloc*/
  0, /*tp_print*/
  0, /*tp_getattr*/
  0, /*tp_setattr*/
  #if PY_MAJOR_VERSION < 3
  0, /*tp_compare*/
  #else
  0, /*reserved*/
  #endif
  0, /*tp_repr*/
  0, /*tp_as_number*/
  0, /*tp_as_sequence*/
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  0, /*tp_as_buffer*/
  Py_TPFLAGS_DEFAULT|Py_TPFLAGS_HAVE_VERSION_TAG|Py_TPFLAGS_CHECKTYPES|Py_TPFLAGS_HAVE_NEWBUFFER|Py_TPFLAGS_BASETYPE, /*tp_flags*/
  0, /*tp_doc*/
  0, /*tp_traverse*/
  0, /*tp_clear*/
  0, /*tp_richcompare*/
  0, /*tp_weaklistoffset*/
  0, /*tp_iter*/
  0, /*tp_iternext*/
  __pyx_methods_4kiva_6quartz_6CTFont_CTFont, /*tp_methods*/
  0, /*tp_members*/
  0, /*tp_getset*/
  0, /*tp_base*/
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  0, /*tp_alloc*/
  __pyx_tp_new_4kiva_6quartz_6CTFont_CTFont, /*tp_new*/
  0, /*tp_free*/
  0, /*tp_is_gc*/
  0, /*tp_bases*/
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  0, /*tp_del*/
  #if PY_VERSION_HEX >= 0x02060000
  0, /*tp_version_tag*/
  #endif
  #if PY_VERSION_HEX >= 0x030400a1 && defined(Py_TPFLAGS_HAVE_FINALIZE)
  0, /*tp_finalize*/
  #endif
};

static PyObject *__pyx_tp_new_4kiva_6quartz_6CTFont_FontLookup(PyTypeObject *t, CYTHON_UNUSED PyObject *a, CYTHON_UNUSED PyObject *k) {
  struct __pyx_obj_4kiva_6quartz_6CTFont_FontLookup *p;
  PyObject *o;
  o = (*t->tp_alloc)(t, 0);
  if (unlikely(!o)) return 0;
  p = ((struct __pyx_obj_4kiva_6quartz_6CTFont_FontLookup *)o);
  p->cache = Py_None; Py_INCREF(Py_None);
  p->default_font = Py_None; Py_INCREF(Py_None);
  return o;
}

static void __pyx_tp_dealloc_4kiva_6quartz_6CTFont_FontLookup(PyObject *o) {
  struct __pyx_obj_4kiva_6quartz_6CTFont_FontLookup *p = (struct __pyx_obj_4kiva_6quartz_6CTFont_FontLookup *)o;
  PyObject_GC_UnTrack(o);
  Py_CLEAR(p->cache);
  Py_CLEAR(p->default_font);
  (*Py_TYPE(o)->tp_free)(o);
}

static int __pyx_tp_traverse_4kiva_6quartz_6CTFont_FontLookup(PyObject *o, visitproc v, void *a) {
  int e;
  struct __pyx_obj_4kiva_6quartz_6CTFont_FontLookup *p = (struct __pyx_obj_4kiva_6quartz_6CTFont_FontLookup *)o;
  if (p->cache) {
    e = (*v)(p->cache, a); if (e) return e;
  }
  if (p->default_font) {
    e = (*v)(p->default_font, a); if (e) return e;
  }
  return 0;
}

static int __pyx_tp_clear_4kiva_6quartz_6CTFont_FontLookup(PyObject *o) {
  struct __pyx_obj_4kiva_6quartz_6CTFont_FontLookup *p = (struct __pyx_obj_4kiva_6quartz_6CTFont_FontLookup *)o;
  PyObject* tmp;
  tmp = ((PyObject*)p->cache);
  p->cache = Py_None; Py_INCREF(Py_None);
  Py_XDECREF(tmp);
  tmp = ((PyObject*)p->default_font);
  p->default_font = Py_None; Py_INCREF(Py_None);
  Py_XDECREF(tmp);
  return 0;
}

static PyObject *__pyx_getprop_4kiva_6quartz_6CTFont_10FontLookup_cache(PyObject *o, CYTHON_UNUSED void *x) {
  return __pyx_pw_4kiva_6quartz_6CTFont_10FontLookup_5cache_1__get__(o);
}

static PyObject *__pyx_getprop_4kiva_6quartz_6CTFont_10FontLookup_default_font(PyObject *o, CYTHON_UNUSED void *x) {
  return __pyx_pw_4kiva_6quartz_6CTFont_10FontLookup_12default_font_1__get__(o);
}

static int __pyx_setprop_4kiva_6quartz_6CTFont_10FontLookup_default_font(PyObject *o, PyObject *v, CYTHON_UNUSED void *x) {
  if (v) {
    return __pyx_pw_4kiva_6quartz_6CTFont_10FontLookup_12default_font_3__set__(o, v);
  }
  else {
    return __pyx_pw_4kiva_6quartz_6CTFont_10FontLookup_12default_font_5__del__(o);
  }
}

static PyMethodDef __pyx_methods_4kiva_6quartz_6CTFont_FontLookup[] = {
  {__Pyx_NAMESTR("lookup"), (PyCFunction)__pyx_pw_4kiva_6quartz_6CTFont_10FontLookup_1lookup, METH_VARARGS|METH_KEYWORDS, __Pyx_DOCSTR(0)},
  {__Pyx_NAMESTR("names"), (PyCFunction)__pyx_pw_4kiva_6quartz_6CTFont_10FontLookup_3names, METH_NOARGS, __Pyx_DOCSTR(0)},
  {__Pyx_NAMESTR("styles"), (PyCFunction)__pyx_pw_4kiva_6quartz_6CTFont_10FontLookup_5styles, METH_O, __Pyx_DOCSTR(0)},
  {__Pyx_NAMESTR("list_fonts"), (PyCFunction)__pyx_pw_4kiva_6quartz_6CTFont_10FontLookup_7list_fonts, METH_NOARGS, __Pyx_DOCSTR(0)},
  {0, 0, 0, 0}
};

static struct PyGetSetDef __pyx_getsets_4kiva_6quartz_6CTFont_FontLookup[] = {
  {(char *)"cache", __pyx_getprop_4kiva_6quartz_6CTFont_10FontLookup_cache, 0, 0, 0},
  {(char *)"default_font", __pyx_getprop_4kiva_6quartz_6CTFont_10FontLookup_default_font, __pyx_setprop_4kiva_6quartz_6CTFont_10FontLookup_default_font, 0, 0},
  {0, 0, 0, 0, 0}
};

static PyTypeObject __pyx_type_4kiva_6quartz_6CTFont_FontLookup = {
  PyVarObject_HEAD_INIT(0, 0)
  __Pyx_NAMESTR("kiva.quartz.CTFont.FontLookup"), /*tp_name*/
  sizeof(struct __pyx_obj_4kiva_6quartz_6CTFont_FontLookup), /*tp_basicsize*/
  0, /*tp_itemsize*/
  __pyx_tp_dealloc_4kiva_6quartz_6CTFont_FontLookup, /*tp_dealloc*/
  0, /*tp_print*/
  0, /*tp_getattr*/
  0, /*tp_setattr*/
  #if PY_MAJOR_VERSION < 3
  0, /*tp_compare*/
  #else
  0, /*reserved*/
  #endif
  0, /*tp_repr*/
  0, /*tp_as_number*/
  0, /*tp_as_sequence*/
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  0, /*tp_as_buffer*/
  Py_TPFLAGS_DEFAULT|Py_TPFLAGS_HAVE_VERSION_TAG|Py_TPFLAGS_CHECKTYPES|Py_TPFLAGS_HAVE_NEWBUFFER|Py_TPFLAGS_BASETYPE|Py_TPFLAGS_HAVE_GC, /*tp_flags*/
  0, /*tp_doc*/
  __pyx_tp_traverse_4kiva_6quartz_6CTFont_FontLookup, /*tp_traverse*/
  __pyx_tp_clear_4kiva_6quartz_6CTFont_FontLookup, /*tp_clear*/
  0, /*tp_richcompare*/
  0, /*tp_weaklistoffset*/
  0, /*tp_iter*/
  0, /*tp_iternext*/
  __pyx_methods_4kiva_6quartz_6CTFont_FontLookup, /*tp_methods*/
  0, /*tp_members*/
  __pyx_getsets_4kiva_6quartz_6CTFont_FontLookup, /*tp_getset*/
  0, /*tp_base*/
  0, /*tp_dict*/
  0, /*tp_descr_get*/
  0, /*tp_descr_set*/
  0, /*tp_dictoffset*/
  0, /*tp_init*/
  0, /*tp_alloc*/
  __pyx_tp_new_4kiva_6quartz_6CTFont_FontLookup, /*tp_new*/
  0, /*tp_free*/
  0, /*tp_is_gc*/
  0, /*tp_bases*/
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  0, /*tp_del*/
  #if PY_VERSION_HEX >= 0x02060000
  0, /*tp_version_tag*/
  #endif
  #if PY_VERSION_HEX >= 0x030400a1 && defined(Py_TPFLAGS_HAVE_FINALIZE)
  0, /*tp_finalize*/
  #endif
};
static struct __pyx_vtabstruct_4kiva_6quartz_6CTFont_CTFontStyle __pyx_vtable_4kiva_6quartz_6CTFont_CTFontStyle;

static PyObject *__pyx_tp_new_4kiva_6quartz_6CTFont_CTFontStyle(PyTypeObject *t, PyObject *a, PyObject *k) {
  struct __pyx_obj_4kiva_6quartz_6CTFont_CTFontStyle *p;
  PyObject *o;
  o = (*t->tp_alloc)(t, 0);
  if (unlikely(!o)) return 0;
  p = ((struct __pyx_obj_4kiva_6quartz_6CTFont_CTFontStyle *)o);
  p->__pyx_vtab = __pyx_vtabptr_4kiva_6quartz_6CTFont_CTFontStyle;
  p->family_name = Py_None; Py_INCREF(Py_None);
  p->style = Py_None; Py_INCREF(Py_None);
  if (unlikely(__pyx_pw_4kiva_6quartz_6CTFont_11CTFontStyle_1__cinit__(o, a, k) < 0)) {
    Py_DECREF(o); o = 0;
  }
  return o;
}

static void __pyx_tp_dealloc_4kiva_6quartz_6CTFont_CTFontStyle(PyObject *o) {
  struct __pyx_obj_4kiva_6quartz_6CTFont_CTFontStyle *p = (struct __pyx_obj_4kiva_6quartz_6CTFont_CTFontStyle *)o;
  PyObject_GC_UnTrack(o);
  {
    PyObject *etype, *eval, *etb;
    PyErr_Fetch(&etype, &eval, &etb);
    ++Py_REFCNT(o);
    __pyx_pw_4kiva_6quartz_6CTFont_11CTFontStyle_3__dealloc__(o);
    if (PyErr_Occurred()) PyErr_WriteUnraisable(o);
    --Py_REFCNT(o);
    PyErr_Restore(etype, eval, etb);
  }
  Py_CLEAR(p->family_name);
  Py_CLEAR(p->style);
  (*Py_TYPE(o)->tp_free)(o);
}

static int __pyx_tp_traverse_4kiva_6quartz_6CTFont_CTFontStyle(PyObject *o, visitproc v, void *a) {
  int e;
  struct __pyx_obj_4kiva_6quartz_6CTFont_CTFontStyle *p = (struct __pyx_obj_4kiva_6quartz_6CTFont_CTFontStyle *)o;
  if (p->family_name) {
    e = (*v)(p->family_name, a); if (e) return e;
  }
  if (p->style) {
    e = (*v)(p->style, a); if (e) return e;
  }
  return 0;
}

static int __pyx_tp_clear_4kiva_6quartz_6CTFont_CTFontStyle(PyObject *o) {
  struct __pyx_obj_4kiva_6quartz_6CTFont_CTFontStyle *p = (struct __pyx_obj_4kiva_6quartz_6CTFont_CTFontStyle *)o;
  PyObject* tmp;
  tmp = ((PyObject*)p->family_name);
  p->family_name = Py_None; Py_INCREF(Py_None);
  Py_XDECREF(tmp);
  tmp = ((PyObject*)p->style);
  p->style = Py_None; Py_INCREF(Py_None);
  Py_XDECREF(tmp);
  return 0;
}

static PyObject *__pyx_getprop_4kiva_6quartz_6CTFont_11CTFontStyle_postcript_name(PyObject *o, CYTHON_UNUSED void *x) {
  return __pyx_pw_4kiva_6quartz_6CTFont_11CTFontStyle_14postcript_name_1__get__(o);
}

static PyObject *__pyx_getprop_4kiva_6quartz_6CTFont_11CTFontStyle_family_name(PyObject *o, CYTHON_UNUSED void *x) {
  return __pyx_pw_4kiva_6quartz_6CTFont_11CTFontStyle_11family_name_1__get__(o);
}

static PyObject *__pyx_getprop_4kiva_6quartz_6CTFont_11CTFontStyle_style(PyObject *o, CYTHON_UNUSED void *x) {
  return __pyx_pw_4kiva_6quartz_6CTFont_11CTFontStyle_5style_1__get__(o);
}

static PyMethodDef __pyx_methods_4kiva_6quartz_6CTFont_CTFontStyle[] = {
  {__Pyx_NAMESTR("get_descent_ascent"), (PyCFunction)__pyx_pw_4kiva_6quartz_6CTFont_11CTFontStyle_7get_descent_ascent, METH_O, __Pyx_DOCSTR(__pyx_doc_4kiva_6quartz_6CTFont_11CTFontStyle_6get_descent_ascent)},
  {__Pyx_NAMESTR("get_font"), (PyCFunction)__pyx_pw_4kiva_6quartz_6CTFont_11CTFontStyle_9get_font, METH_O, __Pyx_DOCSTR(__pyx_doc_4kiva_6quartz_6CTFont_11CTFontStyle_8get_font)},
  {0, 0, 0, 0}
};

static struct PyGetSetDef __pyx_getsets_4kiva_6quartz_6CTFont_CTFontStyle[] = {
  {(char *)"postcript_name", __pyx_getprop_4kiva_6quartz_6CTFont_11CTFontStyle_postcript_name, 0, 0, 0},
  {(char *)"family_name", __pyx_getprop_4kiva_6quartz_6CTFont_11CTFontStyle_family_name, 0, 0, 0},
  {(char *)"style", __pyx_getprop_4kiva_6quartz_6CTFont_11CTFontStyle_style, 0, 0, 0},
  {0, 0, 0, 0, 0}
};

static PyTypeObject __pyx_type_4kiva_6quartz_6CTFont_CTFontStyle = {
  PyVarObject_HEAD_INIT(0, 0)
  __Pyx_NAMESTR("kiva.quartz.CTFont.CTFontStyle"), /*tp_name*/
  sizeof(struct __pyx_obj_4kiva_6quartz_6CTFont_CTFontStyle), /*tp_basicsize*/
  0, /*tp_itemsize*/
  __pyx_tp_dealloc_4kiva_6quartz_6CTFont_CTFontStyle, /*tp_dealloc*/
  0, /*tp_print*/
  0, /*tp_getattr*/
  0, /*tp_setattr*/
  #if PY_MAJOR_VERSION < 3
  0, /*tp_compare*/
  #else
  0, /*reserved*/
  #endif
  0, /*tp_repr*/
  0, /*tp_as_number*/
  0, /*tp_as_sequence*/
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  0, /*tp_as_buffer*/
  Py_TPFLAGS_DEFAULT|Py_TPFLAGS_HAVE_VERSION_TAG|Py_TPFLAGS_CHECKTYPES|Py_TPFLAGS_HAVE_NEWBUFFER|Py_TPFLAGS_BASETYPE|Py_TPFLAGS_HAVE_GC, /*tp_flags*/
  0, /*tp_doc*/
  __pyx_tp_traverse_4kiva_6quartz_6CTFont_CTFontStyle, /*tp_traverse*/
  __pyx_tp_clear_4kiva_6quartz_6CTFont_CTFontStyle, /*tp_clear*/
  0, /*tp_richcompare*/
  0, /*tp_weaklistoffset*/
  0, /*tp_iter*/
  0, /*tp_iternext*/
  __pyx_methods_4kiva_6quartz_6CTFont_CTFontStyle, /*tp_methods*/
  0, /*tp_members*/
  __pyx_getsets_4kiva_6quartz_6CTFont_CTFontStyle, /*tp_getset*/
  0, /*tp_base*/
  0, /*tp_dict*/
  0, /*tp_descr_get*/
  0, /*tp_descr_set*/
  0, /*tp_dictoffset*/
  __pyx_pw_4kiva_6quartz_6CTFont_11CTFontStyle_5__init__, /*tp_init*/
  0, /*tp_alloc*/
  __pyx_tp_new_4kiva_6quartz_6CTFont_CTFontStyle, /*tp_new*/
  0, /*tp_free*/
  0, /*tp_is_gc*/
  0, /*tp_bases*/
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  0, /*tp_del*/
  #if PY_VERSION_HEX >= 0x02060000
  0, /*tp_version_tag*/
  #endif
  #if PY_VERSION_HEX >= 0x030400a1 && defined(Py_TPFLAGS_HAVE_FINALIZE)
  0, /*tp_finalize*/
  #endif
};

static PyMethodDef __pyx_methods[] = {
  {0, 0, 0, 0}
};

#if PY_MAJOR_VERSION >= 3
static struct PyModuleDef __pyx_moduledef = {
  #if PY_VERSION_HEX < 0x03020000
    { PyObject_HEAD_INIT(NULL) NULL, 0, NULL },
  #else
    PyModuleDef_HEAD_INIT,
  #endif
    __Pyx_NAMESTR("CTFont"),
    0, /* m_doc */
    -1, /* m_size */
    __pyx_methods /* m_methods */,
    NULL, /* m_reload */
    NULL, /* m_traverse */
    NULL, /* m_clear */
    NULL /* m_free */
};
#endif

static __Pyx_StringTabEntry __pyx_string_tab[] = {
  {&__pyx_kp_s_1, __pyx_k_1, sizeof(__pyx_k_1), 0, 0, 1, 0},
  {&__pyx_kp_s_2, __pyx_k_2, sizeof(__pyx_k_2), 0, 0, 1, 0},
  {&__pyx_kp_s_5, __pyx_k_5, sizeof(__pyx_k_5), 0, 0, 1, 0},
  {&__pyx_n_s__Helvetica, __pyx_k__Helvetica, sizeof(__pyx_k__Helvetica), 0, 0, 1, 1},
  {&__pyx_n_s__NotImplementedError, __pyx_k__NotImplementedError, sizeof(__pyx_k__NotImplementedError), 0, 0, 1, 1},
  {&__pyx_n_s__RuntimeError, __pyx_k__RuntimeError, sizeof(__pyx_k__RuntimeError), 0, 0, 1, 1},
  {&__pyx_n_s____main__, __pyx_k____main__, sizeof(__pyx_k____main__), 0, 0, 1, 1},
  {&__pyx_n_s____pyx_vtable__, __pyx_k____pyx_vtable__, sizeof(__pyx_k____pyx_vtable__), 0, 0, 1, 1},
  {&__pyx_n_s____test__, __pyx_k____test__, sizeof(__pyx_k____test__), 0, 0, 1, 1},
  {&__pyx_n_s__default_font, __pyx_k__default_font, sizeof(__pyx_k__default_font), 0, 0, 1, 1},
  {&__pyx_n_s__default_font_info, __pyx_k__default_font_info, sizeof(__pyx_k__default_font_info), 0, 0, 1, 1},
  {&__pyx_n_s__encode, __pyx_k__encode, sizeof(__pyx_k__encode), 0, 0, 1, 1},
  {&__pyx_n_s__end, __pyx_k__end, sizeof(__pyx_k__end), 0, 0, 1, 1},
  {&__pyx_n_s__file, __pyx_k__file, sizeof(__pyx_k__file), 0, 0, 1, 1},
  {&__pyx_n_s__get_pointer, __pyx_k__get_pointer, sizeof(__pyx_k__get_pointer), 0, 0, 1, 1},
  {&__pyx_n_s__name, __pyx_k__name, sizeof(__pyx_k__name), 0, 0, 1, 1},
  {&__pyx_n_s__names, __pyx_k__names, sizeof(__pyx_k__names), 0, 0, 1, 1},
  {&__pyx_n_s__print, __pyx_k__print, sizeof(__pyx_k__print), 0, 0, 1, 1},
  {&__pyx_n_s__regular, __pyx_k__regular, sizeof(__pyx_k__regular), 0, 0, 1, 1},
  {&__pyx_n_s__strip, __pyx_k__strip, sizeof(__pyx_k__strip), 0, 0, 1, 1},
  {&__pyx_n_s__style, __pyx_k__style, sizeof(__pyx_k__style), 0, 0, 1, 1},
  {&__pyx_n_s__styles, __pyx_k__styles, sizeof(__pyx_k__styles), 0, 0, 1, 1},
  {&__pyx_n_s__title, __pyx_k__title, sizeof(__pyx_k__title), 0, 0, 1, 1},
  {0, 0, 0, 0, 0, 0, 0}
};
static int __Pyx_InitCachedBuiltins(void) {
  __pyx_builtin_RuntimeError = __Pyx_GetBuiltinName(__pyx_n_s__RuntimeError); if (!__pyx_builtin_RuntimeError) {__pyx_filename = __pyx_f[0]; __pyx_lineno = 41; __pyx_clineno = __LINE__; goto __pyx_L1_error;}
  __pyx_builtin_NotImplementedError = __Pyx_GetBuiltinName(__pyx_n_s__NotImplementedError); if (!__pyx_builtin_NotImplementedError) {__pyx_filename = __pyx_f[0]; __pyx_lineno = 182; __pyx_clineno = __LINE__; goto __pyx_L1_error;}
  return 0;
  __pyx_L1_error:;
  return -1;
}

static int __Pyx_InitCachedConstants(void) {
  __Pyx_RefNannyDeclarations
  __Pyx_RefNannySetupContext("__Pyx_InitCachedConstants", 0);

  /* "kiva/quartz/CTFont.pyx":128
 *         cdef CFMutableDictionaryRef cf_dict
 * 
 *         mac_name = name.strip().encode('utf-8')             # <<<<<<<<<<<<<<
 *         cf_name = CFStringCreateWithCString(NULL, mac_name,
 *             kCFStringEncodingUTF8)
 */
  __pyx_k_tuple_3 = PyTuple_Pack(1, ((PyObject *)__pyx_kp_s_2)); if (unlikely(!__pyx_k_tuple_3)) {__pyx_filename = __pyx_f[0]; __pyx_lineno = 128; __pyx_clineno = __LINE__; goto __pyx_L1_error;}
  __Pyx_GOTREF(__pyx_k_tuple_3);
  __Pyx_GIVEREF(((PyObject *)__pyx_k_tuple_3));

  /* "kiva/quartz/CTFont.pyx":133
 * 
 *         style = style.title()
 *         mac_style = style.strip().encode('utf-8')             # <<<<<<<<<<<<<<
 *         cf_style = CFStringCreateWithCString(NULL, mac_style,
 *             kCFStringEncodingUTF8)
 */
  __pyx_k_tuple_4 = PyTuple_Pack(1, ((PyObject *)__pyx_kp_s_2)); if (unlikely(!__pyx_k_tuple_4)) {__pyx_filename = __pyx_f[0]; __pyx_lineno = 133; __pyx_clineno = __LINE__; goto __pyx_L1_error;}
  __Pyx_GOTREF(__pyx_k_tuple_4);
  __Pyx_GIVEREF(((PyObject *)__pyx_k_tuple_4));
  __Pyx_RefNannyFinishContext();
  return 0;
  __pyx_L1_error:;
  __Pyx_RefNannyFinishContext();
  return -1;
}

static int __Pyx_InitGlobals(void) {
  if (__Pyx_InitStrings(__pyx_string_tab) < 0) {__pyx_filename = __pyx_f[0]; __pyx_lineno = 1; __pyx_clineno = __LINE__; goto __pyx_L1_error;};
  return 0;
  __pyx_L1_error:;
  return -1;
}

#if PY_MAJOR_VERSION < 3
PyMODINIT_FUNC initCTFont(void); /*proto*/
PyMODINIT_FUNC initCTFont(void)
#else
PyMODINIT_FUNC PyInit_CTFont(void); /*proto*/
PyMODINIT_FUNC PyInit_CTFont(void)
#endif
{
  PyObject *__pyx_t_1 = NULL;
  int __pyx_lineno = 0;
  const char *__pyx_filename = NULL;
  int __pyx_clineno = 0;
  __Pyx_RefNannyDeclarations
  #if CYTHON_REFNANNY
  __Pyx_RefNanny = __Pyx_RefNannyImportAPI("refnanny");
  if (!__Pyx_RefNanny) {
      PyErr_Clear();
      __Pyx_RefNanny = __Pyx_RefNannyImportAPI("Cython.Runtime.refnanny");
      if (!__Pyx_RefNanny)
          Py_FatalError("failed to import 'refnanny' module");
  }
  #endif
  __Pyx_RefNannySetupContext("PyMODINIT_FUNC PyInit_CTFont(void)", 0);
  if ( __Pyx_check_binary_version() < 0) {__pyx_filename = __pyx_f[0]; __pyx_lineno = 1; __pyx_clineno = __LINE__; goto __pyx_L1_error;}
  __pyx_empty_tuple = PyTuple_New(0); if (unlikely(!__pyx_empty_tuple)) {__pyx_filename = __pyx_f[0]; __pyx_lineno = 1; __pyx_clineno = __LINE__; goto __pyx_L1_error;}
  __pyx_empty_bytes = PyBytes_FromStringAndSize("", 0); if (unlikely(!__pyx_empty_bytes)) {__pyx_filename = __pyx_f[0]; __pyx_lineno = 1; __pyx_clineno = __LINE__; goto __pyx_L1_error;}
  #ifdef __Pyx_CyFunction_USED
  if (__Pyx_CyFunction_init() < 0) {__pyx_filename = __pyx_f[0]; __pyx_lineno = 1; __pyx_clineno = __LINE__; goto __pyx_L1_error;}
  #endif
  #ifdef __Pyx_FusedFunction_USED
  if (__pyx_FusedFunction_init() < 0) {__pyx_filename = __pyx_f[0]; __pyx_lineno = 1; __pyx_clineno = __LINE__; goto __pyx_L1_error;}
  #endif
  #ifdef __Pyx_Generator_USED
  if (__pyx_Generator_init() < 0) {__pyx_filename = __pyx_f[0]; __pyx_lineno = 1; __pyx_clineno = __LINE__; goto __pyx_L1_error;}
  #endif
  /*--- Library function declarations ---*/
  /*--- Threads initialization code ---*/
  #if defined(__PYX_FORCE_INIT_THREADS) && __PYX_FORCE_INIT_THREADS
  #ifdef WITH_THREAD /* Python build with threading support? */
  PyEval_InitThreads();
  #endif
  #endif
  /*--- Module creation code ---*/
  #if PY_MAJOR_VERSION < 3
  __pyx_m = Py_InitModule4(__Pyx_NAMESTR("CTFont"), __pyx_methods, 0, 0, PYTHON_API_VERSION); Py_XINCREF(__pyx_m);
  #else
  __pyx_m = PyModule_Create(&__pyx_moduledef);
  #endif
  if (unlikely(!__pyx_m)) {__pyx_filename = __pyx_f[0]; __pyx_lineno = 1; __pyx_clineno = __LINE__; goto __pyx_L1_error;}
  __pyx_d = PyModule_GetDict(__pyx_m); if (unlikely(!__pyx_d)) {__pyx_filename = __pyx_f[0]; __pyx_lineno = 1; __pyx_clineno = __LINE__; goto __pyx_L1_error;}
  Py_INCREF(__pyx_d);
  #if PY_MAJOR_VERSION >= 3
  {
    PyObject *modules = PyImport_GetModuleDict(); if (unlikely(!modules)) {__pyx_filename = __pyx_f[0]; __pyx_lineno = 1; __pyx_clineno = __LINE__; goto __pyx_L1_error;}
    if (!PyDict_GetItemString(modules, "kiva.quartz.CTFont")) {
      if (unlikely(PyDict_SetItemString(modules, "kiva.quartz.CTFont", __pyx_m) < 0)) {__pyx_filename = __pyx_f[0]; __pyx_lineno = 1; __pyx_clineno = __LINE__; goto __pyx_L1_error;}
    }
  }
  #endif
  __pyx_b = PyImport_AddModule(__Pyx_NAMESTR(__Pyx_BUILTIN_MODULE_NAME)); if (unlikely(!__pyx_b)) {__pyx_filename = __pyx_f[0]; __pyx_lineno = 1; __pyx_clineno = __LINE__; goto __pyx_L1_error;}
  #if CYTHON_COMPILING_IN_PYPY
  Py_INCREF(__pyx_b);
  #endif
  if (__Pyx_SetAttrString(__pyx_m, "__builtins__", __pyx_b) < 0) {__pyx_filename = __pyx_f[0]; __pyx_lineno = 1; __pyx_clineno = __LINE__; goto __pyx_L1_error;};
  /*--- Initialize various global constants etc. ---*/
  if (unlikely(__Pyx_InitGlobals() < 0)) {__pyx_filename = __pyx_f[0]; __pyx_lineno = 1; __pyx_clineno = __LINE__; goto __pyx_L1_error;}
  #if PY_MAJOR_VERSION < 3 && (__PYX_DEFAULT_STRING_ENCODING_IS_ASCII || __PYX_DEFAULT_STRING_ENCODING_IS_DEFAULT)
  if (__Pyx_init_sys_getdefaultencoding_params() < 0) {__pyx_filename = __pyx_f[0]; __pyx_lineno = 1; __pyx_clineno = __LINE__; goto __pyx_L1_error;}
  #endif
  if (__pyx_module_is_main_kiva__quartz__CTFont) {
    if (__Pyx_SetAttrString(__pyx_m, "__name__", __pyx_n_s____main__) < 0) {__pyx_filename = __pyx_f[0]; __pyx_lineno = 1; __pyx_clineno = __LINE__; goto __pyx_L1_error;};
  }
  /*--- Builtin init code ---*/
  if (unlikely(__Pyx_InitCachedBuiltins() < 0)) {__pyx_filename = __pyx_f[0]; __pyx_lineno = 1; __pyx_clineno = __LINE__; goto __pyx_L1_error;}
  /*--- Constants init code ---*/
  if (unlikely(__Pyx_InitCachedConstants() < 0)) {__pyx_filename = __pyx_f[0]; __pyx_lineno = 1; __pyx_clineno = __LINE__; goto __pyx_L1_error;}
  /*--- Global init code ---*/
  /*--- Variable export code ---*/
  /*--- Function export code ---*/
  /*--- Type init code ---*/
  __pyx_vtabptr_4kiva_6quartz_6CTFont_CTFont = &__pyx_vtable_4kiva_6quartz_6CTFont_CTFont;
  __pyx_vtable_4kiva_6quartz_6CTFont_CTFont.get_pointer = (size_t (*)(struct __pyx_obj_4kiva_6quartz_6CTFont_CTFont *, int __pyx_skip_dispatch))__pyx_f_4kiva_6quartz_6CTFont_6CTFont_get_pointer;
  __pyx_vtable_4kiva_6quartz_6CTFont_CTFont.set_pointer = (PyObject *(*)(struct __pyx_obj_4kiva_6quartz_6CTFont_CTFont *, CTFontRef))__pyx_f_4kiva_6quartz_6CTFont_6CTFont_set_pointer;
  if (PyType_Ready(&__pyx_type_4kiva_6quartz_6CTFont_CTFont) < 0) {__pyx_filename = __pyx_f[0]; __pyx_lineno = 51; __pyx_clineno = __LINE__; goto __pyx_L1_error;}
  if (__Pyx_SetVtable(__pyx_type_4kiva_6quartz_6CTFont_CTFont.tp_dict, __pyx_vtabptr_4kiva_6quartz_6CTFont_CTFont) < 0) {__pyx_filename = __pyx_f[0]; __pyx_lineno = 51; __pyx_clineno = __LINE__; goto __pyx_L1_error;}
  if (__Pyx_SetAttrString(__pyx_m, "CTFont", (PyObject *)&__pyx_type_4kiva_6quartz_6CTFont_CTFont) < 0) {__pyx_filename = __pyx_f[0]; __pyx_lineno = 51; __pyx_clineno = __LINE__; goto __pyx_L1_error;}
  __pyx_ptype_4kiva_6quartz_6CTFont_CTFont = &__pyx_type_4kiva_6quartz_6CTFont_CTFont;
  if (PyType_Ready(&__pyx_type_4kiva_6quartz_6CTFont_FontLookup) < 0) {__pyx_filename = __pyx_f[0]; __pyx_lineno = 154; __pyx_clineno = __LINE__; goto __pyx_L1_error;}
  if (__Pyx_SetAttrString(__pyx_m, "FontLookup", (PyObject *)&__pyx_type_4kiva_6quartz_6CTFont_FontLookup) < 0) {__pyx_filename = __pyx_f[0]; __pyx_lineno = 154; __pyx_clineno = __LINE__; goto __pyx_L1_error;}
  __pyx_ptype_4kiva_6quartz_6CTFont_FontLookup = &__pyx_type_4kiva_6quartz_6CTFont_FontLookup;
  __pyx_vtabptr_4kiva_6quartz_6CTFont_CTFontStyle = &__pyx_vtable_4kiva_6quartz_6CTFont_CTFontStyle;
  __pyx_vtable_4kiva_6quartz_6CTFont_CTFontStyle._build_attribute_dictionary = (CFDictionaryRef (*)(struct __pyx_obj_4kiva_6quartz_6CTFont_CTFontStyle *, PyObject *, PyObject *))__pyx_f_4kiva_6quartz_6CTFont_11CTFontStyle__build_attribute_dictionary;
  if (PyType_Ready(&__pyx_type_4kiva_6quartz_6CTFont_CTFontStyle) < 0) {__pyx_filename = __pyx_f[0]; __pyx_lineno = 67; __pyx_clineno = __LINE__; goto __pyx_L1_error;}
  if (__Pyx_SetVtable(__pyx_type_4kiva_6quartz_6CTFont_CTFontStyle.tp_dict, __pyx_vtabptr_4kiva_6quartz_6CTFont_CTFontStyle) < 0) {__pyx_filename = __pyx_f[0]; __pyx_lineno = 67; __pyx_clineno = __LINE__; goto __pyx_L1_error;}
  if (__Pyx_SetAttrString(__pyx_m, "CTFontStyle", (PyObject *)&__pyx_type_4kiva_6quartz_6CTFont_CTFontStyle) < 0) {__pyx_filename = __pyx_f[0]; __pyx_lineno = 67; __pyx_clineno = __LINE__; goto __pyx_L1_error;}
  __pyx_ptype_4kiva_6quartz_6CTFont_CTFontStyle = &__pyx_type_4kiva_6quartz_6CTFont_CTFontStyle;
  /*--- Type import code ---*/
  /*--- Variable import code ---*/
  /*--- Function import code ---*/
  /*--- Execution code ---*/

  /* "kiva/quartz/CTFont.pyx":188
 *             print name, self.styles(name)
 * 
 * default_font_info = FontLookup()             # <<<<<<<<<<<<<<
 * default_font_info.default_font = 'Helvetica'
 */
  __pyx_t_1 = PyObject_Call(((PyObject *)((PyObject*)__pyx_ptype_4kiva_6quartz_6CTFont_FontLookup)), ((PyObject *)__pyx_empty_tuple), NULL); if (unlikely(!__pyx_t_1)) {__pyx_filename = __pyx_f[0]; __pyx_lineno = 188; __pyx_clineno = __LINE__; goto __pyx_L1_error;}
  __Pyx_GOTREF(__pyx_t_1);
  if (PyDict_SetItem(__pyx_d, __pyx_n_s__default_font_info, __pyx_t_1) < 0) {__pyx_filename = __pyx_f[0]; __pyx_lineno = 188; __pyx_clineno = __LINE__; goto __pyx_L1_error;}
  __Pyx_DECREF(__pyx_t_1); __pyx_t_1 = 0;

  /* "kiva/quartz/CTFont.pyx":189
 * 
 * default_font_info = FontLookup()
 * default_font_info.default_font = 'Helvetica'             # <<<<<<<<<<<<<<
 */
  __pyx_t_1 = __Pyx_GetModuleGlobalName(__pyx_n_s__default_font_info); if (unlikely(!__pyx_t_1)) {__pyx_filename = __pyx_f[0]; __pyx_lineno = 189; __pyx_clineno = __LINE__; goto __pyx_L1_error;}
  __Pyx_GOTREF(__pyx_t_1);
  if (__Pyx_PyObject_SetAttrStr(__pyx_t_1, __pyx_n_s__default_font, ((PyObject *)__pyx_n_s__Helvetica)) < 0) {__pyx_filename = __pyx_f[0]; __pyx_lineno = 189; __pyx_clineno = __LINE__; goto __pyx_L1_error;}
  __Pyx_DECREF(__pyx_t_1); __pyx_t_1 = 0;

  /* "kiva/quartz/CTFont.pyx":1
 * # :Author:    John Wiggins             # <<<<<<<<<<<<<<
 * # :Copyright: 2011, Enthought, Inc.
 * # :License:   BSD Style
 */
  __pyx_t_1 = PyDict_New(); if (unlikely(!__pyx_t_1)) {__pyx_filename = __pyx_f[0]; __pyx_lineno = 1; __pyx_clineno = __LINE__; goto __pyx_L1_error;}
  __Pyx_GOTREF(((PyObject *)__pyx_t_1));
  if (PyDict_SetItem(__pyx_d, __pyx_n_s____test__, ((PyObject *)__pyx_t_1)) < 0) {__pyx_filename = __pyx_f[0]; __pyx_lineno = 1; __pyx_clineno = __LINE__; goto __pyx_L1_error;}
  __Pyx_DECREF(((PyObject *)__pyx_t_1)); __pyx_t_1 = 0;
  goto __pyx_L0;
  __pyx_L1_error:;
  __Pyx_XDECREF(__pyx_t_1);
  if (__pyx_m) {
    __Pyx_AddTraceback("init kiva.quartz.CTFont", __pyx_clineno, __pyx_lineno, __pyx_filename);
    Py_DECREF(__pyx_m); __pyx_m = 0;
  } else if (!PyErr_Occurred()) {
    PyErr_SetString(PyExc_ImportError, "init kiva.quartz.CTFont");
  }
  __pyx_L0:;
  __Pyx_RefNannyFinishContext();
  #if PY_MAJOR_VERSION < 3
  return;
  #else
  return __pyx_m;
  #endif
}

/* Runtime support code */
#if CYTHON_REFNANNY
static __Pyx_RefNannyAPIStruct *__Pyx_RefNannyImportAPI(const char *modname) {
    PyObject *m = NULL, *p = NULL;
    void *r = NULL;
    m = PyImport_ImportModule((char *)modname);
    if (!m) goto end;
    p = PyObject_GetAttrString(m, (char *)"RefNannyAPI");
    if (!p) goto end;
    r = PyLong_AsVoidPtr(p);
end:
    Py_XDECREF(p);
    Py_XDECREF(m);
    return (__Pyx_RefNannyAPIStruct *)r;
}
#endif /* CYTHON_REFNANNY */

static PyObject *__Pyx_GetBuiltinName(PyObject *name) {
    PyObject* result = __Pyx_PyObject_GetAttrStr(__pyx_b, name);
    if (unlikely(!result)) {
        PyErr_Format(PyExc_NameError,
#if PY_MAJOR_VERSION >= 3
            "name '%U' is not defined", name);
#else
            "name '%s' is not defined", PyString_AS_STRING(name));
#endif
    }
    return result;
}

static CYTHON_INLINE void __Pyx_ErrRestore(PyObject *type, PyObject *value, PyObject *tb) {
#if CYTHON_COMPILING_IN_CPYTHON
    PyObject *tmp_type, *tmp_value, *tmp_tb;
    PyThreadState *tstate = PyThreadState_GET();
    tmp_type = tstate->curexc_type;
    tmp_value = tstate->curexc_value;
    tmp_tb = tstate->curexc_traceback;
    tstate->curexc_type = type;
    tstate->curexc_value = value;
    tstate->curexc_traceback = tb;
    Py_XDECREF(tmp_type);
    Py_XDECREF(tmp_value);
    Py_XDECREF(tmp_tb);
#else
    PyErr_Restore(type, value, tb);
#endif
}
static CYTHON_INLINE void __Pyx_ErrFetch(PyObject **type, PyObject **value, PyObject **tb) {
#if CYTHON_COMPILING_IN_CPYTHON
    PyThreadState *tstate = PyThreadState_GET();
    *type = tstate->curexc_type;
    *value = tstate->curexc_value;
    *tb = tstate->curexc_traceback;
    tstate->curexc_type = 0;
    tstate->curexc_value = 0;
    tstate->curexc_traceback = 0;
#else
    PyErr_Fetch(type, value, tb);
#endif
}

#if PY_MAJOR_VERSION < 3
static void __Pyx_Raise(PyObject *type, PyObject *value, PyObject *tb,
                        CYTHON_UNUSED PyObject *cause) {
    Py_XINCREF(type);
    if (!value || value == Py_None)
        value = NULL;
    else
        Py_INCREF(value);
    if (!tb || tb == Py_None)
        tb = NULL;
    else {
        Py_INCREF(tb);
        if (!PyTraceBack_Check(tb)) {
            PyErr_SetString(PyExc_TypeError,
                "raise: arg 3 must be a traceback or None");
            goto raise_error;
        }
    }
    #if PY_VERSION_HEX < 0x02050000
    if (PyClass_Check(type)) {
    #else
    if (PyType_Check(type)) {
    #endif
#if CYTHON_COMPILING_IN_PYPY
        if (!value) {
            Py_INCREF(Py_None);
            value = Py_None;
        }
#endif
        PyErr_NormalizeException(&type, &value, &tb);
    } else {
        if (value) {
            PyErr_SetString(PyExc_TypeError,
                "instance exception may not have a separate value");
            goto raise_error;
        }
        value = type;
        #if PY_VERSION_HEX < 0x02050000
        if (PyInstance_Check(type)) {
            type = (PyObject*) ((PyInstanceObject*)type)->in_class;
            Py_INCREF(type);
        } else {
            type = 0;
            PyErr_SetString(PyExc_TypeError,
                "raise: exception must be an old-style class or instance");
            goto raise_error;
        }
        #else
        type = (PyObject*) Py_TYPE(type);
        Py_INCREF(type);
        if (!PyType_IsSubtype((PyTypeObject *)type, (PyTypeObject *)PyExc_BaseException)) {
            PyErr_SetString(PyExc_TypeError,
                "raise: exception class must be a subclass of BaseException");
            goto raise_error;
        }
        #endif
    }
    __Pyx_ErrRestore(type, value, tb);
    return;
raise_error:
    Py_XDECREF(value);
    Py_XDECREF(type);
    Py_XDECREF(tb);
    return;
}
#else /* Python 3+ */
static void __Pyx_Raise(PyObject *type, PyObject *value, PyObject *tb, PyObject *cause) {
    PyObject* owned_instance = NULL;
    if (tb == Py_None) {
        tb = 0;
    } else if (tb && !PyTraceBack_Check(tb)) {
        PyErr_SetString(PyExc_TypeError,
            "raise: arg 3 must be a traceback or None");
        goto bad;
    }
    if (value == Py_None)
        value = 0;
    if (PyExceptionInstance_Check(type)) {
        if (value) {
            PyErr_SetString(PyExc_TypeError,
                "instance exception may not have a separate value");
            goto bad;
        }
        value = type;
        type = (PyObject*) Py_TYPE(value);
    } else if (PyExceptionClass_Check(type)) {
        PyObject *args;
        if (!value)
            args = PyTuple_New(0);
        else if (PyTuple_Check(value)) {
            Py_INCREF(value);
            args = value;
        } else
            args = PyTuple_Pack(1, value);
        if (!args)
            goto bad;
        owned_instance = PyEval_CallObject(type, args);
        Py_DECREF(args);
        if (!owned_instance)
            goto bad;
        value = owned_instance;
        if (!PyExceptionInstance_Check(value)) {
            PyErr_Format(PyExc_TypeError,
                         "calling %R should have returned an instance of "
                         "BaseException, not %R",
                         type, Py_TYPE(value));
            goto bad;
        }
    } else {
        PyErr_SetString(PyExc_TypeError,
            "raise: exception class must be a subclass of BaseException");
        goto bad;
    }
#if PY_VERSION_HEX >= 0x03030000
    if (cause) {
#else
    if (cause && cause != Py_None) {
#endif
        PyObject *fixed_cause;
        if (cause == Py_None) {
            fixed_cause = NULL;
        } else if (PyExceptionClass_Check(cause)) {
            fixed_cause = PyObject_CallObject(cause, NULL);
            if (fixed_cause == NULL)
                goto bad;
        } else if (PyExceptionInstance_Check(cause)) {
            fixed_cause = cause;
            Py_INCREF(fixed_cause);
        } else {
            PyErr_SetString(PyExc_TypeError,
                            "exception causes must derive from "
                            "BaseException");
            goto bad;
        }
        PyException_SetCause(value, fixed_cause);
    }
    PyErr_SetObject(type, value);
    if (tb) {
        PyThreadState *tstate = PyThreadState_GET();
        PyObject* tmp_tb = tstate->curexc_traceback;
        if (tb != tmp_tb) {
            Py_INCREF(tb);
            tstate->curexc_traceback = tb;
            Py_XDECREF(tmp_tb);
        }
    }
bad:
    Py_XDECREF(owned_instance);
    return;
}
#endif

static void __Pyx_WriteUnraisable(const char *name, CYTHON_UNUSED int clineno,
                                  CYTHON_UNUSED int lineno, CYTHON_UNUSED const char *filename) {
    PyObject *old_exc, *old_val, *old_tb;
    PyObject *ctx;
    __Pyx_ErrFetch(&old_exc, &old_val, &old_tb);
    #if PY_MAJOR_VERSION < 3
    ctx = PyString_FromString(name);
    #else
    ctx = PyUnicode_FromString(name);
    #endif
    __Pyx_ErrRestore(old_exc, old_val, old_tb);
    if (!ctx) {
        PyErr_WriteUnraisable(Py_None);
    } else {
        PyErr_WriteUnraisable(ctx);
        Py_DECREF(ctx);
    }
}

static CYTHON_INLINE int __Pyx_CheckKeywordStrings(
    PyObject *kwdict,
    const char* function_name,
    int kw_allowed)
{
    PyObject* key = 0;
    Py_ssize_t pos = 0;
#if CPYTHON_COMPILING_IN_PYPY
    if (!kw_allowed && PyDict_Next(kwdict, &pos, &key, 0))
        goto invalid_keyword;
    return 1;
#else
    while (PyDict_Next(kwdict, &pos, &key, 0)) {
        #if PY_MAJOR_VERSION < 3
        if (unlikely(!PyString_CheckExact(key)) && unlikely(!PyString_Check(key)))
        #endif
            if (unlikely(!PyUnicode_Check(key)))
                goto invalid_keyword_type;
    }
    if ((!kw_allowed) && unlikely(key))
        goto invalid_keyword;
    return 1;
invalid_keyword_type:
    PyErr_Format(PyExc_TypeError,
        "%s() keywords must be strings", function_name);
    return 0;
#endif
invalid_keyword:
    PyErr_Format(PyExc_TypeError,
    #if PY_MAJOR_VERSION < 3
        "%s() got an unexpected keyword argument '%s'",
        function_name, PyString_AsString(key));
    #else
        "%s() got an unexpected keyword argument '%U'",
        function_name, key);
    #endif
    return 0;
}

static void __Pyx_RaiseDoubleKeywordsError(
    const char* func_name,
    PyObject* kw_name)
{
    PyErr_Format(PyExc_TypeError,
        #if PY_MAJOR_VERSION >= 3
        "%s() got multiple values for keyword argument '%U'", func_name, kw_name);
        #else
        "%s() got multiple values for keyword argument '%s'", func_name,
        PyString_AsString(kw_name));
        #endif
}

static int __Pyx_ParseOptionalKeywords(
    PyObject *kwds,
    PyObject **argnames[],
    PyObject *kwds2,
    PyObject *values[],
    Py_ssize_t num_pos_args,
    const char* function_name)
{
    PyObject *key = 0, *value = 0;
    Py_ssize_t pos = 0;
    PyObject*** name;
    PyObject*** first_kw_arg = argnames + num_pos_args;
    while (PyDict_Next(kwds, &pos, &key, &value)) {
        name = first_kw_arg;
        while (*name && (**name != key)) name++;
        if (*name) {
            values[name-argnames] = value;
            continue;
        }
        name = first_kw_arg;
        #if PY_MAJOR_VERSION < 3
        if (likely(PyString_CheckExact(key)) || likely(PyString_Check(key))) {
            while (*name) {
                if ((CYTHON_COMPILING_IN_PYPY || PyString_GET_SIZE(**name) == PyString_GET_SIZE(key))
                        && _PyString_Eq(**name, key)) {
                    values[name-argnames] = value;
                    break;
                }
                name++;
            }
            if (*name) continue;
            else {
                PyObject*** argname = argnames;
                while (argname != first_kw_arg) {
                    if ((**argname == key) || (
                            (CYTHON_COMPILING_IN_PYPY || PyString_GET_SIZE(**argname) == PyString_GET_SIZE(key))
                             && _PyString_Eq(**argname, key))) {
                        goto arg_passed_twice;
                    }
                    argname++;
                }
            }
        } else
        #endif
        if (likely(PyUnicode_Check(key))) {
            while (*name) {
                int cmp = (**name == key) ? 0 :
                #if !CYTHON_COMPILING_IN_PYPY && PY_MAJOR_VERSION >= 3
                    (PyUnicode_GET_SIZE(**name) != PyUnicode_GET_SIZE(key)) ? 1 :
                #endif
                    PyUnicode_Compare(**name, key);
                if (cmp < 0 && unlikely(PyErr_Occurred())) goto bad;
                if (cmp == 0) {
                    values[name-argnames] = value;
                    break;
                }
                name++;
            }
            if (*name) continue;
            else {
                PyObject*** argname = argnames;
                while (argname != first_kw_arg) {
                    int cmp = (**argname == key) ? 0 :
                    #if !CYTHON_COMPILING_IN_PYPY && PY_MAJOR_VERSION >= 3
                        (PyUnicode_GET_SIZE(**argname) != PyUnicode_GET_SIZE(key)) ? 1 :
                    #endif
                        PyUnicode_Compare(**argname, key);
                    if (cmp < 0 && unlikely(PyErr_Occurred())) goto bad;
                    if (cmp == 0) goto arg_passed_twice;
                    argname++;
                }
            }
        } else
            goto invalid_keyword_type;
        if (kwds2) {
            if (unlikely(PyDict_SetItem(kwds2, key, value))) goto bad;
        } else {
            goto invalid_keyword;
        }
    }
    return 0;
arg_passed_twice:
    __Pyx_RaiseDoubleKeywordsError(function_name, key);
    goto bad;
invalid_keyword_type:
    PyErr_Format(PyExc_TypeError,
        "%s() keywords must be strings", function_name);
    goto bad;
invalid_keyword:
    PyErr_Format(PyExc_TypeError,
    #if PY_MAJOR_VERSION < 3
        "%s() got an unexpected keyword argument '%s'",
        function_name, PyString_AsString(key));
    #else
        "%s() got an unexpected keyword argument '%U'",
        function_name, key);
    #endif
bad:
    return -1;
}

static void __Pyx_RaiseArgtupleInvalid(
    const char* func_name,
    int exact,
    Py_ssize_t num_min,
    Py_ssize_t num_max,
    Py_ssize_t num_found)
{
    Py_ssize_t num_expected;
    const char *more_or_less;
    if (num_found < num_min) {
        num_expected = num_min;
        more_or_less = "at least";
    } else {
        num_expected = num_max;
        more_or_less = "at most";
    }
    if (exact) {
        more_or_less = "exactly";
    }
    PyErr_Format(PyExc_TypeError,
                 "%s() takes %s %" CYTHON_FORMAT_SSIZE_T "d positional argument%s (%" CYTHON_FORMAT_SSIZE_T "d given)",
                 func_name, more_or_less, num_expected,
                 (num_expected == 1) ? "" : "s", num_found);
}

static int __Pyx_SetVtable(PyObject *dict, void *vtable) {
#if PY_VERSION_HEX >= 0x02070000 && !(PY_MAJOR_VERSION==3&&PY_MINOR_VERSION==0)
    PyObject *ob = PyCapsule_New(vtable, 0, 0);
#else
    PyObject *ob = PyCObject_FromVoidPtr(vtable, 0);
#endif
    if (!ob)
        goto bad;
    if (PyDict_SetItem(dict, __pyx_n_s____pyx_vtable__, ob) < 0)
        goto bad;
    Py_DECREF(ob);
    return 0;
bad:
    Py_XDECREF(ob);
    return -1;
}

static CYTHON_INLINE PyObject *__Pyx_GetModuleGlobalName(PyObject *name) {
    PyObject *result;
#if CYTHON_COMPILING_IN_CPYTHON
    result = PyDict_GetItem(__pyx_d, name);
    if (result) {
        Py_INCREF(result);
    } else {
#else
    result = PyObject_GetItem(__pyx_d, name);
    if (!result) {
        PyErr_Clear();
#endif
        result = __Pyx_GetBuiltinName(name);
    }
    return result;
}

#if !CYTHON_COMPILING_IN_PYPY && PY_MAJOR_VERSION < 3
static PyObject *__Pyx_GetStdout(void) {
    PyObject *f = PySys_GetObject((char *)"stdout");
    if (!f) {
        PyErr_SetString(PyExc_RuntimeError, "lost sys.stdout");
    }
    return f;
}
static int __Pyx_Print(PyObject* f, PyObject *arg_tuple, int newline) {
    int i;
    if (!f) {
        if (!(f = __Pyx_GetStdout()))
            return -1;
    }
    Py_INCREF(f);
    for (i=0; i < PyTuple_GET_SIZE(arg_tuple); i++) {
        PyObject* v;
        if (PyFile_SoftSpace(f, 1)) {
            if (PyFile_WriteString(" ", f) < 0)
                goto error;
        }
        v = PyTuple_GET_ITEM(arg_tuple, i);
        if (PyFile_WriteObject(v, f, Py_PRINT_RAW) < 0)
            goto error;
        if (PyString_Check(v)) {
            char *s = PyString_AsString(v);
            Py_ssize_t len = PyString_Size(v);
            if (len > 0 &&
                isspace(Py_CHARMASK(s[len-1])) &&
                s[len-1] != ' ')
                    PyFile_SoftSpace(f, 0);
        }
    }
    if (newline) {
        if (PyFile_WriteString("\n", f) < 0)
            goto error;
        PyFile_SoftSpace(f, 0);
    }
    Py_DECREF(f);
    return 0;
error:
    Py_DECREF(f);
    return -1;
}
#else /* Python 3 has a print function */
static int __Pyx_Print(PyObject* stream, PyObject *arg_tuple, int newline) {
    PyObject* kwargs = 0;
    PyObject* result = 0;
    PyObject* end_string;
    if (unlikely(!__pyx_print)) {
        __pyx_print = PyObject_GetAttr(__pyx_b, __pyx_n_s__print);
        if (!__pyx_print)
            return -1;
    }
    if (stream) {
        kwargs = PyDict_New();
        if (unlikely(!kwargs))
            return -1;
        if (unlikely(PyDict_SetItem(kwargs, __pyx_n_s__file, stream) < 0))
            goto bad;
        if (!newline) {
            end_string = PyUnicode_FromStringAndSize(" ", 1);
            if (unlikely(!end_string))
                goto bad;
            if (PyDict_SetItem(kwargs, __pyx_n_s__end, end_string) < 0) {
                Py_DECREF(end_string);
                goto bad;
            }
            Py_DECREF(end_string);
        }
    } else if (!newline) {
        if (unlikely(!__pyx_print_kwargs)) {
            __pyx_print_kwargs = PyDict_New();
            if (unlikely(!__pyx_print_kwargs))
                return -1;
            end_string = PyUnicode_FromStringAndSize(" ", 1);
            if (unlikely(!end_string))
                return -1;
            if (PyDict_SetItem(__pyx_print_kwargs, __pyx_n_s__end, end_string) < 0) {
                Py_DECREF(end_string);
                return -1;
            }
            Py_DECREF(end_string);
        }
        kwargs = __pyx_print_kwargs;
    }
    result = PyObject_Call(__pyx_print, arg_tuple, kwargs);
    if (unlikely(kwargs) && (kwargs != __pyx_print_kwargs))
        Py_DECREF(kwargs);
    if (!result)
        return -1;
    Py_DECREF(result);
    return 0;
bad:
    if (kwargs != __pyx_print_kwargs)
        Py_XDECREF(kwargs);
    return -1;
}
#endif

static CYTHON_INLINE unsigned char __Pyx_PyInt_AsUnsignedChar(PyObject* x) {
    const unsigned char neg_one = (unsigned char)-1, const_zero = 0;
    const int is_unsigned = neg_one > const_zero;
    if (sizeof(unsigned char) < sizeof(long)) {
        long val = __Pyx_PyInt_AsLong(x);
        if (unlikely(val != (long)(unsigned char)val)) {
            if (!unlikely(val == -1 && PyErr_Occurred())) {
                PyErr_SetString(PyExc_OverflowError,
                    (is_unsigned && unlikely(val < 0)) ?
                    "can't convert negative value to unsigned char" :
                    "value too large to convert to unsigned char");
            }
            return (unsigned char)-1;
        }
        return (unsigned char)val;
    }
    return (unsigned char)__Pyx_PyInt_AsUnsignedLong(x);
}

static CYTHON_INLINE unsigned short __Pyx_PyInt_AsUnsignedShort(PyObject* x) {
    const unsigned short neg_one = (unsigned short)-1, const_zero = 0;
    const int is_unsigned = neg_one > const_zero;
    if (sizeof(unsigned short) < sizeof(long)) {
        long val = __Pyx_PyInt_AsLong(x);
        if (unlikely(val != (long)(unsigned short)val)) {
            if (!unlikely(val == -1 && PyErr_Occurred())) {
                PyErr_SetString(PyExc_OverflowError,
                    (is_unsigned && unlikely(val < 0)) ?
                    "can't convert negative value to unsigned short" :
                    "value too large to convert to unsigned short");
            }
            return (unsigned short)-1;
        }
        return (unsigned short)val;
    }
    return (unsigned short)__Pyx_PyInt_AsUnsignedLong(x);
}

static CYTHON_INLINE unsigned int __Pyx_PyInt_AsUnsignedInt(PyObject* x) {
    const unsigned int neg_one = (unsigned int)-1, const_zero = 0;
    const int is_unsigned = neg_one > const_zero;
    if (sizeof(unsigned int) < sizeof(long)) {
        long val = __Pyx_PyInt_AsLong(x);
        if (unlikely(val != (long)(unsigned int)val)) {
            if (!unlikely(val == -1 && PyErr_Occurred())) {
                PyErr_SetString(PyExc_OverflowError,
                    (is_unsigned && unlikely(val < 0)) ?
                    "can't convert negative value to unsigned int" :
                    "value too large to convert to unsigned int");
            }
            return (unsigned int)-1;
        }
        return (unsigned int)val;
    }
    return (unsigned int)__Pyx_PyInt_AsUnsignedLong(x);
}

static CYTHON_INLINE char __Pyx_PyInt_AsChar(PyObject* x) {
    const char neg_one = (char)-1, const_zero = 0;
    const int is_unsigned = neg_one > const_zero;
    if (sizeof(char) < sizeof(long)) {
        long val = __Pyx_PyInt_AsLong(x);
        if (unlikely(val != (long)(char)val)) {
            if (!unlikely(val == -1 && PyErr_Occurred())) {
                PyErr_SetString(PyExc_OverflowError,
                    (is_unsigned && unlikely(val < 0)) ?
                    "can't convert negative value to char" :
                    "value too large to convert to char");
            }
            return (char)-1;
        }
        return (char)val;
    }
    return (char)__Pyx_PyInt_AsLong(x);
}

static CYTHON_INLINE short __Pyx_PyInt_AsShort(PyObject* x) {
    const short neg_one = (short)-1, const_zero = 0;
    const int is_unsigned = neg_one > const_zero;
    if (sizeof(short) < sizeof(long)) {
        long val = __Pyx_PyInt_AsLong(x);
        if (unlikely(val != (long)(short)val)) {
            if (!unlikely(val == -1 && PyErr_Occurred())) {
                PyErr_SetString(PyExc_OverflowError,
                    (is_unsigned && unlikely(val < 0)) ?
                    "can't convert negative value to short" :
                    "value too large to convert to short");
            }
            return (short)-1;
        }
        return (short)val;
    }
    return (short)__Pyx_PyInt_AsLong(x);
}

static CYTHON_INLINE int __Pyx_PyInt_AsInt(PyObject* x) {
    const int neg_one = (int)-1, const_zero = 0;
    const int is_unsigned = neg_one > const_zero;
    if (sizeof(int) < sizeof(long)) {
        long val = __Pyx_PyInt_AsLong(x);
        if (unlikely(val != (long)(int)val)) {
            if (!unlikely(val == -1 && PyErr_Occurred())) {
                PyErr_SetString(PyExc_OverflowError,
                    (is_unsigned && unlikely(val < 0)) ?
                    "can't convert negative value to int" :
                    "value too large to convert to int");
            }
            return (int)-1;
        }
        return (int)val;
    }
    return (int)__Pyx_PyInt_AsLong(x);
}

static CYTHON_INLINE signed char __Pyx_PyInt_AsSignedChar(PyObject* x) {
    const signed char neg_one = (signed char)-1, const_zero = 0;
    const int is_unsigned = neg_one > const_zero;
    if (sizeof(signed char) < sizeof(long)) {
        long val = __Pyx_PyInt_AsLong(x);
        if (unlikely(val != (long)(signed char)val)) {
            if (!unlikely(val == -1 && PyErr_Occurred())) {
                PyErr_SetString(PyExc_OverflowError,
                    (is_unsigned && unlikely(val < 0)) ?
                    "can't convert negative value to signed char" :
                    "value too large to convert to signed char");
            }
            return (signed char)-1;
        }
        return (signed char)val;
    }
    return (signed char)__Pyx_PyInt_AsSignedLong(x);
}

static CYTHON_INLINE signed short __Pyx_PyInt_AsSignedShort(PyObject* x) {
    const signed short neg_one = (signed short)-1, const_zero = 0;
    const int is_unsigned = neg_one > const_zero;
    if (sizeof(signed short) < sizeof(long)) {
        long val = __Pyx_PyInt_AsLong(x);
        if (unlikely(val != (long)(signed short)val)) {
            if (!unlikely(val == -1 && PyErr_Occurred())) {
                PyErr_SetString(PyExc_OverflowError,
                    (is_unsigned && unlikely(val < 0)) ?
                    "can't convert negative value to signed short" :
                    "value too large to convert to signed short");
            }
            return (signed short)-1;
        }
        return (signed short)val;
    }
    return (signed short)__Pyx_PyInt_AsSignedLong(x);
}

static CYTHON_INLINE signed int __Pyx_PyInt_AsSignedInt(PyObject* x) {
    const signed int neg_one = (signed int)-1, const_zero = 0;
    const int is_unsigned = neg_one > const_zero;
    if (sizeof(signed int) < sizeof(long)) {
        long val = __Pyx_PyInt_AsLong(x);
        if (unlikely(val != (long)(signed int)val)) {
            if (!unlikely(val == -1 && PyErr_Occurred())) {
                PyErr_SetString(PyExc_OverflowError,
                    (is_unsigned && unlikely(val < 0)) ?
                    "can't convert negative value to signed int" :
                    "value too large to convert to signed int");
            }
            return (signed int)-1;
        }
        return (signed int)val;
    }
    return (signed int)__Pyx_PyInt_AsSignedLong(x);
}

static CYTHON_INLINE int __Pyx_PyInt_AsLongDouble(PyObject* x) {
    const int neg_one = (int)-1, const_zero = 0;
    const int is_unsigned = neg_one > const_zero;
    if (sizeof(int) < sizeof(long)) {
        long val = __Pyx_PyInt_AsLong(x);
        if (unlikely(val != (long)(int)val)) {
            if (!unlikely(val == -1 && PyErr_Occurred())) {
                PyErr_SetString(PyExc_OverflowError,
                    (is_unsigned && unlikely(val < 0)) ?
                    "can't convert negative value to int" :
                    "value too large to convert to int");
            }
            return (int)-1;
        }
        return (int)val;
    }
    return (int)__Pyx_PyInt_AsLong(x);
}

#if CYTHON_COMPILING_IN_CPYTHON && PY_MAJOR_VERSION >= 3
#if CYTHON_USE_PYLONG_INTERNALS
#include "longintrepr.h"
#endif
#endif
static CYTHON_INLINE unsigned long __Pyx_PyInt_AsUnsignedLong(PyObject* x) {
    const unsigned long neg_one = (unsigned long)-1, const_zero = 0;
    const int is_unsigned = neg_one > const_zero;
#if PY_MAJOR_VERSION < 3
    if (likely(PyInt_Check(x))) {
        long val = PyInt_AS_LONG(x);
        if (is_unsigned && unlikely(val < 0)) {
            PyErr_SetString(PyExc_OverflowError,
                            "can't convert negative value to unsigned long");
            return (unsigned long)-1;
        }
        return (unsigned long)val;
    } else
#endif
    if (likely(PyLong_Check(x))) {
        if (is_unsigned) {
#if CYTHON_COMPILING_IN_CPYTHON && PY_MAJOR_VERSION >= 3
#if CYTHON_USE_PYLONG_INTERNALS
            if (sizeof(digit) <= sizeof(unsigned long)) {
                switch (Py_SIZE(x)) {
                    case  0: return 0;
                    case  1: return (unsigned long) ((PyLongObject*)x)->ob_digit[0];
                }
            }
#endif
#endif
            if (unlikely(Py_SIZE(x) < 0)) {
                PyErr_SetString(PyExc_OverflowError,
                                "can't convert negative value to unsigned long");
                return (unsigned long)-1;
            }
            return (unsigned long)PyLong_AsUnsignedLong(x);
        } else {
#if CYTHON_COMPILING_IN_CPYTHON && PY_MAJOR_VERSION >= 3
#if CYTHON_USE_PYLONG_INTERNALS
            if (sizeof(digit) <= sizeof(unsigned long)) {
                switch (Py_SIZE(x)) {
                    case  0: return 0;
                    case  1: return +(unsigned long) ((PyLongObject*)x)->ob_digit[0];
                    case -1: return -(unsigned long) ((PyLongObject*)x)->ob_digit[0];
                }
            }
#endif
#endif
            return (unsigned long)PyLong_AsLong(x);
        }
    } else {
        unsigned long val;
        PyObject *tmp = __Pyx_PyNumber_Int(x);
        if (!tmp) return (unsigned long)-1;
        val = __Pyx_PyInt_AsUnsignedLong(tmp);
        Py_DECREF(tmp);
        return val;
    }
}

#if CYTHON_COMPILING_IN_CPYTHON && PY_MAJOR_VERSION >= 3
#if CYTHON_USE_PYLONG_INTERNALS
#include "longintrepr.h"
#endif
#endif
static CYTHON_INLINE unsigned PY_LONG_LONG __Pyx_PyInt_AsUnsignedLongLong(PyObject* x) {
    const unsigned PY_LONG_LONG neg_one = (unsigned PY_LONG_LONG)-1, const_zero = 0;
    const int is_unsigned = neg_one > const_zero;
#if PY_MAJOR_VERSION < 3
    if (likely(PyInt_Check(x))) {
        long val = PyInt_AS_LONG(x);
        if (is_unsigned && unlikely(val < 0)) {
            PyErr_SetString(PyExc_OverflowError,
                            "can't convert negative value to unsigned PY_LONG_LONG");
            return (unsigned PY_LONG_LONG)-1;
        }
        return (unsigned PY_LONG_LONG)val;
    } else
#endif
    if (likely(PyLong_Check(x))) {
        if (is_unsigned) {
#if CYTHON_COMPILING_IN_CPYTHON && PY_MAJOR_VERSION >= 3
#if CYTHON_USE_PYLONG_INTERNALS
            if (sizeof(digit) <= sizeof(unsigned PY_LONG_LONG)) {
                switch (Py_SIZE(x)) {
                    case  0: return 0;
                    case  1: return (unsigned PY_LONG_LONG) ((PyLongObject*)x)->ob_digit[0];
                }
            }
#endif
#endif
            if (unlikely(Py_SIZE(x) < 0)) {
                PyErr_SetString(PyExc_OverflowError,
                                "can't convert negative value to unsigned PY_LONG_LONG");
                return (unsigned PY_LONG_LONG)-1;
            }
            return (unsigned PY_LONG_LONG)PyLong_AsUnsignedLongLong(x);
        } else {
#if CYTHON_COMPILING_IN_CPYTHON && PY_MAJOR_VERSION >= 3
#if CYTHON_USE_PYLONG_INTERNALS
            if (sizeof(digit) <= sizeof(unsigned PY_LONG_LONG)) {
                switch (Py_SIZE(x)) {
                    case  0: return 0;
                    case  1: return +(unsigned PY_LONG_LONG) ((PyLongObject*)x)->ob_digit[0];
                    case -1: return -(unsigned PY_LONG_LONG) ((PyLongObject*)x)->ob_digit[0];
                }
            }
#endif
#endif
            return (unsigned PY_LONG_LONG)PyLong_AsLongLong(x);
        }
    } else {
        unsigned PY_LONG_LONG val;
        PyObject *tmp = __Pyx_PyNumber_Int(x);
        if (!tmp) return (unsigned PY_LONG_LONG)-1;
        val = __Pyx_PyInt_AsUnsignedLongLong(tmp);
        Py_DECREF(tmp);
        return val;
    }
}

#if CYTHON_COMPILING_IN_CPYTHON && PY_MAJOR_VERSION >= 3
#if CYTHON_USE_PYLONG_INTERNALS
#include "longintrepr.h"
#endif
#endif
static CYTHON_INLINE long __Pyx_PyInt_AsLong(PyObject* x) {
    const long neg_one = (long)-1, const_zero = 0;
    const int is_unsigned = neg_one > const_zero;
#if PY_MAJOR_VERSION < 3
    if (likely(PyInt_Check(x))) {
        long val = PyInt_AS_LONG(x);
        if (is_unsigned && unlikely(val < 0)) {
            PyErr_SetString(PyExc_OverflowError,
                            "can't convert negative value to long");
            return (long)-1;
        }
        return (long)val;
    } else
#endif
    if (likely(PyLong_Check(x))) {
        if (is_unsigned) {
#if CYTHON_COMPILING_IN_CPYTHON && PY_MAJOR_VERSION >= 3
#if CYTHON_USE_PYLONG_INTERNALS
            if (sizeof(digit) <= sizeof(long)) {
                switch (Py_SIZE(x)) {
                    case  0: return 0;
                    case  1: return (long) ((PyLongObject*)x)->ob_digit[0];
                }
            }
#endif
#endif
            if (unlikely(Py_SIZE(x) < 0)) {
                PyErr_SetString(PyExc_OverflowError,
                                "can't convert negative value to long");
                return (long)-1;
            }
            return (long)PyLong_AsUnsignedLong(x);
        } else {
#if CYTHON_COMPILING_IN_CPYTHON && PY_MAJOR_VERSION >= 3
#if CYTHON_USE_PYLONG_INTERNALS
            if (sizeof(digit) <= sizeof(long)) {
                switch (Py_SIZE(x)) {
                    case  0: return 0;
                    case  1: return +(long) ((PyLongObject*)x)->ob_digit[0];
                    case -1: return -(long) ((PyLongObject*)x)->ob_digit[0];
                }
            }
#endif
#endif
            return (long)PyLong_AsLong(x);
        }
    } else {
        long val;
        PyObject *tmp = __Pyx_PyNumber_Int(x);
        if (!tmp) return (long)-1;
        val = __Pyx_PyInt_AsLong(tmp);
        Py_DECREF(tmp);
        return val;
    }
}

#if CYTHON_COMPILING_IN_CPYTHON && PY_MAJOR_VERSION >= 3
#if CYTHON_USE_PYLONG_INTERNALS
#include "longintrepr.h"
#endif
#endif
static CYTHON_INLINE PY_LONG_LONG __Pyx_PyInt_AsLongLong(PyObject* x) {
    const PY_LONG_LONG neg_one = (PY_LONG_LONG)-1, const_zero = 0;
    const int is_unsigned = neg_one > const_zero;
#if PY_MAJOR_VERSION < 3
    if (likely(PyInt_Check(x))) {
        long val = PyInt_AS_LONG(x);
        if (is_unsigned && unlikely(val < 0)) {
            PyErr_SetString(PyExc_OverflowError,
                            "can't convert negative value to PY_LONG_LONG");
            return (PY_LONG_LONG)-1;
        }
        return (PY_LONG_LONG)val;
    } else
#endif
    if (likely(PyLong_Check(x))) {
        if (is_unsigned) {
#if CYTHON_COMPILING_IN_CPYTHON && PY_MAJOR_VERSION >= 3
#if CYTHON_USE_PYLONG_INTERNALS
            if (sizeof(digit) <= sizeof(PY_LONG_LONG)) {
                switch (Py_SIZE(x)) {
                    case  0: return 0;
                    case  1: return (PY_LONG_LONG) ((PyLongObject*)x)->ob_digit[0];
                }
            }
#endif
#endif
            if (unlikely(Py_SIZE(x) < 0)) {
                PyErr_SetString(PyExc_OverflowError,
                                "can't convert negative value to PY_LONG_LONG");
                return (PY_LONG_LONG)-1;
            }
            return (PY_LONG_LONG)PyLong_AsUnsignedLongLong(x);
        } else {
#if CYTHON_COMPILING_IN_CPYTHON && PY_MAJOR_VERSION >= 3
#if CYTHON_USE_PYLONG_INTERNALS
            if (sizeof(digit) <= sizeof(PY_LONG_LONG)) {
                switch (Py_SIZE(x)) {
                    case  0: return 0;
                    case  1: return +(PY_LONG_LONG) ((PyLongObject*)x)->ob_digit[0];
                    case -1: return -(PY_LONG_LONG) ((PyLongObject*)x)->ob_digit[0];
                }
            }
#endif
#endif
            return (PY_LONG_LONG)PyLong_AsLongLong(x);
        }
    } else {
        PY_LONG_LONG val;
        PyObject *tmp = __Pyx_PyNumber_Int(x);
        if (!tmp) return (PY_LONG_LONG)-1;
        val = __Pyx_PyInt_AsLongLong(tmp);
        Py_DECREF(tmp);
        return val;
    }
}

#if CYTHON_COMPILING_IN_CPYTHON && PY_MAJOR_VERSION >= 3
#if CYTHON_USE_PYLONG_INTERNALS
#include "longintrepr.h"
#endif
#endif
static CYTHON_INLINE signed long __Pyx_PyInt_AsSignedLong(PyObject* x) {
    const signed long neg_one = (signed long)-1, const_zero = 0;
    const int is_unsigned = neg_one > const_zero;
#if PY_MAJOR_VERSION < 3
    if (likely(PyInt_Check(x))) {
        long val = PyInt_AS_LONG(x);
        if (is_unsigned && unlikely(val < 0)) {
            PyErr_SetString(PyExc_OverflowError,
                            "can't convert negative value to signed long");
            return (signed long)-1;
        }
        return (signed long)val;
    } else
#endif
    if (likely(PyLong_Check(x))) {
        if (is_unsigned) {
#if CYTHON_COMPILING_IN_CPYTHON && PY_MAJOR_VERSION >= 3
#if CYTHON_USE_PYLONG_INTERNALS
            if (sizeof(digit) <= sizeof(signed long)) {
                switch (Py_SIZE(x)) {
                    case  0: return 0;
                    case  1: return (signed long) ((PyLongObject*)x)->ob_digit[0];
                }
            }
#endif
#endif
            if (unlikely(Py_SIZE(x) < 0)) {
                PyErr_SetString(PyExc_OverflowError,
                                "can't convert negative value to signed long");
                return (signed long)-1;
            }
            return (signed long)PyLong_AsUnsignedLong(x);
        } else {
#if CYTHON_COMPILING_IN_CPYTHON && PY_MAJOR_VERSION >= 3
#if CYTHON_USE_PYLONG_INTERNALS
            if (sizeof(digit) <= sizeof(signed long)) {
                switch (Py_SIZE(x)) {
                    case  0: return 0;
                    case  1: return +(signed long) ((PyLongObject*)x)->ob_digit[0];
                    case -1: return -(signed long) ((PyLongObject*)x)->ob_digit[0];
                }
            }
#endif
#endif
            return (signed long)PyLong_AsLong(x);
        }
    } else {
        signed long val;
        PyObject *tmp = __Pyx_PyNumber_Int(x);
        if (!tmp) return (signed long)-1;
        val = __Pyx_PyInt_AsSignedLong(tmp);
        Py_DECREF(tmp);
        return val;
    }
}

#if CYTHON_COMPILING_IN_CPYTHON && PY_MAJOR_VERSION >= 3
#if CYTHON_USE_PYLONG_INTERNALS
#include "longintrepr.h"
#endif
#endif
static CYTHON_INLINE signed PY_LONG_LONG __Pyx_PyInt_AsSignedLongLong(PyObject* x) {
    const signed PY_LONG_LONG neg_one = (signed PY_LONG_LONG)-1, const_zero = 0;
    const int is_unsigned = neg_one > const_zero;
#if PY_MAJOR_VERSION < 3
    if (likely(PyInt_Check(x))) {
        long val = PyInt_AS_LONG(x);
        if (is_unsigned && unlikely(val < 0)) {
            PyErr_SetString(PyExc_OverflowError,
                            "can't convert negative value to signed PY_LONG_LONG");
            return (signed PY_LONG_LONG)-1;
        }
        return (signed PY_LONG_LONG)val;
    } else
#endif
    if (likely(PyLong_Check(x))) {
        if (is_unsigned) {
#if CYTHON_COMPILING_IN_CPYTHON && PY_MAJOR_VERSION >= 3
#if CYTHON_USE_PYLONG_INTERNALS
            if (sizeof(digit) <= sizeof(signed PY_LONG_LONG)) {
                switch (Py_SIZE(x)) {
                    case  0: return 0;
                    case  1: return (signed PY_LONG_LONG) ((PyLongObject*)x)->ob_digit[0];
                }
            }
#endif
#endif
            if (unlikely(Py_SIZE(x) < 0)) {
                PyErr_SetString(PyExc_OverflowError,
                                "can't convert negative value to signed PY_LONG_LONG");
                return (signed PY_LONG_LONG)-1;
            }
            return (signed PY_LONG_LONG)PyLong_AsUnsignedLongLong(x);
        } else {
#if CYTHON_COMPILING_IN_CPYTHON && PY_MAJOR_VERSION >= 3
#if CYTHON_USE_PYLONG_INTERNALS
            if (sizeof(digit) <= sizeof(signed PY_LONG_LONG)) {
                switch (Py_SIZE(x)) {
                    case  0: return 0;
                    case  1: return +(signed PY_LONG_LONG) ((PyLongObject*)x)->ob_digit[0];
                    case -1: return -(signed PY_LONG_LONG) ((PyLongObject*)x)->ob_digit[0];
                }
            }
#endif
#endif
            return (signed PY_LONG_LONG)PyLong_AsLongLong(x);
        }
    } else {
        signed PY_LONG_LONG val;
        PyObject *tmp = __Pyx_PyNumber_Int(x);
        if (!tmp) return (signed PY_LONG_LONG)-1;
        val = __Pyx_PyInt_AsSignedLongLong(tmp);
        Py_DECREF(tmp);
        return val;
    }
}

static int __Pyx_check_binary_version(void) {
    char ctversion[4], rtversion[4];
    PyOS_snprintf(ctversion, 4, "%d.%d", PY_MAJOR_VERSION, PY_MINOR_VERSION);
    PyOS_snprintf(rtversion, 4, "%s", Py_GetVersion());
    if (ctversion[0] != rtversion[0] || ctversion[2] != rtversion[2]) {
        char message[200];
        PyOS_snprintf(message, sizeof(message),
                      "compiletime version %s of module '%.100s' "
                      "does not match runtime version %s",
                      ctversion, __Pyx_MODULE_NAME, rtversion);
        #if PY_VERSION_HEX < 0x02050000
        return PyErr_Warn(NULL, message);
        #else
        return PyErr_WarnEx(NULL, message, 1);
        #endif
    }
    return 0;
}

static int __pyx_bisect_code_objects(__Pyx_CodeObjectCacheEntry* entries, int count, int code_line) {
    int start = 0, mid = 0, end = count - 1;
    if (end >= 0 && code_line > entries[end].code_line) {
        return count;
    }
    while (start < end) {
        mid = (start + end) / 2;
        if (code_line < entries[mid].code_line) {
            end = mid;
        } else if (code_line > entries[mid].code_line) {
             start = mid + 1;
        } else {
            return mid;
        }
    }
    if (code_line <= entries[mid].code_line) {
        return mid;
    } else {
        return mid + 1;
    }
}
static PyCodeObject *__pyx_find_code_object(int code_line) {
    PyCodeObject* code_object;
    int pos;
    if (unlikely(!code_line) || unlikely(!__pyx_code_cache.entries)) {
        return NULL;
    }
    pos = __pyx_bisect_code_objects(__pyx_code_cache.entries, __pyx_code_cache.count, code_line);
    if (unlikely(pos >= __pyx_code_cache.count) || unlikely(__pyx_code_cache.entries[pos].code_line != code_line)) {
        return NULL;
    }
    code_object = __pyx_code_cache.entries[pos].code_object;
    Py_INCREF(code_object);
    return code_object;
}
static void __pyx_insert_code_object(int code_line, PyCodeObject* code_object) {
    int pos, i;
    __Pyx_CodeObjectCacheEntry* entries = __pyx_code_cache.entries;
    if (unlikely(!code_line)) {
        return;
    }
    if (unlikely(!entries)) {
        entries = (__Pyx_CodeObjectCacheEntry*)PyMem_Malloc(64*sizeof(__Pyx_CodeObjectCacheEntry));
        if (likely(entries)) {
            __pyx_code_cache.entries = entries;
            __pyx_code_cache.max_count = 64;
            __pyx_code_cache.count = 1;
            entries[0].code_line = code_line;
            entries[0].code_object = code_object;
            Py_INCREF(code_object);
        }
        return;
    }
    pos = __pyx_bisect_code_objects(__pyx_code_cache.entries, __pyx_code_cache.count, code_line);
    if ((pos < __pyx_code_cache.count) && unlikely(__pyx_code_cache.entries[pos].code_line == code_line)) {
        PyCodeObject* tmp = entries[pos].code_object;
        entries[pos].code_object = code_object;
        Py_DECREF(tmp);
        return;
    }
    if (__pyx_code_cache.count == __pyx_code_cache.max_count) {
        int new_max = __pyx_code_cache.max_count + 64;
        entries = (__Pyx_CodeObjectCacheEntry*)PyMem_Realloc(
            __pyx_code_cache.entries, new_max*sizeof(__Pyx_CodeObjectCacheEntry));
        if (unlikely(!entries)) {
            return;
        }
        __pyx_code_cache.entries = entries;
        __pyx_code_cache.max_count = new_max;
    }
    for (i=__pyx_code_cache.count; i>pos; i--) {
        entries[i] = entries[i-1];
    }
    entries[pos].code_line = code_line;
    entries[pos].code_object = code_object;
    __pyx_code_cache.count++;
    Py_INCREF(code_object);
}

#include "compile.h"
#include "frameobject.h"
#include "traceback.h"
static PyCodeObject* __Pyx_CreateCodeObjectForTraceback(
            const char *funcname, int c_line,
            int py_line, const char *filename) {
    PyCodeObject *py_code = 0;
    PyObject *py_srcfile = 0;
    PyObject *py_funcname = 0;
    #if PY_MAJOR_VERSION < 3
    py_srcfile = PyString_FromString(filename);
    #else
    py_srcfile = PyUnicode_FromString(filename);
    #endif
    if (!py_srcfile) goto bad;
    if (c_line) {
        #if PY_MAJOR_VERSION < 3
        py_funcname = PyString_FromFormat( "%s (%s:%d)", funcname, __pyx_cfilenm, c_line);
        #else
        py_funcname = PyUnicode_FromFormat( "%s (%s:%d)", funcname, __pyx_cfilenm, c_line);
        #endif
    }
    else {
        #if PY_MAJOR_VERSION < 3
        py_funcname = PyString_FromString(funcname);
        #else
        py_funcname = PyUnicode_FromString(funcname);
        #endif
    }
    if (!py_funcname) goto bad;
    py_code = __Pyx_PyCode_New(
        0,            /*int argcount,*/
        0,            /*int kwonlyargcount,*/
        0,            /*int nlocals,*/
        0,            /*int stacksize,*/
        0,            /*int flags,*/
        __pyx_empty_bytes, /*PyObject *code,*/
        __pyx_empty_tuple, /*PyObject *consts,*/
        __pyx_empty_tuple, /*PyObject *names,*/
        __pyx_empty_tuple, /*PyObject *varnames,*/
        __pyx_empty_tuple, /*PyObject *freevars,*/
        __pyx_empty_tuple, /*PyObject *cellvars,*/
        py_srcfile,   /*PyObject *filename,*/
        py_funcname,  /*PyObject *name,*/
        py_line,      /*int firstlineno,*/
        __pyx_empty_bytes  /*PyObject *lnotab*/
    );
    Py_DECREF(py_srcfile);
    Py_DECREF(py_funcname);
    return py_code;
bad:
    Py_XDECREF(py_srcfile);
    Py_XDECREF(py_funcname);
    return NULL;
}
static void __Pyx_AddTraceback(const char *funcname, int c_line,
                               int py_line, const char *filename) {
    PyCodeObject *py_code = 0;
    PyObject *py_globals = 0;
    PyFrameObject *py_frame = 0;
    py_code = __pyx_find_code_object(c_line ? c_line : py_line);
    if (!py_code) {
        py_code = __Pyx_CreateCodeObjectForTraceback(
            funcname, c_line, py_line, filename);
        if (!py_code) goto bad;
        __pyx_insert_code_object(c_line ? c_line : py_line, py_code);
    }
    py_globals = PyModule_GetDict(__pyx_m);
    if (!py_globals) goto bad;
    py_frame = PyFrame_New(
        PyThreadState_GET(), /*PyThreadState *tstate,*/
        py_code,             /*PyCodeObject *code,*/
        py_globals,          /*PyObject *globals,*/
        0                    /*PyObject *locals*/
    );
    if (!py_frame) goto bad;
    py_frame->f_lineno = py_line;
    PyTraceBack_Here(py_frame);
bad:
    Py_XDECREF(py_code);
    Py_XDECREF(py_frame);
}

static int __Pyx_InitStrings(__Pyx_StringTabEntry *t) {
    while (t->p) {
        #if PY_MAJOR_VERSION < 3
        if (t->is_unicode) {
            *t->p = PyUnicode_DecodeUTF8(t->s, t->n - 1, NULL);
        } else if (t->intern) {
            *t->p = PyString_InternFromString(t->s);
        } else {
            *t->p = PyString_FromStringAndSize(t->s, t->n - 1);
        }
        #else  /* Python 3+ has unicode identifiers */
        if (t->is_unicode | t->is_str) {
            if (t->intern) {
                *t->p = PyUnicode_InternFromString(t->s);
            } else if (t->encoding) {
                *t->p = PyUnicode_Decode(t->s, t->n - 1, t->encoding, NULL);
            } else {
                *t->p = PyUnicode_FromStringAndSize(t->s, t->n - 1);
            }
        } else {
            *t->p = PyBytes_FromStringAndSize(t->s, t->n - 1);
        }
        #endif
        if (!*t->p)
            return -1;
        ++t;
    }
    return 0;
}

static CYTHON_INLINE PyObject* __Pyx_PyUnicode_FromString(char* c_str) {
    return __Pyx_PyUnicode_FromStringAndSize(c_str, strlen(c_str));
}
static CYTHON_INLINE char* __Pyx_PyObject_AsString(PyObject* o) {
    Py_ssize_t ignore;
    return __Pyx_PyObject_AsStringAndSize(o, &ignore);
}
static CYTHON_INLINE char* __Pyx_PyObject_AsStringAndSize(PyObject* o, Py_ssize_t *length) {
#if __PYX_DEFAULT_STRING_ENCODING_IS_ASCII || __PYX_DEFAULT_STRING_ENCODING_IS_DEFAULT
    if (
#if PY_MAJOR_VERSION < 3 && __PYX_DEFAULT_STRING_ENCODING_IS_ASCII
            __Pyx_sys_getdefaultencoding_not_ascii &&
#endif
            PyUnicode_Check(o)) {
#if PY_VERSION_HEX < 0x03030000
        char* defenc_c;
        PyObject* defenc = _PyUnicode_AsDefaultEncodedString(o, NULL);
        if (!defenc) return NULL;
        defenc_c = PyBytes_AS_STRING(defenc);
#if __PYX_DEFAULT_STRING_ENCODING_IS_ASCII
        {
            char* end = defenc_c + PyBytes_GET_SIZE(defenc);
            char* c;
            for (c = defenc_c; c < end; c++) {
                if ((unsigned char) (*c) >= 128) {
                    PyUnicode_AsASCIIString(o);
                    return NULL;
                }
            }
        }
#endif /*__PYX_DEFAULT_STRING_ENCODING_IS_ASCII*/
        *length = PyBytes_GET_SIZE(defenc);
        return defenc_c;
#else /* PY_VERSION_HEX < 0x03030000 */
        if (PyUnicode_READY(o) == -1) return NULL;
#if __PYX_DEFAULT_STRING_ENCODING_IS_ASCII
        if (PyUnicode_IS_ASCII(o)) {
            *length = PyUnicode_GET_DATA_SIZE(o);
            return PyUnicode_AsUTF8(o);
        } else {
            PyUnicode_AsASCIIString(o);
            return NULL;
        }
#else /* __PYX_DEFAULT_STRING_ENCODING_IS_ASCII */
        return PyUnicode_AsUTF8AndSize(o, length);
#endif /* __PYX_DEFAULT_STRING_ENCODING_IS_ASCII */
#endif /* PY_VERSION_HEX < 0x03030000 */
    } else
#endif /* __PYX_DEFAULT_STRING_ENCODING_IS_ASCII  || __PYX_DEFAULT_STRING_ENCODING_IS_DEFAULT */
    {
        char* result;
        int r = PyBytes_AsStringAndSize(o, &result, length);
        if (r < 0) {
            return NULL;
        } else {
            return result;
        }
    }
}
static CYTHON_INLINE int __Pyx_PyObject_IsTrue(PyObject* x) {
   int is_true = x == Py_True;
   if (is_true | (x == Py_False) | (x == Py_None)) return is_true;
   else return PyObject_IsTrue(x);
}
static CYTHON_INLINE PyObject* __Pyx_PyNumber_Int(PyObject* x) {
  PyNumberMethods *m;
  const char *name = NULL;
  PyObject *res = NULL;
#if PY_MAJOR_VERSION < 3
  if (PyInt_Check(x) || PyLong_Check(x))
#else
  if (PyLong_Check(x))
#endif
    return Py_INCREF(x), x;
  m = Py_TYPE(x)->tp_as_number;
#if PY_MAJOR_VERSION < 3
  if (m && m->nb_int) {
    name = "int";
    res = PyNumber_Int(x);
  }
  else if (m && m->nb_long) {
    name = "long";
    res = PyNumber_Long(x);
  }
#else
  if (m && m->nb_int) {
    name = "int";
    res = PyNumber_Long(x);
  }
#endif
  if (res) {
#if PY_MAJOR_VERSION < 3
    if (!PyInt_Check(res) && !PyLong_Check(res)) {
#else
    if (!PyLong_Check(res)) {
#endif
      PyErr_Format(PyExc_TypeError,
                   "__%s__ returned non-%s (type %.200s)",
                   name, name, Py_TYPE(res)->tp_name);
      Py_DECREF(res);
      return NULL;
    }
  }
  else if (!PyErr_Occurred()) {
    PyErr_SetString(PyExc_TypeError,
                    "an integer is required");
  }
  return res;
}
static CYTHON_INLINE Py_ssize_t __Pyx_PyIndex_AsSsize_t(PyObject* b) {
  Py_ssize_t ival;
  PyObject* x = PyNumber_Index(b);
  if (!x) return -1;
  ival = PyInt_AsSsize_t(x);
  Py_DECREF(x);
  return ival;
}
static CYTHON_INLINE PyObject * __Pyx_PyInt_FromSize_t(size_t ival) {
#if PY_VERSION_HEX < 0x02050000
   if (ival <= LONG_MAX)
       return PyInt_FromLong((long)ival);
   else {
       unsigned char *bytes = (unsigned char *) &ival;
       int one = 1; int little = (int)*(unsigned char*)&one;
       return _PyLong_FromByteArray(bytes, sizeof(size_t), little, 0);
   }
#else
   return PyInt_FromSize_t(ival);
#endif
}
static CYTHON_INLINE size_t __Pyx_PyInt_AsSize_t(PyObject* x) {
   unsigned PY_LONG_LONG val = __Pyx_PyInt_AsUnsignedLongLong(x);
   if (unlikely(val != (unsigned PY_LONG_LONG)(size_t)val)) {
       if ((val != (unsigned PY_LONG_LONG)-1) || !PyErr_Occurred())
           PyErr_SetString(PyExc_OverflowError,
                           "value too large to convert to size_t");
       return (size_t)-1;
   }
   return (size_t)val;
}


#endif /* Py_PYTHON_H */
